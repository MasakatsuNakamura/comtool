AUTOSAR XML (schema 4-0-3)
package /Ecuc
  module config BswM_LittleEndianCanV11: definition=BswM, ecuc-def-edition=4.0.3
  module config CanIf_LittleEndianCanV11: definition=CanIf, ecuc-def-edition=4.0.3
    CanIfInitCfg_LittleEndianCanV11 (CanIfInitCfg)
      CanIfRxPduCfg_Rx_can0 (CanIfRxPduCfg):
        CanIfRxPduCanId = 0x00000300
        CanIfRxPduCanIdType = STANDARD_CAN
        CanIfRxPduDlc = 1
        CanIfRxPduId = 0
        CanIfRxPduReadData = 0
        CanIfRxPduReadNotifyStatus = 0
        CanIfRxPduUserRxIndicationUL = PDUR
        CanIfRxPduRef = Pdu_Rx_can0
      CanIfTxPduCfg_Tx_can0 (CanIfTxPduCfg):
        CanIfTxPduCanId = 0x00000100
        CanIfTxPduCanIdType = STANDARD_CAN
        CanIfTxPduDlc = 1
        CanIfTxPduId = 0
        CanIfTxPduPnFilterPdu = 0
        CanIfTxPduReadNotifyStatus = 0
        CanIfTxPduType = STATIC
        CanIfTxPduUserTxConfirmationUL = PDUR
        CanIfTxPduRef = Pdu_Tx_can0
  module config Com_LittleEndianCanV11: definition=Com, ecuc-def-edition=4.0.3
    ComConfig_LittleEndianCanV11 (ComConfig): ComConfigurationId=0
      ComIPdu_Rx_can0 (ComIPdu):
        ComIPduCancellationSupport = 0
        ComIPduDirection = RECEIVE
        ComIPduHandleId = 0
        ComIPduSignalProcessing = IMMEDIATE
        ComIPduType = NORMAL
        ComIPduSignalRef = ComSignal_RxSig_can0_0
        ComPduIdRef = Pdu_Rx_can0
      ComIPdu_Tx_can0 (ComIPdu):
        ComIPduCancellationSupport = 0
        ComIPduDirection = SEND
        ComIPduHandleId = 1
        ComIPduSignalProcessing = IMMEDIATE
        ComIPduType = NORMAL
        ComIPduSignalRef = ComSignal_TxSig_can0_0
        ComPduIdRef = Pdu_Tx_can0
        ComTxIPdu_Tx_can0 (ComTxIPdu)
      ComSignal_RxSig_can0_0 (ComSignal):
        ComBitPosition = 0
        ComBitSize = 3
        ComHandleId = 0
        ComSignalEndianness = LITTLE_ENDIAN
        ComSignalInitValue = 0
        ComSignalType = BOOLEAN
        ComSystemTemplateSystemSignalRef = ISignalToIPduMapping_RxSig_can0_0_Rx_can0
      ComSignal_TxSig_can0_0 (ComSignal):
        ComBitPosition = 0
        ComBitSize = 2
        ComHandleId = 1
        ComSignalEndianness = LITTLE_ENDIAN
        ComSignalInitValue = 0
        ComSignalType = BOOLEAN
        ComSystemTemplateSystemSignalRef = ISignalToIPduMapping_TxSig_can0_0_Tx_can0
  module config Ecuc_LittleEndianCanV11: definition=EcuC, ecuc-def-edition=4.0.3
    EcucPduCollection_LittleEndianCanV11 (EcucPduCollection): PduIdTypeEnum=UINT8, PduLengthTypeEnum=UINT8
      Pdu_Rx_can0 (Pdu): PduLength=1
      Pdu_Tx_can0 (Pdu): PduLength=1
  module config PduR_LittleEndianCanV11: definition=PduR, ecuc-def-edition=4.0.3
    PduRRoutingTables_LittleEndianCanV11 (PduRRoutingTables): PduRConfigurationId=0
      PduRRoutingTable_LittleEndianCanV11 (PduRRoutingTable)
        PduRRoutingPath_Rx_can0 (PduRRoutingPath)
          PduRDestPdu_Rx_can0 (PduRDestPdu): PduRDestPduHandleId=0, PduRDestPduRef=Pdu_Rx_can0
          PduRSrcPdu_Rx_can0 (PduRSrcPdu): PduRSourcePduHandleId=0, PduRSrcPduRef=Pdu_Rx_can0
        PduRRoutingPath_Tx_can0 (PduRRoutingPath)
          PduRDestPdu_Tx_can0 (PduRDestPdu): PduRDestPduHandleId=1, PduRDestPduRef=Pdu_Tx_can0
          PduRSrcPdu_Tx_can0 (PduRSrcPdu): PduRSourcePduHandleId=1, PduRSrcPduRef=Pdu_Tx_can0

AUTOSAR XML (schema 4-2-2)
package /SystemDesign
  pdu ISignalIPdu_LittleEndianCanV20
    signal ISignal_RxSig_can0_0: 
    signal ISignal_TxSig_can0_0: 

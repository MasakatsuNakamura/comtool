AUTOSAR XML (schema 4-0-3)
package /SystemDesign
  pdu ISignalIPdu_PrjMultipleMessageSingalCanV11
    signal ISignal_TxSignal{1..3}: 
    signal ISignal_RxSignal{1..3}: 

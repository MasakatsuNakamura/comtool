AUTOSAR XML (schema 4-0-3)
package /SystemDesign
  pdu ISignalIPdu_LittleEndianCanV11
    signal ISignal_RxSig_can0_0: 
    signal ISignal_TxSig_can0_0: 

AUTOSAR XML (schema 4-2-2)
package /Ecuc
  module config BswM_PrjBswMV20: definition=BswM, ecuc-def-edition=4.2.2
    BswMConfig_BswMConfig (BswMConfig)
      Arbitration (BswMArbitration)
        Rule_1 (BswMRule):
          BswMNestedExecutionOnly = false
          BswMRuleInitState = BSWM_FALSE
          BswMRuleExpressionRef = exp_0
          BswMRuleFalseActionList = ActionList_12
          BswMRuleTrueActionList = ActionList_11
        Rule_7 (BswMRule): BswMNestedExecutionOnly=true, BswMRuleInitState=BSWM_FALSE, BswMRuleExpressionRef=exp_1, BswMRuleTrueActionList=ActionList_8
        5 x BswMModeCondition, all with BswMConditionType=BSWM_EQUALS:
          cond_0: BswMConditionMode=port_0
            BswMConditionValue
              BswMBswMode: BswMBswRequestedMode=NVM_REQ_OK
          cond_1: BswMConditionMode=port_1
            BswMConditionValue
              BswMBswMode: BswMBswRequestedMode=NVM_REQ_OK
          cond_2: BswMConditionMode=port_2
            BswMConditionValue
              BswMBswMode: BswMBswRequestedMode=NVM_REQ_NG
          cond_3: BswMConditionMode=port_3
            BswMConditionValue
              BswMBswMode: BswMBswRequestedMode=ECUM_STATE_STARTUP_ONE
          cond_4: BswMConditionMode=port_4
            BswMConditionValue
              BswMBswMode: BswMBswRequestedMode=ECUM_STATE_STARTUP_TWO
        3 x BswMLogicalExpression:
          exp_0: BswMLogicalOperator=BSWM_NO_OPE, BswMArgumentRef=cond_0
          exp_1: BswMLogicalOperator=BSWM_AND, BswMArgumentRef=cond_1, BswMArgumentRef=exp_2, BswMArgumentRef=cond_4
          exp_2: BswMLogicalOperator=BSWM_OR, BswMArgumentRef=cond_2, BswMArgumentRef=cond_3
        5 x BswMModeRequestPort:
          port_0
            BswMModeRequestSource
              BswMNvMJobModeIndication
          port_1
            BswMModeRequestSource
              BswMNvMJobModeIndication
          port_2
            BswMModeRequestSource
              BswMNvMJobModeIndication
          port_3
            BswMModeRequestSource
              BswMEcuMIndication
          port_4
            BswMModeRequestSource
              BswMEcuMIndication
      ModeControl (BswMModeControl)
        3 x BswMActionList:
          ActionList_11
            item_0 (BswMActionListItem): BswMAbortOnFail=false, BswMActionListItemIndex=0, BswMActionListItemRef=ActionList_12
            item_1 (BswMActionListItem): BswMAbortOnFail=false, BswMActionListItemIndex=1, BswMActionListItemRef=Action_15
          ActionList_12
            item_0 (BswMActionListItem): BswMAbortOnFail=false, BswMActionListItemIndex=0, BswMActionListItemRef=Rule_7
          ActionList_8
            item_0 (BswMActionListItem): BswMAbortOnFail=false, BswMActionListItemIndex=0, BswMActionListItemRef=Action_10
        Action_10 (BswMAction)
          BswMAvailableActions
            BswMRteSwitch
        Action_15 (BswMAction)
          BswMAvailableActions
            BswMComMModeSwitch
  module config CanIf_PrjBswMV20: definition=CanIf, ecuc-def-edition=4.2.2
    CanIfInitCfg_PrjBswMV20 (CanIfInitCfg)
  module config Com_PrjBswMV20: definition=Com, ecuc-def-edition=4.2.2
    ComConfig_PrjBswMV20 (ComConfig)
  module config Ecuc_PrjBswMV20: definition=EcuC, ecuc-def-edition=4.2.2
    EcucConfigSet_PrjBswMV20 (EcucConfigSet)
      EcucPduCollection_PrjBswMV20 (EcucPduCollection)
  module config PduR_PrjBswMV20: definition=PduR, ecuc-def-edition=4.2.2
    PduRRoutingTables_PrjBswMV20 (PduRRoutingTables): PduRConfigurationId=0
      PduRRoutingTable_PrjBswMV20 (PduRRoutingTable)

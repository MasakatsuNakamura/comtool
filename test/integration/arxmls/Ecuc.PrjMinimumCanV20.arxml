AUTOSAR XML (schema 4-2-2)
package /Ecuc
  module config CanIf_PrjMinimumCanV20: definition=/QINeS/CanIf
    CanIfInitCfg_PrjMinimumCanV20 (CanIfInitCfg)
      CanIfRxPduCfg_Rx_can0 (CanIfRxPduCfg):
        CanIfRxPduCanId = 0x00000300
        CanIfRxPduDlc = 1
        CanIfRxPduCanIdType = STANDARD_CAN
        CanIfRxPduId = 0
        CanIfRxPduReadData = 0
        CanIfRxPduReadNotifyStatus = 0
        CanIfRxPduUserRxIndicationUL = PDUR
        CanIfRxPduRef = Pdu_Rx_can0
      CanIfTxPduCfg_Tx_can0 (CanIfTxPduCfg):
        CanIfTxPduCanId = 0x00000100
        CanIfTxPduId = 0
        CanIfTxPduType = STATIC
        CanIfTxPduDlc = 1
        CanIfTxPduCanIdType = STANDARD_CAN
        CanIfTxPduPnFilterPdu = 0
        CanIfTxPduReadNotifyStatus = 0
        CanIfTxPduUserTxConfirmationUL = PDUR
        CanIfTxPduRef = Pdu_Tx_can0
  module config Com_PrjMinimumCanV20: definition=/eSOL/EcucDefs/Com
    ComConfig_PrjMinimumCanV20 (ComConfig)
      ComIPdu_Rx_can0 (ComIPdu):
        ComIPduCancellationSupport = 0
        ComIPduDirection = RECEIVE
        ComIPduHandleId = 0
        ComIPduSignalProcessing = IMMEDIATE
        ComIPduType = NORMAL
        ComIPduSignalRef = ComSignal_RxSig_can0_0
        ComPduIdRef = Pdu_Rx_can0
      ComIPdu_Tx_can0 (ComIPdu):
        ComIPduCancellationSupport = 0
        ComIPduDirection = SEND
        ComIPduHandleId = 1
        ComIPduSignalProcessing = IMMEDIATE
        ComIPduType = NORMAL
        ComIPduSignalRef = ComSignal_TxSig_can0_0
        ComPduIdRef = Pdu_Tx_can0
        ComTxIPdu_Tx_can0 (ComTxIPdu)
      ComSignal_RxSig_can0_0 (ComSignal): ComBitPosition=7, ComBitSize=3, ComHandleId=0, ComInitialValueOnly=0, ComSignalEndianness=BIG_ENDIAN, ComSignalInitValue=0, ComSignalType=BOOLEAN
      ComSignal_TxSig_can0_0 (ComSignal): ComBitPosition=7, ComBitSize=2, ComHandleId=1, ComInitialValueOnly=0, ComSignalEndianness=BIG_ENDIAN, ComSignalInitValue=0, ComSignalType=BOOLEAN
  module config Ecuc_PrjMinimumCanV20: definition=/AUTOSAR/EcucDefs/EcuC
    EcucConfigSet_PrjMinimumCanV20 (EcucConfigSet)
      EcucPduCollection_PrjMinimumCanV20 (EcucPduCollection)
        Pdu_Rx_can0 (Pdu): PduLength=1
        Pdu_Tx_can0 (Pdu): PduLength=1
  module config PduR_PrjMinimumCanV20: definition=/AUTOSAR/EcucDefs/PduR
    PduRRoutingTables_PrjMinimumCanV20 (PduRRoutingTables): PduRConfigurationId=0
      PduRRoutingTable_PrjMinimumCanV20 (PduRRoutingTable)
        PduRRoutingPath_Rx_can0 (PduRRoutingPath)
          PduRDestPdu_Rx_can0 (PduRDestPdu): PduRDestPduHandleId=0, PduRDestPduRef=Pdu_Rx_can0
          PduRSrcPdu_Rx_can0 (PduRSrcPdu): PduRSourcePduHandleId=0, PduRSrcPduRef=Pdu_Rx_can0
        PduRRoutingPath_Tx_can0 (PduRRoutingPath)
          PduRDestPdu_Tx_can0 (PduRDestPdu): PduRDestPduHandleId=1, PduRDestPduRef=Pdu_Tx_can0
          PduRSrcPdu_Tx_can0 (PduRSrcPdu): PduRSourcePduHandleId=1, PduRSrcPduRef=Pdu_Tx_can0

AUTOSAR XML (schema 4-2-2)
package /Ecuc
  module config BswM_PrjMultipleMessageSingalCanV20: definition=BswM, ecuc-def-edition=4.2.2
  module config CanIf_PrjMultipleMessageSingalCanV20: definition=CanIf, ecuc-def-edition=4.2.2
    CanIfInitCfg_PrjMultipleMessageSingalCanV20 (CanIfInitCfg)
      CanIfRxPduCfg_RxMessage1 (CanIfRxPduCfg):
        CanIfRxPduCanId = 0x0000012c
        CanIfRxPduCanIdType = STANDARD_CAN
        CanIfRxPduDlc = 1
        CanIfRxPduId = 0
        CanIfRxPduReadData = 0
        CanIfRxPduReadNotifyStatus = 0
        CanIfRxPduUserRxIndicationUL = PDUR
        CanIfRxPduRef = Pdu_RxMessage1
      CanIfRxPduCfg_RxMessage2 (CanIfRxPduCfg):
        CanIfRxPduCanId = 0x00000190
        CanIfRxPduCanIdType = STANDARD_CAN
        CanIfRxPduDlc = 8
        CanIfRxPduId = 1
        CanIfRxPduReadData = 0
        CanIfRxPduReadNotifyStatus = 0
        CanIfRxPduUserRxIndicationUL = PDUR
        CanIfRxPduRef = Pdu_RxMessage2
      CanIfTxPduCfg_TxMessage1 (CanIfTxPduCfg):
        CanIfTxPduCanId = 0x00000064
        CanIfTxPduCanIdType = STANDARD_CAN
        CanIfTxPduDlc = 1
        CanIfTxPduId = 0
        CanIfTxPduPnFilterPdu = 0
        CanIfTxPduReadNotifyStatus = 0
        CanIfTxPduType = STATIC
        CanIfTxPduUserTxConfirmationUL = PDUR
        CanIfTxPduRef = Pdu_TxMessage1
      CanIfTxPduCfg_TxMessage2 (CanIfTxPduCfg):
        CanIfTxPduCanId = 0x000000c8
        CanIfTxPduCanIdType = STANDARD_CAN
        CanIfTxPduDlc = 8
        CanIfTxPduId = 1
        CanIfTxPduPnFilterPdu = 0
        CanIfTxPduReadNotifyStatus = 0
        CanIfTxPduType = STATIC
        CanIfTxPduUserTxConfirmationUL = PDUR
        CanIfTxPduRef = Pdu_TxMessage2
  module config Com_PrjMultipleMessageSingalCanV20: definition=Com, ecuc-def-edition=4.2.2
    ComConfig_PrjMultipleMessageSingalCanV20 (ComConfig)
      4 x ComIPdu, all with ComIPduCancellationSupport=0, ComIPduSignalProcessing=COM_Q_IPDU_SIGPRO_IMMEDIATE, ComIPduType=COM_Q_IPDU_TYPE_NORMAL:
        ComIPdu_RxMessage1: ComIPduDirection=COM_Q_IPDU_DIR_RECEIVE, ComIPduHandleId=2, ComIPduSignalRef=ComSignal_RxSignal1, ComPduIdRef=Pdu_RxMessage1
        ComIPdu_RxMessage2: ComIPduDirection=COM_Q_IPDU_DIR_RECEIVE, ComIPduHandleId=3, ComIPduSignalRef=ComSignal_RxSignal3, ComPduIdRef=Pdu_RxMessage2
        ComIPdu_TxMessage1: ComIPduDirection=COM_Q_IPDU_DIR_SEND, ComIPduHandleId=0, ComIPduSignalRef=ComSignal_TxSignal1, ComPduIdRef=Pdu_TxMessage1
          ComTxIPdu_TxMessage1 (ComTxIPdu)
        ComIPdu_TxMessage2: ComIPduDirection=COM_Q_IPDU_DIR_SEND, ComIPduHandleId=1, ComIPduSignalRef=ComSignal_TxSignal3, ComPduIdRef=Pdu_TxMessage2
          ComTxIPdu_TxMessage2 (ComTxIPdu)
      6 x ComSignal, all with ComInitialValueOnly=0, ComSignalEndianness=COM_Q_SIG_ENDIAN_BIG_ENDIAN, ComSignalInitValue=0:
        ComSignal_RxSignal1: ComBitPosition=7, ComBitSize=8, ComHandleId=3, ComSignalType=COM_Q_SIGTYPE_UINT8, ComSystemTemplateSystemSignalRef=ISignalToIPduMapping_RxSignal1_RxMessage1
        ComSignal_RxSignal2: ComBitPosition=7, ComBitSize=1, ComHandleId=4, ComSignalType=COM_Q_SIGTYPE_BOOL, ComSystemTemplateSystemSignalRef=ISignalToIPduMapping_RxSignal2_RxMessage2
        ComSignal_RxSignal3: ComBitPosition=6, ComBitSize=63, ComHandleId=5, ComSignalType=COM_Q_SIGTYPE_UINT64, ComSystemTemplateSystemSignalRef=ISignalToIPduMapping_RxSignal3_RxMessage2
        ComSignal_TxSignal1: ComBitPosition=7, ComBitSize=8, ComHandleId=0, ComSignalType=COM_Q_SIGTYPE_UINT8, ComSystemTemplateSystemSignalRef=ISignalToIPduMapping_TxSignal1_TxMessage1
        ComSignal_TxSignal2: ComBitPosition=7, ComBitSize=32, ComHandleId=1, ComSignalType=COM_Q_SIGTYPE_UINT32, ComSystemTemplateSystemSignalRef=ISignalToIPduMapping_TxSignal2_TxMessage2
        ComSignal_TxSignal3: ComBitPosition=39, ComBitSize=32, ComHandleId=2, ComSignalType=COM_Q_SIGTYPE_UINT32, ComSystemTemplateSystemSignalRef=ISignalToIPduMapping_TxSignal3_TxMessage2
  module config Ecuc_PrjMultipleMessageSingalCanV20: definition=EcuC, ecuc-def-edition=4.2.2
    EcucConfigSet_PrjMultipleMessageSingalCanV20 (EcucConfigSet)
      EcucPduCollection_PrjMultipleMessageSingalCanV20 (EcucPduCollection)
        4 x Pdu:
          Pdu_RxMessage1: PduLength=1
          Pdu_RxMessage2: PduLength=8
          Pdu_TxMessage1: PduLength=1
          Pdu_TxMessage2: PduLength=8
  module config PduR_PrjMultipleMessageSingalCanV20: definition=PduR, ecuc-def-edition=4.2.2
    PduRRoutingTables_PrjMultipleMessageSingalCanV20 (PduRRoutingTables): PduRConfigurationId=0
      PduRRoutingTable_PrjMultipleMessageSingalCanV20 (PduRRoutingTable)
        4 x PduRRoutingPath:
          PduRRoutingPath_RxMessage1
            PduRDestPdu_RxMessage1 (PduRDestPdu): PduRDestPduHandleId=2, PduRDestPduRef=Pdu_RxMessage1
            PduRSrcPdu_RxMessage1 (PduRSrcPdu): PduRSourcePduHandleId=2, PduRSrcPduRef=Pdu_RxMessage1
          PduRRoutingPath_RxMessage2
            PduRDestPdu_RxMessage2 (PduRDestPdu): PduRDestPduHandleId=3, PduRDestPduRef=Pdu_RxMessage2
            PduRSrcPdu_RxMessage2 (PduRSrcPdu): PduRSourcePduHandleId=3, PduRSrcPduRef=Pdu_RxMessage2
          PduRRoutingPath_TxMessage1
            PduRDestPdu_TxMessage1 (PduRDestPdu): PduRDestPduHandleId=0, PduRDestPduRef=Pdu_TxMessage1
            PduRSrcPdu_TxMessage1 (PduRSrcPdu): PduRSourcePduHandleId=0, PduRSrcPduRef=Pdu_TxMessage1
          PduRRoutingPath_TxMessage2
            PduRDestPdu_TxMessage2 (PduRDestPdu): PduRDestPduHandleId=1, PduRDestPduRef=Pdu_TxMessage2
            PduRSrcPdu_TxMessage2 (PduRSrcPdu): PduRSourcePduHandleId=1, PduRSrcPduRef=Pdu_TxMessage2

AUTOSAR XML (schema 4-2-2)
package /SystemDesign
  pdu ISignalIPdu_PrjMultipleMessageSingalCanV20
    signal ISignal_TxSignal{1..3}: 
    signal ISignal_RxSignal{1..3}: 

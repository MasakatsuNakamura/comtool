AUTOSAR XML (schema 4-2-2)
package /SystemDesign
  pdu ISignalIPdu_PrjBswMV20

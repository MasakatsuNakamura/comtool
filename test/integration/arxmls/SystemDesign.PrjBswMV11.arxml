AUTOSAR XML (schema 4-0-3)
package /SystemDesign
  pdu ISignalIPdu_PrjBswMV11

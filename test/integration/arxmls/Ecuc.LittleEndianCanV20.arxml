AUTOSAR XML (schema 4-2-2)
package /Ecuc
  module config BswM_LittleEndianCanV20: definition=BswM, ecuc-def-edition=4.2.2
  module config CanIf_LittleEndianCanV20: definition=CanIf, ecuc-def-edition=4.2.2
    CanIfInitCfg_LittleEndianCanV20 (CanIfInitCfg)
      CanIfRxPduCfg_Rx_can0 (CanIfRxPduCfg):
        CanIfRxPduCanId = 0x00000300
        CanIfRxPduCanIdType = STANDARD_CAN
        CanIfRxPduDlc = 1
        CanIfRxPduId = 0
        CanIfRxPduReadData = 0
        CanIfRxPduReadNotifyStatus = 0
        CanIfRxPduUserRxIndicationUL = PDUR
        CanIfRxPduRef = Pdu_Rx_can0
      CanIfTxPduCfg_Tx_can0 (CanIfTxPduCfg):
        CanIfTxPduCanId = 0x00000100
        CanIfTxPduCanIdType = STANDARD_CAN
        CanIfTxPduDlc = 1
        CanIfTxPduId = 0
        CanIfTxPduPnFilterPdu = 0
        CanIfTxPduReadNotifyStatus = 0
        CanIfTxPduType = STATIC
        CanIfTxPduUserTxConfirmationUL = PDUR
        CanIfTxPduRef = Pdu_Tx_can0
  module config Com_LittleEndianCanV20: definition=Com, ecuc-def-edition=4.2.2
    ComConfig_LittleEndianCanV20 (ComConfig)
      ComIPdu_Rx_can0 (ComIPdu):
        ComIPduCancellationSupport = 0
        ComIPduDirection = COM_Q_IPDU_DIR_RECEIVE
        ComIPduHandleId = 0
        ComIPduSignalProcessing = COM_Q_IPDU_SIGPRO_IMMEDIATE
        ComIPduType = COM_Q_IPDU_TYPE_NORMAL
        ComIPduSignalRef = ComSignal_RxSig_can0_0
        ComPduIdRef = Pdu_Rx_can0
      ComIPdu_Tx_can0 (ComIPdu):
        ComIPduCancellationSupport = 0
        ComIPduDirection = COM_Q_IPDU_DIR_SEND
        ComIPduHandleId = 1
        ComIPduSignalProcessing = COM_Q_IPDU_SIGPRO_IMMEDIATE
        ComIPduType = COM_Q_IPDU_TYPE_NORMAL
        ComIPduSignalRef = ComSignal_TxSig_can0_0
        ComPduIdRef = Pdu_Tx_can0
        ComTxIPdu_Tx_can0 (ComTxIPdu)
      ComSignal_RxSig_can0_0 (ComSignal):
        ComBitPosition = 0
        ComBitSize = 3
        ComHandleId = 0
        ComInitialValueOnly = 0
        ComSignalEndianness = COM_Q_SIG_ENDIAN_LITTLE_ENDIAN
        ComSignalInitValue = 0
        ComSignalType = COM_Q_SIGTYPE_BOOL
        ComSystemTemplateSystemSignalRef = ISignalToIPduMapping_RxSig_can0_0_Rx_can0
      ComSignal_TxSig_can0_0 (ComSignal):
        ComBitPosition = 0
        ComBitSize = 2
        ComHandleId = 1
        ComInitialValueOnly = 0
        ComSignalEndianness = COM_Q_SIG_ENDIAN_LITTLE_ENDIAN
        ComSignalInitValue = 0
        ComSignalType = COM_Q_SIGTYPE_BOOL
        ComSystemTemplateSystemSignalRef = ISignalToIPduMapping_TxSig_can0_0_Tx_can0
  module config Ecuc_LittleEndianCanV20: definition=EcuC, ecuc-def-edition=4.2.2
    EcucConfigSet_LittleEndianCanV20 (EcucConfigSet)
      EcucPduCollection_LittleEndianCanV20 (EcucPduCollection)
        Pdu_Rx_can0 (Pdu): PduLength=1
        Pdu_Tx_can0 (Pdu): PduLength=1
  module config PduR_LittleEndianCanV20: definition=PduR, ecuc-def-edition=4.2.2
    PduRRoutingTables_LittleEndianCanV20 (PduRRoutingTables): PduRConfigurationId=0
      PduRRoutingTable_LittleEndianCanV20 (PduRRoutingTable)
        PduRRoutingPath_Rx_can0 (PduRRoutingPath)
          PduRDestPdu_Rx_can0 (PduRDestPdu): PduRDestPduHandleId=0, PduRDestPduRef=Pdu_Rx_can0
          PduRSrcPdu_Rx_can0 (PduRSrcPdu): PduRSourcePduHandleId=0, PduRSrcPduRef=Pdu_Rx_can0
        PduRRoutingPath_Tx_can0 (PduRRoutingPath)
          PduRDestPdu_Tx_can0 (PduRDestPdu): PduRDestPduHandleId=1, PduRDestPduRef=Pdu_Tx_can0
          PduRSrcPdu_Tx_can0 (PduRSrcPdu): PduRSourcePduHandleId=1, PduRSrcPduRef=Pdu_Tx_can0

AUTOSAR XML (schema 4.0)
package /Ecuc
  module config CanIf: definition=/QINeS/CanIf
    CanIfCtrlDrvCfg: CanIfCtrlDrvInitHohConfigRef=InitHohCfg0, CanIfCtrlDrvNameRef=Can_70_rh850f1
      CanIfCtrlCfg_can0 (CanIfCtrlCfg): CanIfCtrlId=0, CanIfCtrlWakeupSupport=1, CanIfCtrlCanCtrlRef=CanController_can0
    CanIf_DispatchCfg (CanIfDispatchCfg):
      CanIfDispatchUserCtrlBusOffUL = CAN_SM
      CanIfDispatchUserCtrlModeIndicationUL = CAN_SM
      CanIfDispatchUserCtrlBusOffName = CanSM_ControllerBusOff
      CanIfDispatchUserCtrlModeIndicationName = CanSM_ControllerModeIndication
      CanIfDispatchUserTrcvModeIndicationName = CanSM_TransceiverModeIndication
      CanIfDispatchUserTrcvModeIndicationUL = CAN_SM
      CanIfDispatchUserValidateWakeupEventName = EcuM_ValidateWakeupEvent
      CanIfDispatchUserValidateWakeupEventUL = ECUM
    CanIfInitCfg
      BufCfg0 (CanIfBufferCfg): CanIfBufferSize=8, CanIfBufferHthRef=HthCfg_can0
      InitHohCfg0 (CanIfInitHohCfg)
        HthCfg_can0 (CanIfHthCfg): CanIfHthCanCtrlIdRef=CanIfCtrlCfg_can0, CanIfHthIdSymRef=Hthcan0_0
        CanIfHrhCfg_can0 (CanIfHrhCfg): CanIfHrhSoftwareFilter=0, CanIfHrhCanCtrlIdRef=CanIfCtrlCfg_can0, CanIfHrhIdSymRef=Hrhcan0_0
      RxPduCfg_can0 (CanIfRxPduCfg):
        CanIfRxPduCanId = 0x00000300
        CanIfRxPduCanIdType = STANDARD_CAN
        CanIfRxPduDlc = 8
        CanIfRxPduId = 0
        CanIfRxPduReadData = 1
        CanIfRxPduReadNotifyStatus = 1
        CanIfRxPduUserRxIndicationName = PduR_CanIfRxIndication
        CanIfRxPduUserRxIndicationUL = PDUR
        CanIfRxPduBswSchExclAreaIdRef = CriticalSection
        CanIfRxPduHrhIdRef = CanIfHrhCfg_can0
        CanIfRxPduRef = Pdu_Rx_can0
      TxPduCfg_can0 (CanIfTxPduCfg):
        CanIfTxPduCanId = 0x00000100
        CanIfTxPduCanIdType = STANDARD_CAN
        CanIfTxPduDlc = 8
        CanIfTxPduId = 0
        CanIfTxPduPnFilterPdu = 0
        CanIfTxPduReadNotifyStatus = 1
        CanIfTxPduType = STATIC
        CanIfTxPduUserTxConfirmationName = PduR_CanIfTxConfirmation
        CanIfTxPduUserTxConfirmationUL = PDUR
        CanIfTxPduBswSchExclAreaIdRef = CriticalSection
        CanIfTxPduBufferRef = BufCfg0
        CanIfTxPduRef = Pdu_Tx_can0
    CanIfPrivateCfg: CanIfPrivateDlcCheck=1, CanIfPrivateSoftwareFilterType=CANIF_Q_LINEAR
    CanIfPublicCfg:
      CanIfPublicNumberOfCanHwUnits = 1
      CanIfPublicDevErrorDetect = 0
      CanIfPublicReadRxPduDataApi = 1
      CanIfPublicReadRxPduNotifyStatusApi = 1
      CanIfPublicReadTxPduNotifyStatusApi = 1
      CanIfPublicTxBuffering = 1
      CanIfPublicTxConfirmPollingSupport = 1
      CanIfPublicWakeupCheckValidSupport = 1
    CanIfTrcvDrvCfg
      CanIfTrcvCfg_can0 (CanIfTrcvCfg): CanIfTrcvId=0, CanIfTrcvWakeupSupport=0, CanIfTrcvCanTrcvRef=CanTrcv_70_tja1050
  module config Com: definition=/eSOL/EcucDefs/Com
    ComConfig_0 (ComConfig): ComConfigurationId=0
      RxIPdu_can0 (ComIPdu):
        ComIPduCancellationSupport = 0
        ComIPduDirection = RECEIVE
        ComIPduHandleId = 0
        ComIPduSignalProcessing = IMMEDIATE
        ComIPduType = NORMAL
        ComIPduCallout = Rx_IPduCallout_1
        ComIPduGroupRef = IPduGrp_can0
        ComIPduSignalRef = RxSig_can0_0
        ComPduIdRef = Pdu_Rx_can0
      TxIPdu_can0 (ComIPdu):
        ComIPduCallout = Tx_IPduCallout_1
        ComIPduCancellationSupport = 0
        ComIPduDirection = SEND
        ComIPduHandleId = 0
        ComIPduSignalProcessing = IMMEDIATE
        ComIPduType = NORMAL
        ComIPduGroupRef = IPduGrp_can0
        ComIPduSignalRef = TxSig_can0_0
        ComPduIdRef = Pdu_Tx_can0
        ComTxIpdu (ComTxIPdu): ComTxIPduUnusedAreasDefault=0
          ComTxModeTrue
            ComTxMode: ComTxModeMode=DIRECT, ComTxModeNumberOfRepetitions=0
      IPduGrp_can0 (ComIPduGroup): ComIPduGroupHandleId=0
      RxSig_can0_0 (ComSignal):
        ComBitPosition = 7
        ComHandleId = 0
        ComSignalEndianness = BIG_ENDIAN
        ComSignalInitValue = 0
        ComSignalType = UINT8
        ComBitSize = 8
        ComNotification = Rte_COMCbk_RxSig_can0_0
        ComTimeout = 0.005
        ComFirstTimeout = 0.005
        ComSystemTemplateSystemSignalRef = ISignalToIPduMapping_001
      TxSig_can0_0 (ComSignal):
        ComBitPosition = 7
        ComHandleId = 1
        ComSignalEndianness = BIG_ENDIAN
        ComSignalInitValue = 0
        ComSignalType = UINT8
        ComTransferProperty = TRIGGERED
        ComBitSize = 8
        ComNotification = Rte_COMCbk_TxSig_can0_0
        ComSystemTemplateSystemSignalRef = ISignalToIPduMapping_002
      ComTimeBase: ComGwTimeBase=0, ComRxTimeBase=0.005, ComTxTimeBase=0.005
    ComGeneral:
      ComConfigurationUseDet = 0
      ComEnableMDTForCyclicTransmission = 1
      ComRetryFailedTransmitRequests = 0
      ComSupportedIPduGroups = 1
      ComVersionInfoApi = 0
      ComTriggerTransmitApi = 1
  module config EcuC: definition=/AUTOSAR/EcucDefs/EcuC
    EcucPduCollection: PduIdTypeEnum=UINT8, PduLengthTypeEnum=UINT8
      Pdu_Rx_can0 (Pdu): PduLength=8
      Pdu_Tx_can0 (Pdu): PduLength=8
  module config PduR: definition=/AUTOSAR/EcucDefs/PduR
    PduRGeneral: PduRDevErrorDetect=0, PduRVersionInfoApi=0, PduRZeroCostOperation=1
    PduRRoutingTables: PduRConfigurationId=0
      PduRRoutingTable_0 (PduRRoutingTable)
        PduRRoutingPath_can0 (PduRRoutingPath)
          PduRDestPdu_can0 (PduRDestPdu): PduRDestPduHandleId=0, PduRTpThreshold=1, PduRDestPduRef=Pdu_Rx_can0
          Pdu_can0_Src (PduRSrcPdu): PduRSourcePduHandleId=0, PduRSrcPduRef=Pdu_Tx_can0

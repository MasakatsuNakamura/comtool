AUTOSAR XML (schema 4.0)
package /Ecuc
  module config Rte: definition=/QINeS/Rte
    RteBswGeneral: RteSchMVersionInfoApi=1, RteUseComShadowSignalApi=0
    RteGeneration:
      RteCalibrationSupport = NONE
      RteCodeVendorId = 0
      RteDevErrorDetect = 0
      RteDevErrorDetectUninit = 0
      RteGenerationMode = COMPATIBILITY_MODE
      RteIocInteractionReturnValue = RTE_IOC
      RteMeasurementSupport = 0
      RteOptimizationMode = RUNTIME
      RteValueRangeCheckEnabled = 0
      RteVfbTraceEnabled = 0
    RteInitializationBehavior: RteInitializationStrategy=RTE_INITIALIZATION_STRATEGY_NONE, RteSectionInitializationPolicy=0
    RteOsInteraction
    RtePostBuildVariantConfiguration: RtePostBuildUsedPredefinedVariant=Variant_Dummy
    12 x RteBswModuleInstance:
      EcuM: RteBswImplementationRef=EcuMImpl
        Main (RteBswEventToTaskMapping):
          RteBswImmediateRestart = 0
          RteBswPositionInTask = 1
          RteBswEventRef = EcuM_MainFunction_TimingEvent
          RteBswMappedToTaskRef = TASK_ID_MainFunctionTask
          RteBswUsedOsEventRef = EVENT_MASK_MainFunctionEvent
        Startup (RteBswEventToTaskMapping): RteBswImmediateRestart=0, RteBswPositionInTask=11, RteBswEventRef=EcuM_StartupTwo_TimingEvent, RteBswMappedToTaskRef=TASK_ID_StartupTask
      Gpt: RteBswImplementationRef=GptImpl
      Mcu: RteBswImplementationRef=McuImpl
      Port: RteBswImplementationRef=PortImpl
      Can: RteBswImplementationRef=CanImpl
        5 x RteBswEventToTaskMapping, all with RteBswImmediateRestart=0, RteBswMappedToTaskRef=TASK_ID_MainFunctionTask, RteBswUsedOsEventRef=EVENT_MASK_MainFunctionEvent:
          Read: RteBswPositionInTask=80, RteBswEventRef=Can_70_rh850f1MainFunction_Read_TimingEvent
          Write: RteBswPositionInTask=81, RteBswEventRef=Can_70_rh850f1MainFunction_Write_TimingEvent
          BusOff: RteBswPositionInTask=82, RteBswEventRef=Can_70_rh850f1MainFunction_BusOff_TimingEvent
          Wakeup: RteBswPositionInTask=83, RteBswEventRef=Can_70_rh850f1MainFunction_Wakeup_TimingEvent
          Mode: RteBswPositionInTask=84, RteBswEventRef=Can_70_rh850f1MainFunction_Mode_TimingEvent
      CanSM: RteBswImplementationRef=CanSMImpl
        RteBswEventToTaskMapping:
          RteBswImmediateRestart = 0
          RteBswPositionInTask = 85
          RteBswEventRef = CanSM_MainFunction_TimingEvent
          RteBswMappedToTaskRef = TASK_ID_MainFunctionTask
          RteBswUsedOsEventRef = EVENT_MASK_MainFunctionEvent
        CriticalSection (RteBswExclusiveAreaImpl): RteExclusiveAreaImplMechanism=OS_INTERRUPT_BLOCKING, RteBswExclusiveAreaRef=CriticalSection
      Com: RteBswImplementationRef=ComImpl
        ComTx (RteBswEventToTaskMapping):
          RteBswImmediateRestart = 0
          RteBswPositionInTask = 88
          RteBswEventRef = Com_MainFunctionTx_TimingEvent
          RteBswUsedOsEventRef = EVENT_MASK_MainFunctionEvent
        ComRx (RteBswEventToTaskMapping):
          RteBswImmediateRestart = 0
          RteBswPositionInTask = 89
          RteBswEventRef = Com_MainFunctionRx_TimingEvent
          RteBswMappedToTaskRef = TASK_ID_MainFunctionTask
          RteBswUsedOsEventRef = EVENT_MASK_MainFunctionEvent
        CriticalSection (RteBswExclusiveAreaImpl): RteExclusiveAreaImplMechanism=OS_INTERRUPT_BLOCKING, RteBswExclusiveAreaRef=AllGlobalVariable
      ComM: RteBswImplementationRef=ComMImpl
        ComM_0 (RteBswEventToTaskMapping):
          RteBswImmediateRestart = 0
          RteBswPositionInTask = 90
          RteBswEventRef = ComM_MainFunction_0_TimingEvent
          RteBswMappedToTaskRef = TASK_ID_MainFunctionTask
          RteBswUsedOsEventRef = EVENT_MASK_MainFunctionEvent
        ComM_1 (RteBswEventToTaskMapping):
          RteBswImmediateRestart = 0
          RteBswPositionInTask = 91
          RteBswEventRef = ComM_MainFunction_0_TimingEvent
          RteBswMappedToTaskRef = TASK_ID_MainFunctionTask
          RteBswUsedOsEventRef = EVENT_MASK_MainFunctionEvent
        CriticalSection (RteBswExclusiveAreaImpl): RteExclusiveAreaImplMechanism=OS_INTERRUPT_BLOCKING, RteBswExclusiveAreaRef=CriticalSection
      CanIf: RteBswImplementationRef=CanIfImpl
        CriticalSection (RteBswExclusiveAreaImpl): RteExclusiveAreaImplMechanism=OS_INTERRUPT_BLOCKING, RteBswExclusiveAreaRef=CriticalSection
      CanTrcv: RteBswImplementationRef=CanTrcvImpl
        CriticalSection (RteBswExclusiveAreaImpl): RteExclusiveAreaImplMechanism=OS_INTERRUPT_BLOCKING, RteBswExclusiveAreaRef=CanTrcvCommonData
      Os: RteBswImplementationRef=OsImpl
      Icu: RteBswImplementationRef=IcuImpl
    4 x RteSwComponentInstance:
      SwcRH850Ins: RteSoftwareComponentInstanceRef=SwcRH850Ins
        3 x RteEventToTaskMapping, all with RteImmediateRestart=0:
          INIT: RtePositionInTask=61, RteEventRef=TimingEvent_001, RteMappedToTaskRef=TASK_ID_StartupTask
          CYCLE: RtePositionInTask=62, RteEventRef=TimingEvent_002, RteMappedToTaskRef=TASK_ID_SwcRH850Task, RteUsedOsEventRef=EVENT_MASK_SwcRH850cycleEvent
          ERROR_NOTIFICATION: RteEventRef=TimingEvent_003, RteMappedToTaskRef=TASK_ID_SwcRH850Task, RteUsedOsEventRef=EVENT_MASK_SwcRH850errorEvent
      EcuMSwcIns: RteSoftwareComponentInstanceRef=EcuMSwcIns
      CanSMSwcIns: RteSoftwareComponentInstanceRef=CanSMSwcIns
      ComMSwcIns: RteSoftwareComponentInstanceRef=ComMSwcIns
    4 x RteSwComponentType:
      SwcRH850: RteComponentTypeRef=SwcRH850
      EcuMSwc: RteComponentTypeRef=EcuMSwc
      CanSMSwc: RteComponentTypeRef=CanSMSwc
      ComMSwc: RteComponentTypeRef=ComMSwc
  module config Can: definition=/eSOL/EcucDefs/Can
    CanConfigSet
      CanController_can0 (CanController):
        CanBusoffProcessing = INTERRUPT
        CanControllerActivation = 1
        CanControllerBaseAddress = 0
        CanControllerId = 0
        CanRxProcessing = INTERRUPT
        CanTxProcessing = INTERRUPT
        CanWakeupProcessing = INTERRUPT
        CanWakeupSupport = 1
        CanControllerDefaultBaudrate = CanControllerBaudrateConfig
        CanCpuClockRef = McuClockReferencePoint
        CanWakeupSourceRef = WAKEUPSOURCE_CAN
        CanControllerBaudrateConfig: CanControllerBaudRate=0, CanControllerPropSeg=0, CanControllerSeg1=0, CanControllerSeg2=0, CanControllerSyncJumpWidth=0
      Hthcan0_0 (CanHardwareObject): CanHandleType=BASIC, CanIdType=STANDARD, CanIdValue=0, CanObjectId=0, CanObjectType=TRANSMIT, CanControllerRef=CanController_can0
      Hrhcan0_0 (CanHardwareObject): CanHandleType=BASIC, CanIdType=STANDARD, CanIdValue=0, CanObjectId=3, CanObjectType=RECEIVE, CanControllerRef=CanController_can0
    Can_70_rh850f1 (CanGeneral):
      CanChangeBaudrateApi = 0
      CanDevErrorDetection = 0
      CanHardwareCancellation = 1
      CanIdenticalIdCancellation = 1
      CanIndex = 0
      CanMainFunctionModePeriod = 0.001
      CanMultiplexedTransmission = 1
      CanTimeoutDuration = 0.001
      CanVersionInfoApi = 1
      CanCounterRef = Hw_Counter
      CanSupportTTCANRef = CanIfPrivateCfg
      CanMainFunctionRWPeriods
  module config CanIf: definition=/QINeS/CanIf
    CanIfCtrlDrvCfg: CanIfCtrlDrvInitHohConfigRef=InitHohCfg0, CanIfCtrlDrvNameRef=Can_70_rh850f1
      CanIfCtrlCfg_can0 (CanIfCtrlCfg): CanIfCtrlId=0, CanIfCtrlWakeupSupport=1, CanIfCtrlCanCtrlRef=CanController_can0
    CanIf_DispatchCfg (CanIfDispatchCfg):
      CanIfDispatchUserCtrlBusOffUL = CAN_SM
      CanIfDispatchUserCtrlModeIndicationUL = CAN_SM
      CanIfDispatchUserCtrlBusOffName = CanSM_ControllerBusOff
      CanIfDispatchUserCtrlModeIndicationName = CanSM_ControllerModeIndication
      CanIfDispatchUserTrcvModeIndicationName = CanSM_TransceiverModeIndication
      CanIfDispatchUserTrcvModeIndicationUL = CAN_SM
      CanIfDispatchUserValidateWakeupEventName = EcuM_ValidateWakeupEvent
      CanIfDispatchUserValidateWakeupEventUL = ECUM
    CanIfInitCfg
      BufCfg0 (CanIfBufferCfg): CanIfBufferSize=8, CanIfBufferHthRef=HthCfg_can0
      InitHohCfg0 (CanIfInitHohCfg)
        HthCfg_can0 (CanIfHthCfg): CanIfHthCanCtrlIdRef=CanIfCtrlCfg_can0, CanIfHthIdSymRef=Hthcan0_0
        CanIfHrhCfg_can0 (CanIfHrhCfg): CanIfHrhSoftwareFilter=0, CanIfHrhCanCtrlIdRef=CanIfCtrlCfg_can0, CanIfHrhIdSymRef=Hrhcan0_0
      RxPduCfg_can0 (CanIfRxPduCfg):
        CanIfRxPduCanId = 0x00000300
        CanIfRxPduCanIdType = STANDARD_CAN
        CanIfRxPduDlc = 8
        CanIfRxPduId = 0
        CanIfRxPduReadData = 1
        CanIfRxPduReadNotifyStatus = 1
        CanIfRxPduUserRxIndicationName = PduR_CanIfRxIndication
        CanIfRxPduUserRxIndicationUL = PDUR
        CanIfRxPduBswSchExclAreaIdRef = CanIf/CriticalSection
        CanIfRxPduHrhIdRef = CanIfHrhCfg_can0
        CanIfRxPduRef = Pdu_Rx_can0
      TxPduCfg_can0 (CanIfTxPduCfg):
        CanIfTxPduCanId = 0x00000100
        CanIfTxPduCanIdType = STANDARD_CAN
        CanIfTxPduDlc = 8
        CanIfTxPduId = 0
        CanIfTxPduPnFilterPdu = 0
        CanIfTxPduReadNotifyStatus = 1
        CanIfTxPduType = STATIC
        CanIfTxPduUserTxConfirmationName = PduR_CanIfTxConfirmation
        CanIfTxPduUserTxConfirmationUL = PDUR
        CanIfTxPduBswSchExclAreaIdRef = CanIf/CriticalSection
        CanIfTxPduBufferRef = BufCfg0
        CanIfTxPduRef = Pdu_Tx_can0
    CanIfPrivateCfg: CanIfPrivateDlcCheck=1, CanIfPrivateSoftwareFilterType=CANIF_Q_LINEAR
    CanIfPublicCfg:
      CanIfPublicNumberOfCanHwUnits = 1
      CanIfPublicDevErrorDetect = 0
      CanIfPublicReadRxPduDataApi = 1
      CanIfPublicReadRxPduNotifyStatusApi = 1
      CanIfPublicReadTxPduNotifyStatusApi = 1
      CanIfPublicTxBuffering = 1
      CanIfPublicTxConfirmPollingSupport = 1
      CanIfPublicWakeupCheckValidSupport = 1
    CanIfTrcvDrvCfg
      CanIfTrcvCfg_can0 (CanIfTrcvCfg): CanIfTrcvId=0, CanIfTrcvWakeupSupport=0, CanIfTrcvCanTrcvRef=CanTrcvConfigSet/CanTrcv_70_tja1050
  module config CanTrcv: definition=/QINeS/CanTrcv
    CanTrcvConfigSet
      CanTrcv_70_tja1050 (CanTrcvChannel):
        CanTrcvChannelId = 0
        CanTrcvChannelUsed = 1
        CanTrcvControlsPowerSupply = 0
        CanTrcvHwPnSupport = 0
        CanTrcvInitState = CANTRCV_OP_MODE_NORMAL
        CanTrcvMaxBaudrate = 1
        CanTrcvWakeupByBusUsed = 0
        CanTrcvAccess
          CanTrcvDioAccess
            CanTrcvDioChannelAccess: CanTrcvHardwareInterfaceName=DIO_Q_CAN_TRANCIEVER_MODE
    CanTrcv_70_tja1050 (CanTrcvGeneral): CanTrcvDevErrorDetect=0, CanTrcvGetVersionInfo=0, CanTrcvWaitCount=0xff, CanTrcvWakeUpSupport=CANTRCV_WAKEUP_NOT_SUPPORTED
  module config Com: definition=/eSOL/EcucDefs/Com
    ComConfig_0 (ComConfig): ComConfigurationId=0
      RxIPdu_can0 (ComIPdu):
        ComIPduCancellationSupport = 0
        ComIPduDirection = RECEIVE
        ComIPduHandleId = 0
        ComIPduSignalProcessing = IMMEDIATE
        ComIPduType = NORMAL
        ComIPduCallout = Rx_IPduCallout_1
        ComIPduGroupRef = IPduGrp_can0
        ComIPduSignalRef = RxSig_can0_0
        ComPduIdRef = Pdu_Rx_can0
      TxIPdu_can0 (ComIPdu):
        ComIPduCallout = Tx_IPduCallout_1
        ComIPduCancellationSupport = 0
        ComIPduDirection = SEND
        ComIPduHandleId = 0
        ComIPduSignalProcessing = IMMEDIATE
        ComIPduType = NORMAL
        ComIPduGroupRef = IPduGrp_can0
        ComIPduSignalRef = TxSig_can0_0
        ComPduIdRef = Pdu_Tx_can0
        ComTxIpdu (ComTxIPdu): ComTxIPduUnusedAreasDefault=0
          ComTxModeTrue
            ComTxMode: ComTxModeMode=DIRECT, ComTxModeNumberOfRepetitions=0
      IPduGrp_can0 (ComIPduGroup): ComIPduGroupHandleId=0
      RxSig_can0_0 (ComSignal):
        ComBitPosition = 7
        ComHandleId = 0
        ComSignalEndianness = BIG_ENDIAN
        ComSignalInitValue = 0
        ComSignalType = UINT8
        ComBitSize = 8
        ComNotification = Rte_COMCbk_RxSig_can0_0
        ComTimeout = 0.005
        ComFirstTimeout = 0.005
        ComSystemTemplateSystemSignalRef = ISignalToIPduMapping_001
      TxSig_can0_0 (ComSignal):
        ComBitPosition = 7
        ComHandleId = 1
        ComSignalEndianness = BIG_ENDIAN
        ComSignalInitValue = 0
        ComSignalType = UINT8
        ComTransferProperty = TRIGGERED
        ComBitSize = 8
        ComNotification = Rte_COMCbk_TxSig_can0_0
        ComSystemTemplateSystemSignalRef = ISignalToIPduMapping_002
      ComTimeBase: ComGwTimeBase=0, ComRxTimeBase=0.005, ComTxTimeBase=0.005
    ComGeneral:
      ComConfigurationUseDet = 0
      ComEnableMDTForCyclicTransmission = 1
      ComRetryFailedTransmitRequests = 0
      ComSupportedIPduGroups = 1
      ComVersionInfoApi = 0
      ComTriggerTransmitApi = 1
  module config ComM: definition=/QINeS/ComM
    ComMConfigSet
      ComMChannel0 (ComMChannel): ComMBusType=COMM_BUS_TYPE_CAN, ComMChannelId=0, ComMFullCommRequestNotificationEnabled=0, ComMMainFunctionPeriod=10
        ComMNetworkManagement: ComMNmVariant=LIGHT, ComMNmLightTimeout=1000
        ComMUserPerChannel: ComMUserChannel=CanPhysicalChannel_SR000
      CanPhysicalChannel_SR000 (ComMUser): ComMUserIdentifier=0
    ComMGeneral: ComMDevErrorDetect=0, ComMSynchronousWakeUp=1, ComMTMinFullComModeDuration=5000
  module config PduR: definition=/AUTOSAR/EcucDefs/PduR
    PduRGeneral: PduRDevErrorDetect=0, PduRVersionInfoApi=0, PduRZeroCostOperation=1
    PduRRoutingTables: PduRConfigurationId=0
      PduRRoutingTable_0 (PduRRoutingTable)
        PduRRoutingPath_can0 (PduRRoutingPath)
          PduRDestPdu_can0 (PduRDestPdu): PduRDestPduHandleId=0, PduRTpThreshold=1, PduRDestPduRef=Pdu_Rx_can0
          Pdu_can0_Src (PduRSrcPdu): PduRSourcePduHandleId=0, PduRSrcPduRef=Pdu_Tx_can0

AUTOSAR XML (schema 4-2-2)
package /QINeS
  ecuc definition collection AUTOSARParameterDefinition: module=Ea
  module definition Ea [0..1]: refined-module-def=Ea, variants pre-compile  # Configuration of the Ea (EEPROM Abstraction) module. / Eaモジュールのコンフィグレーション。 | The module shall abstract from the device specific addressing scheme and segmentation and provide the upper layers with a virtual addressing scheme and segmentation as well as a 'virtually' unlimited number of erase cycles.
    container EaBlockConfiguration [1..65536]  # Configuration of block specific parameters for the EEPROM abstraction module. / Eaブロックコンフィグレーション。 EEPROMアブストラクションモジュールのためのブロック特有パラメータのコンフィグレーション。
      integer EaBlockNumber: 1..65534, scope=ECU, set at pre-compile, symbolic-name-value=true  # Block identifier (handle). / ブロックID。 | 0x0000 and 0xFFFF shall not be used for block numbers (see EA006). Range: min = 2^NVM_DATASET_SELECTION_BITS max = 0xFFFF -2^NVM_DATASET_SELECTION_BITS Note: Depending on the number of bits set aside for dataset selection several other block numbers shall also be left out to ease implementation.
      integer EaBlockSize: 1..65535, scope=ECU, set at pre-compile  # Size of a logical block in bytes. / 論理ブロックサイズ（バイト）。
      boolean EaImmediateData: scope=ECU, set at pre-compile, default-value=false  # Marker for high priority data. / 即時データ 高い優先度データのためのマーカー。 | true: Block contains immediate data. false: Block does not contain immediate data.
      integer EaNumberOfWriteCycles: 1..4294967295, set at pre-compile  # Number of write cycles required for this block. / ライトサイクル 本ブロックに必要なライトサイクル数。
      symbolic name reference EaDeviceIndex: set at pre-compile, destination=EepGeneral  # Reference to the device this block is stored in. / デバイスインデックス。
    container EaGeneral  # General configuration of the EEPROM abstraction module. This container lists block independent configuration parameters. / 抽象化されたEEPROMモジュールのジェネラルコンフィグレーション。
      boolean EaDevErrorDetect: set at pre-compile, default-value=false  # Switches the Default Error Tracer (Det) detection and notification ON or OFF. / 開発エラー検出の有効/無効スイッチ。 TRUE：有効 FALSE：無効 | * true: enabled (ON). * false: disabled (OFF).
      float EaMainFunctionPeriod: 0.001..4294967.295, scope=ECU, set at pre-compile  # The period between successive calls to the main function in seconds.
      function name EaNvmJobEndNotification: multiplicity set at pre-compile, set at pre-compile, default-value=NvM_JobEndNotification  # Mapped to the job end notification routine provided by the upper layer module (NvM_JobEndNotification). / NvM_JobEndNotification()関数名。
      function name EaNvmJobErrorNotification: multiplicity set at pre-compile, set at pre-compile, default-value=NvM_JobErrorNotification  # Mapped to the job error notification routine provided by the upper layer module (NvM_JobErrorNotification). / NvM_JobErrorNotification()関数名。
      boolean EaPollingMode: set at pre-compile, default-value=false  # Pre-processor switch to enable and disable the polling mode for this module. / ポーリングモードの有効/無効スイッチ。 TRUE：有効 FALSE：無効 | true: Polling mode enabled, callback functions (provided to EEP module) disabled. false: Polling mode disabled, callback functions (provided to EEP module) enabled.
      boolean EaSetModeSupported: set at pre-compile, default-value=false  # Compile switch to enable / disable the function Ea_SetMode. / SetMode機能の有効/無効スイッチ。 TRUE：有効 FALSE：無効
      boolean EaVersionInfoApi: set at pre-compile, default-value=false  # Pre-processor switch to enable / disable the API to read out the modules version information. / モジュールバージョン情報APIの有効/無効スイッチ。 TRUE：有効 FALSE：無効 | true: Version info API enabled. false: Version info API disabled.
      integer EaVirtualPageSize: 0..65535, set at pre-compile  # The size in bytes to which logical blocks shall be aligned. / 仮想ページサイズ。 論理ブロックはバイト単位に整列しなければならない。 MAX=65535 MIN=0
      integer EA_Q_NUM_OF_EA_BLOCK_CONFIGURATION: 1..65536, set at pre-compile, origin=QINeS, default-value=1  # - / EaBlockConfigurationコンテナの要素数を設定する。
      boolean EA_Q_PUBLISHEDINFORMATIONTYPE_ENABLED: set at pre-compile, origin=QINeS, default-value=false  # - / EaPublishedInformationコンテナを生成するかしないかを決める。 TRUE：生成する FALSE：生成しない
    container EaPublishedInformation  # Additional published parameters not covered by CommonPublishedInformation container. / 公開情報 CommonPublishedInformationコンテナでカバーされない追加一般パラメータ。 | Note that these parameters do not have any configuration class setting, since they are published information.
      integer EaBlockOverhead: 0..65535, set at published-information  # Management overhead per logical block in bytes. / ブロックオーバーヘッド。 | Note: If the management overhead depends on the block size or block location a formula has to be provided that allows the configurator to calculate the management overhead correctly.
      integer EaPageOverhead: 0..65535, set at published-information  # Management overhead per page in bytes. / ページオーバーヘッド ページの管理オーバーヘッド。 | Note: If the management overhead depends on the block size or block location a formula has to be provided that allows the configurator to calculate the management overhead correctly.
    container EaDeviceFunction [1..*]  # - / 複数ドライバ機能 複数のドライバが設定されている場合に、特定のドライバを指定する情報を記載。
      function name EepCancel: multiplicity set at pre-compile, origin=QINeS, set at pre-compile  # -
      function name EepCompare: multiplicity set at pre-compile, origin=QINeS, set at pre-compile  # -
      function name EepErase: multiplicity set at pre-compile, origin=QINeS, set at pre-compile  # -
      function name EepGetJobResult: multiplicity set at pre-compile, origin=QINeS, set at pre-compile  # -
      function name EepRead: multiplicity set at pre-compile, origin=QINeS, set at pre-compile  # -
      function name EepSetMode: multiplicity set at pre-compile, origin=QINeS, set at pre-compile  # -
      function name EepWrite: multiplicity set at pre-compile, origin=QINeS, set at pre-compile  # -

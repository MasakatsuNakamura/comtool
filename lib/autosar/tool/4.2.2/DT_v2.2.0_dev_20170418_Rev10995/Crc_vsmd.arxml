AUTOSAR XML (schema 4-2-2)
package /QINeS
  ecuc definition collection AUTOSARParameterDefinition: module=Crc
  module definition Crc [0..1]: refined-module-def=Crc, variants pre-compile  # Configuration of the Crc (Crc routines) module. / CRCモジュールのコンフィグレーション。
    container CrcGeneral  # General configuration of CRC module / CRCモジュールのジェネラルコンフィグレーション。
      enumeration Crc16Mode [0..1]: {CRC_16_HARDWARE, CRC_16_RUNTIME, CRC_16_TABLE}, multiplicity set at pre-compile, set at pre-compile  # Switch to select one of the available CRC 16-bit (CCITT) calculation methods / CRC16ビット（CCITT）の計算方法を指定する。 定義なし：CRC16ビット計算を無効 CRC_16_TABLE：テーブル計算(デフォルト) CRC_16_RUNTIME：実行時計算 CRC_16_HARDWARE：ハードウェア計算 ※非サポート
      enumeration Crc32Mode [0..1]: {CRC_32_HARDWARE, CRC_32_RUNTIME, CRC_32_TABLE}, multiplicity set at pre-compile, set at pre-compile  # Switch to select one of the available CRC 32-bit (IEEE-802.3 CRC32 Ethernet Standard) calculation methods / CRC32ビット（IEEE-802.3 CRC32イーサネット規格）の計算方法を指定する。 定義なし：CRC32ビット計算を無効 CRC_32_TABLE：テーブル計算(デフォルト) CRC_32_RUNTIME：実行時計算 CRC_32_HARDWARE：ハードウェア計算 ※非サポート
      enumeration Crc32P4Mode [0..1]: {CRC_32P4_HARDWARE, CRC_32P4_RUNTIME, CRC_32P4_TABLE}, multiplicity set at pre-compile, set at pre-compile  # Switch to select one of the available CRC 32-bit E2E Profile 4 calculation methods.
      enumeration Crc8H2FMode [0..1]: {CRC_8H2F_HARDWARE, CRC_8H2F_RUNTIME, CRC_8H2F_TABLE}, multiplicity set at pre-compile, set at pre-compile  # Switch to select one of the available CRC 8-bit (2Fh polynomial) calculation methods / CRC8ビット(多項式=2Fh）の計算方法を指定する。 定義なし：CRC8ビット(多項式=2Fh）計算を無効 CRC_8H2F_TABLE：テーブル計算(デフォルト) CRC_8H2F_RUNTIME：実行時計算 CRC_8H2F_HARDWARE：ハードウェア計算 ※非サポート
      enumeration Crc8Mode [0..1]: {CRC_8_HARDWARE, CRC_8_RUNTIME, CRC_8_TABLE}, multiplicity set at pre-compile, set at pre-compile  # Switch to select one of the available CRC 8-bit (SAE J1850) calculation methods / CRC8ビット（SAE J1850）の計算方法を指定する。 定義なし：CRC8ビット（SAE J1850）を無効 CRC_8_TABLE：テーブル計算(デフォルト) CRC_8_RUNTIME：実行時計算 CRC_8_HARDWARE：ハードウェア計算を使用 ※非サポート
      boolean CrcDevErrorDetect: set at pre-compile, origin=QINeS, default-value=false  # 開発エラー検出の有効/無効スイッチ。 TRUE：開発時エラー検出および通知を有効 FALSE：開発時エラー検出および通知を無効
      boolean CrcQLengthErrorDetect: set at pre-compile, origin=QINeS, default-value=false  # データ長エラー検出の有効/無効スイッチ。 TRUE：データ長エラー検出および通知を有効 FALSE：データ長エラー検出および通知を無効
      integer CrcQMaxLength: 0..65535, set at pre-compile, origin=QINeS, default-value=1024
      boolean CrcVersionInfoApi: set at pre-compile, default-value=false  # Crc_GetVersionInfo()関数の有効/無効スイッチ。 TRUE：Crc_GetVersionInfo関数を有効 FALSE：Crc_GetVersionInfo関数を無効

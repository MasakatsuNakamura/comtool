AUTOSAR XML (schema 4-2-2)
package /QINeS
  ecuc definition collection AUTOSARParameterDefinition: module=Nm
  module definition Nm [0..1]: refined-module-def=Nm, variants link-time/pre-compile  # The Generic Network Management Interface module / Nmモジュールのコンフィグレーション。
    container NmChannelConfig [1..*]  # This container contains the configuration (parameters) of the bus channel(s). The channel parameter shall be harmonized within the whole communication stack. / チャネルの設定のコンテナ。チャネルのパラメータはComスタック全体で整合性が取れていること。
      boolean NmActiveCoordinator: multiplicity set at pre-compile, set at pre-compile  # This parameter indicates whether a NM channel - part of a Nm Coordination cluster - will be coordinated actively (NmActiveCoordinator = TRUE) or passively (NmActiveCoordinator = FALSE). / ActiveNMコーディネータとして動作させるかの選択。 TRUE：アクティブ FALSE：パッシブ
      boolean NmChannelSleepMaster: set at link in variant link-time / pre-compile in variant pre-compile  # This parameter shall be set to indicate if the sleep of this network can be absolutely decided by the local node only and that no other nodes can oppose that decision. / 強制的にネットワークをシャットダウンに出来るマスターとして動作させるかの選択。 | If this parameter is set to TRUE, the Nm shall assume that the channel is always ready to go to sleep and that no calls to Nm_RemoteSleepIndication or Nm_RemoteSleepCancellation will be made from the <BusNm> representing this channel. If this parameter is set to FALSE, the Nm shall not assume that the network is ready to sleep until a call has been made to Nm_RemoteSleepCancellation.
      integer NmCoordClusterIndex: 0..255, multiplicity set at link in variant link-time / pre-compile in variant pre-compile, set at link in variant link-time / pre-compile in variant pre-compile  # If this parameter is undefined for a channel, the corresponding bus does not belong to an NM coordination cluster. / クラスターID。定義されていない場合、クラスタに所属しないためNmの機能が利用不可。
      boolean NmStateReportEnabled: set at pre-compile, default-value=false  # Specifies if the NMS shall be set for the corresponding network. / 対応したネットワークのNMSを指定。 | false: No NMS shall be set true: The NMS shall be set
      boolean NmSynchronizingNetwork: set at link in variant link-time / pre-compile in variant pre-compile, default-value=false  # If this parameter is true, then this network is a synchronizing network for the NM coordination cluster which it belongs to. The network is expected to call Nm_SynchronizationPoint() at regular intervals. / 所属しているクラスタの同期ネットワークであるかを選択。 TRUE時、Nm_SynchronizationPoint関数を定期間隔でコールする。
      symbolic name reference NmComMChannelRef: set at link in variant link-time / pre-compile in variant pre-compile, destination=ComMChannel  # Reference to the corresponding ComM Channel. / ComM Channelへの参照。
      symbolic name reference NmStateReportSignalRef: multiplicity set at pre-compile, set at pre-compile, destination=ComSignal  # Reference to the signal for setting the NMS by calling Com_SendSignal for the respective channel. / 個々のチャンネルのためにCom_SendSignalを呼んでNMSを設定するためのシグナルの参照。
      choice container NmBusType
        container NmGenericBusNmConfig [0..0]
          string NmGenericBusNmPrefix: set at link in variant link-time / pre-compile in variant pre-compile  # The prefix which identifies the generic <BusNm>. This will be used to determine the API name to be called by Nm for the provided interfaces of the <BusNm>. This string will used for the module prefix before the "_" character in the API call name. / AUTOSARで定義されている&lt;BusNm&gt;以外の&lt;BusNm&gt;を使用する場合に、その接頭辞を指定。
          float NmGenericBusNmShutdownTime: 0..Inf, set at link in variant link-time / pre-compile in variant pre-compile  # This parameter shall be | used to calculate shutdown delay time.
        container NmStandardBusNmConfig [0..1]
          integer NmBusNmShutdownTime: 0..4294967295, multiplicity set at link in variant link-time / pre-compile in variant pre-compile, origin=QINeS, set at link in variant link-time / pre-compile in variant pre-compile  # -
          enumeration NmStandardBusType: {NM_BUSNM_CANNM, NM_BUSNM_LINNM}, set at link in variant link-time / pre-compile in variant pre-compile  # Identifies the bus type of the channel for standard AUTOSAR <BusNm>s and is used to determine which set of API calls to be called by Nm for the <BusNm>s. / AUTOSAR標準&lt;BusNm&gt;のチャンネルバスタイプを識別する。 Nmが呼び出す&lt;BusNm&gt;のAPIセットを決定するために使用される。 | Note: The Ethernet bus' NM is UdpNm !
    container NmGlobalConfig  # This container contains all global configuration parameters of the Nm Interface. / Nm全体の設定を行うためのコンテナ。
      boolean NmQUsedBusCan: scope=ECU, origin=QINeS, set at pre-compile  # - / CanNmを使用するための有効/無効。
      boolean NmQUsedBusFr: scope=ECU, origin=QINeS, set at pre-compile  # - / 未使用
      boolean NmQUsedBusLin: scope=ECU, origin=QINeS, set at pre-compile  # - / LinNmを使用する。
      boolean NmQUsedBusUdp: scope=ECU, origin=QINeS, set at pre-compile  # - / 未使用
      container NmGlobalConstants
        integer NmNumberOfChannels: 1..255, set at pre-compile  # Number of NM channels allowed within one ECU. / 1つのECUで許容されるNMチャネル数。
      container NmGlobalFeatures
        boolean NmBusSynchronizationEnabled: set at pre-compile, default-value=false  # Pre-processor switch for enabling bus synchronization support of the <BusNm>s. This feature is required for NM Coordinator nodes only. / &lt;BusNm&gt;の同期をサポート。
        function name NmCarWakeUpCallout: multiplicity set at link in variant link-time / pre-compile in variant pre-compile, set at link in variant link-time / pre-compile in variant pre-compile, default-value=NULL  # Name of the callout function to be called if Nm_CarWakeUpIndication() is called. If this parameter is not configured, the NmIf will call BswM_CarWakeUpIndication.
        boolean NmCarWakeUpRxEnabled: set at link in variant link-time / pre-compile in variant pre-compile, default-value=false  # Enables or disables CWU detection. / CWUの検出の有効/無効。 | FALSE - CarWakeUp not supported TRUE - CarWakeUp supported
        boolean NmComControlEnabled: set at pre-compile, default-value=false  # Pre-processor switch for enabling the Communication Control support. / Communication Controlをサポート可能にするためのプリプロセッサスイッチ。
        boolean NmComUserDataSupport: set at pre-compile, default-value=false  # Enable/Disable setting of NMUserData via SW-C. If NmComUserDataSupport is enabled the API Nm_SetUserData shall not be available. / SW-C経由でのNMUserDataの有効無効。 NmComUserDataSupportが有効になっている場合は、 API Nm_SetUserDataは利用できない。
        boolean NmCoordinatorSupportEnabled: set at pre-compile, default-value=false  # Pre-processor switch for enabling NM Coordinator support. / NMコーディネータ機能の有効/無効。
        boolean NmCoordinatorSyncSupport: set at link in variant link-time / pre-compile in variant pre-compile, default-value=false  # Enables/disables the coordinator synchronisation support. / Nm_CoordReadyToSleepIndication関数の有効/無効の選択。
        float NmGlobalCoordinatorTime: 0..4294967.295, multiplicity set at pre-compile, set at pre-compile, default-value=0  # This parameter defines the maximum shutdown time of a connected and coordinated NM-Cluster. / クラスタにおける協調シャットダウンの最大時間を指定。[sec]単位（小数第三位まで入力可）。 | Note:This includes nested connections.
        boolean NmNodeDetectionEnabled: set at pre-compile, default-value=false  # Pre-processor switch for enabling the Node Detection feature. / ノード検知機能の有効/無効。
        boolean NmNodeIdEnabled: set at pre-compile, default-value=false  # Pre-processor switch for enabling transmission of the source node identifier in NM messages. / NMメッセージ中の送信元識別機能の有効/無効。
        boolean NmPassiveModeEnabled: set at pre-compile, default-value=false  # Pre-processor switch for enabling support of Passive Mode of the <BusNm>s. / &lt;BusNm&gt;のPassiveモードの有効/無効の選択。
        boolean NmPduRxIndicationEnabled: set at pre-compile, default-value=false  # Pre-processor switch for enabling the PDU Rx Indication. / PDUの受信通知の有効/無効。
        boolean NmRemoteSleepIndEnabled: set at pre-compile, default-value=false  # Pre-processor switch for enabling Remote Sleep Indication support. This feature is required for a Gateway or Nm Coordinator functionality. / Remote Sleep Indicationサポートの有効/無効。
        boolean NmRepeatMsgIndEnabled: set at pre-compile, default-value=false  # Pre-processor switch for enabling the Repeat Message Bit Indication. / 「リピートメッセージビット」の有効/無効。
        boolean NmStateChangeIndEnabled: set at pre-compile, default-value=false  # Pre-processor switch for enabling the Network Management state change notification. / &lt;BusNm&gt;の状態の変化通知の有効/無効。
        boolean NmUserDataEnabled: set at pre-compile, default-value=false  # Pre-processor switch for enabling User Data support. / ユーザデータの有効/無効。
      container NmGlobalProperties
        float NmCycletimeMainFunction: 0..4294967.295, multiplicity set at link in variant link-time / pre-compile in variant pre-compile, set at link in variant link-time / pre-compile in variant pre-compile  # The period between successive calls to the Main Function of the NM Interface in seconds. / Nm_MainFunctionがコールされる周期。[sec]単位（小数第三位まで入力可）。
        boolean NmDevErrorDetect: set at pre-compile, default-value=false  # Switches the Default Error Tracer (Det) detection and notification ON or OFF. / 開発時エラー検出の有効/無効。 | * true: enabled (ON). * false: disabled (OFF).
        boolean NmVersionInfoApi: set at pre-compile, default-value=false  # Pre-processor switch for enabling Version Info API support. / バージョン情報取得の有効/無効。
    container NmClusterConfig [0..1]  # -
      integer NmClusterCoreRefPerNwChPtr [1..255]: 0..255, origin=QINeS, set at pre-compile, default-value=0  # -
      integer NmClusterQCoreMaster: 0..255, origin=QINeS, set at pre-compile, default-value=0  # -
      container NmClusterFuncPtr [2..255]
        enumeration NmClusterCoreChoices: {NMCLUSTER_Q_CORETYPE_TO_MASTER, NMCLUSTER_Q_CORETYPE_TO_SATTELITE}, origin=QINeS, set at pre-compile, default-value=NMCLUSTER_Q_CORETYPE_TO_MASTER  # -
        choice container NmClusterFuncKind
          container NmClusterQM2SFunc [0..1]  # -
            container BusNmSync  # -
              container CanNmSync [0..255]  # -
                function name CanNmGetState: multiplicity set at pre-compile, origin=QINeS, set at pre-compile, default-value=NULL  # -
                function name CanNmNetworkRelease: multiplicity set at pre-compile, origin=QINeS, set at pre-compile, default-value=NULL  # -
                function name CanNmNetworkRequest: multiplicity set at pre-compile, origin=QINeS, set at pre-compile, default-value=NULL  # -
                function name CanNmPassiveStartUp: multiplicity set at pre-compile, origin=QINeS, set at pre-compile, default-value=NULL  # -
                function name CanNmRequestBusSynchronization: multiplicity set at pre-compile, origin=QINeS, set at pre-compile, default-value=NULL  # -
                reference NmClusterTaskTypeRef: multiplicity set at pre-compile, origin=QINeS, set at pre-compile, destination=OsTask  # -
            container ComMAsync  # -
              function name ComMNmBusSleepMode: multiplicity set at pre-compile, origin=QINeS, set at pre-compile, default-value=NULL  # -
              function name ComMNmNetworkMode: multiplicity set at pre-compile, origin=QINeS, set at pre-compile, default-value=NULL  # -
              function name ComMNmNetworkStartIndication: multiplicity set at pre-compile, origin=QINeS, set at pre-compile, default-value=NULL  # -
              function name ComMNmPrepareBusSleepMode: multiplicity set at pre-compile, origin=QINeS, set at pre-compile, default-value=NULL  # -
              function name ComMNmRestartIndication: multiplicity set at pre-compile, origin=QINeS, set at pre-compile, default-value=NULL  # -
          container NmClusterQS2MFunc [0..1]  # -
            container NmAsync  # -
              function name NmBusSleepMode: multiplicity set at pre-compile, origin=QINeS, set at pre-compile, default-value=NULL  # -
              function name NmCoordReadyToSleepIndication: multiplicity set at pre-compile, origin=QINeS, set at pre-compile, default-value=NULL  # -
              function name NmNetworkMode: multiplicity set at pre-compile, origin=QINeS, set at pre-compile, default-value=NULL  # -
              function name NmNetworkStartIndication: multiplicity set at pre-compile, origin=QINeS, set at pre-compile, default-value=NULL  # -
              function name NmPrepareBusSleepMode: multiplicity set at pre-compile, origin=QINeS, set at pre-compile, default-value=NULL  # -
              function name NmRemoteSleepCancellation: multiplicity set at pre-compile, origin=QINeS, set at pre-compile, default-value=NULL  # -
              function name NmRemoteSleepIndication: multiplicity set at pre-compile, origin=QINeS, set at pre-compile, default-value=NULL  # -
            container NmSync  # -
              function name NmGetState: multiplicity set at pre-compile, origin=QINeS, set at pre-compile, default-value=NULL  # -
              function name NmNetworkRelease: multiplicity set at pre-compile, origin=QINeS, set at pre-compile, default-value=NULL  # -
              function name NmNetworkRequest: multiplicity set at pre-compile, origin=QINeS, set at pre-compile, default-value=NULL  # -
              function name NmPassiveStartUp: multiplicity set at pre-compile, origin=QINeS, set at pre-compile, default-value=NULL  # -
              reference NmClusterTaskTypeRef [0..255]: multiplicity set at pre-compile, origin=QINeS, set at pre-compile, destination=OsTask  # -

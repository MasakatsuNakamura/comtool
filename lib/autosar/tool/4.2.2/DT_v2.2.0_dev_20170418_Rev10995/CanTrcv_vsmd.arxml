AUTOSAR XML (schema 4-2-2)
package /QINeS
  ecuc definition collection AUTOSARParameterDefinition: module=CanTrcv
  module definition CanTrcv [0..*]: refined-module-def=CanTrcv, post-build-variant-support=true, variants post-build/pre-compile  # Configuration of the CanTrcv (CAN Transceiver driver) module. / CanTrcvモジュールのコンフィグレーション。
    container CanTrcvConfigSet  # This container contains the configuration parameters and sub containers of the AUTOSAR WdgM module. / Canトランシーバ用のコンフィグレーションセット。
      integer CanTrcvSPICommRetries [0..0]: 0..255, post-build-variant-value=true, set at post-build in variant post-build / pre-compile in variant pre-compile, default-value=0  # Indicates the maximum number of communication retries in case of a failed SPI communication (applies both to timed out communication and to errors/NACK in the response data). / SPI通信の最大リトライ数。 | If configured value is '0', no retry is allowed (communication is expected to succeed at first try).
      integer CanTrcvSPICommTimeout [0..0]: 0..100, post-build-variant-value=true, set at post-build in variant post-build / pre-compile in variant pre-compile, default-value=0  # Indicates the maximum time allowed to the CanTrcv for replying (either positively or negatively) to a SPI command. / SPIコマンドに応答する最大時間。 | Timeout is configured in milliseconds. Timeout value of '0' means that no specific timeout is to be used by CanTrcv and the communication is executed at the best of the SPI HW capacity.
      container CanTrcvChannel [1..255]  # Container gives CAN transceiver driver information about a single CAN / チャネル情報への参照データ。 | transceiver (channel).
        integer CanTrcvChannelId: 0..254, scope=ECU, set at pre-compile, symbolic-name-value=true  # Unique identifier of the CAN Transceiver Channel. / チャネルに割り当てるID。(0..254)
        boolean CanTrcvChannelUsed: set at pre-compile, default-value=true  # Shall the related CAN transceiver channel be used? / 該当するトランシーバチャネルを使用する／しないを指定する。現状未使用。
        boolean CanTrcvControlsPowerSupply: set at pre-compile, default-value=false  # Is ECU power supply controlled by this transceiver? / このトランシーバがECUの電源供給を制御する／しないを制御する。現状未使用。 | TRUE = Controlled by transceiver. FALSE = Not controlled by transceiver.
        boolean CanTrcvHwPnSupport: set at pre-compile, default-value=false  # Indicates whether the HW supports the selective wake-up function / TRUE：パーシャルネットワーク機能を有効にする 未サポート FALSE：パーシャルネットワーク機能を無効にする 現状未使用。 | TRUE = Selective wakeup feature is supported by the transceiver FALSE = Selective wakeup functionality is not available in transceiver
        enumeration CanTrcvInitState: {CANTRCV_Q_TRANSCEIVER_STATE_NORMAL, CANTRCV_Q_TRANSCEIVER_STATE_STANDBY}, set at pre-compile, default-value=CANTRCV_Q_TRANSCEIVER_STATE_NORMAL  # State of CAN transceiver after call to CanTrcv_Init. / チャネルモードの初期値を設定する。 CANTRCV_Q_TRANSCEIVER_STATE_NORMAL：NORMAL CANTRCV_Q_TRANSCEIVER_STATE_STANDBY：STANDBY
        integer CanTrcvMaxBaudrate: 0..1000, set at pre-compile  # Max baudrate for transceiver hardware type. Only used for validation purposes. Value shall be configured by configuration tool based on / ハードウェアのボーレート最大値。 現状未使用。 | transceiver hardware type.
        boolean CanTrcvWakeupByBusUsed [0..1]: multiplicity set at pre-compile, set at pre-compile, default-value=false  # Is wake up by bus supported? If CAN transceiver hardware does not support wake up by bus value is always FALSE. If CAN transceiver hardware supports wake up by bus value is TRUE or FALSE depending whether it is used or not. / バスからの起動をサポートするか。 CANトランシーバのハードウェアがバスからの起動をサポートしない場合、FALSEを指定する。 CANトランシーバのハードウェアがバスからの起動をサポートする場合、この機能を使用する／しないをTRUE／FALSEで設定する。 TRUE：使用する FALSE：使用しない | TRUE = Is used. FALSE = Is not used.
        reference CanTrcvIcuChannelRef [0..0]: multiplicity set at pre-compile, set at pre-compile, destination=IcuChannel  # Reference to the IcuChannel to enable/disable the interrupts | for wakeups.
        reference CanTrcvWakeupSourceRef [0..1]: scope=ECU, multiplicity set at pre-compile, set at pre-compile, destination=EcuMWakeupSource  # Reference to a wakeup source in the EcuM configuration. / EcuMコンフィグレーション内の起動ソースへの参照を設定する。 CanTrcvWakeupByBusUsedをtrueに設定している場合に、本設定が必要となる。 | This reference is only needed if CanTrcvWakeupByBusUsed is true.
        symbolic name reference CanTrcvPorWakeupSourceRef [0..0]: scope=ECU, multiplicity set at pre-compile, set at pre-compile, destination=EcuMWakeupSource  # Symbolic name reference to specify the wakeup sources that should be used in the calls to EcuM_SetWakeupEvent as specified in [SWS_CanTrcv_00183] and [SWS_CanTrcv_00184]. | This reference is mandatory if the HW supports POR or SYSERR flags
        symbolic name reference CanTrcvSyserrWakeupSourceRef [0..0]: scope=ECU, multiplicity set at pre-compile, set at pre-compile, destination=EcuMWakeupSource  # Symbolic name reference to specify the wakeup sources that should be used in the calls to EcuM_SetWakeupEvent as specified in [SWS_CanTrcv_00183] and [SWS_CanTrcv_00184] | This reference is mandatory if the HW supports POR or SYSERR flags
        choice container CanTrcvAccess  # Container gives CanTrcv Driver information about access to a single CAN transceiver. / チャネルが扱うDioモジュールへのアクセス情報への参照データ。
          container CanTrcvDioAccess  # Container gives CAN transceiver driver information about accessing ports and port pins. In addition relation between CAN transceiver hardware pin names and Dio port access information is given. / アクセスポートやポートピンへに関する情報。 加えて、CANトランシーバハードウェアピン名とDIOポートアクセスの関連情報が与えられる。 | If a CAN transceiver hardware has no Dio interface, there is no instance of this container.
            container CanTrcvDioChannelAccess  # Container gives DIO channel access by single Can transceiver channel. / Dioモジュールのチャネル情報。
              string CanTrcvHardwareInterfaceName [0..0]: set at pre-compile  # CAN transceiver hardware interface name. It is typically the name of a pin. From a Dio point of view it is either a port, a single channel or a channel group. Depending on this fact either / 以下のシンボリックネームを入力すること。 ・DIOチャネル ・DIOポート ・DIOチャネルグループ | CANTRCV_DIO_PORT_SYMBOLIC_NAME or CANTRCV_DIO_CHANNEL_SYMBOLIC_NAME or CANTRCV_DIO_CHANNEL_GROUP_SYMBOLIC_NAME shall reference a Dio configuration. The CAN transceiver driver implementation description shall list up this name for the appropriate CAN transceiver hardware.
              choice reference CanTrcvDioSymNameRef: set at pre-compile, destination=[DioChannel, DioChannelGroup, DioPort]  # Choice Reference to a DIO Port, DIO Channel or DIO Channel Group. This reference replaces the CANTRCV_DIO_PORT_SYM_NAME, CANTRCV_DIO_CHANNEL_SYM_NAME and CANTRCV_DIO_GROUP_SYM_NAME references in the Can Trcv SWS. / Dioのチャネル情報への参照データ。(0..65535)
          container CanTrcvSpiAccess [0..0]  # Container gives CAN transceiver driver information about accessing Spi. If a CAN transceiver hardware has no Spi interface, there is no instance of this container.
            container CanTrcvSpiSequence [0..0]  # Container gives CAN transceiver driver information about one SPI sequence. / 未使用 | One SPI sequence used by CAN transceiver driver is in exclusive use for it. No other driver is allowed to access this sequence. CAN transceiver driver may use one sequence to access n CAN transceiver hardwares chips of the same type or n sequences are used to access one single CAN transceiver hardware chip. If a CAN transceiver hardware has no SPI interface, there is no instance of this container.
              boolean CanTrcvSpiAccessSynchronous [0..0]: multiplicity set at pre-compile, set at pre-compile, default-value=false  # This parameter is used to define whether the access to the Spi sequence is synchronous or asynchronous. / 未使用 | true: SPI access is synchronous. false: SPI access is asynchronous.
              symbolic name reference CanTrcvSpiSequenceName [0..0]: multiplicity set at pre-compile, set at pre-compile, destination=SpiSequence  # Reference to a Spi sequence configuration container. / 未使用
        container CanTrcvDemEventParameterRefs [0..0]  # Container for the references to DemEventParameter elements which shall be invoked using the API Dem_ReportErrorStatus in case the corresponding error occurs. The EventId is taken from the referenced DemEventParameter's DemEventId value.
          reference CANTRCV_E_BUS_ERROR [0..0]: scope=ECU, multiplicity set at pre-compile, set at pre-compile, destination=DemEventParameter  # Reference to the DemEventParameter which shall be issued when bus error has occurred.
        container CanTrcvPartialNetwork [0..0]  # Container gives CAN transceiver driver information about the configuration of Partial Networking functionality. / 未使用
          integer CanTrcvBaudRate [0..0]: 0..1000, post-build-variant-value=true, set at post-build in variant post-build / pre-compile in variant pre-compile  # Indicates the CAN Bus communication baud rate in kbps. / 未使用
          boolean CanTrcvBusErrFlag [0..0]: post-build-variant-value=true, set at post-build in variant post-build / pre-compile in variant pre-compile, default-value=false  # Indicates if the Bus Error (BUSERR) flag is managed by the BSW. This flag is set if a bus failure is detected by the transceiver. / 未使用 | TRUE = Supported by transceiver and managed by BSW. FALSE = Not managed by BSW.
          boolean CanTrcvPnCanIdIsExtended [0..0]: post-build-variant-value=true, set at post-build in variant post-build / pre-compile in variant pre-compile, default-value=false  # Indicates whether extended or standard ID is used. / 未使用 | TRUE = Extended Can identifier is used. FALSE = Standard Can identifier is used
          boolean CanTrcvPnEnabled [0..0]: post-build-variant-value=true, set at post-build in variant post-build / pre-compile in variant pre-compile, default-value=false  # Indicates whether the selective wake-up function is enabled or disabled in HW. / 未使用 | TRUE = Selective wakeup feature is enabled in the transceiver hardware FALSE = Selective wakeup feature is disabled in the transceiver hardware
          integer CanTrcvPnFrameCanId [0..0]: 0..4294967295, post-build-variant-value=true, set at post-build in variant post-build / pre-compile in variant pre-compile  # CAN ID of the Wake-up Frame (WUF). / 未使用
          integer CanTrcvPnFrameCanIdMask [0..0]: 0..4294967295, post-build-variant-value=true, set at post-build in variant post-build / pre-compile in variant pre-compile  # ID Mask for the selective activation of the transceiver. It is used to enableFrame Wake-up (WUF) on a group of IDs. / 未使用
          integer CanTrcvPnFrameDlc [0..0]: 0..8, post-build-variant-value=true, set at post-build in variant post-build / pre-compile in variant pre-compile  # Data Length of the Wake-up Frame (WUF). / 未使用
          boolean CanTrcvPowerOnFlag [0..0]: post-build-variant-value=true, set at post-build in variant post-build / pre-compile in variant pre-compile, default-value=false  # Description: Indicates if the Power On Reset (POR) flag is available and is managed by the transceiver. / 未使用 | TRUE = Supported by Hardware. FALSE = Not supported by Hardware
          container CanTrcvPnFrameDataMaskSpec [0..0]  # Defines data payload mask to be used on the received payload in order to determine if the transceiver must be woken up by the received Wake-up Frame (WUF). / 未使用
            integer CanTrcvPnFrameDataMask [0..0]: 0..255, post-build-variant-value=true, set at post-build in variant post-build / pre-compile in variant pre-compile  # Defines the n byte (Byte0 = LSB) of the data payload mask to be used on the received payload in order to determine if the transceiver must be woken up by the received Wake-up Frame (WUF). / 未使用
            integer CanTrcvPnFrameDataMaskIndex [0..0]: 0..7, post-build-variant-value=true, set at post-build in variant post-build / pre-compile in variant pre-compile  # holds the position n in frame of the mask-part / 未使用
    container CanTrcvGeneral  # Container gives CAN transceiver driver basic information. / Canトランシーバドライバの基本情報。
      boolean CanTrcvDevErrorDetect: set at pre-compile  # Switches the Default Error Tracer (Det) detection and notification ON or OFF. / TRUE：開発時エラーが有効になる FALSE：開発時エラーが無効になる | * true: enabled (ON). * false: disabled (OFF). If enabled, #define CANTRCV_DEV _ERROR_DETECT ON shall be generated. If disabled, #define CANTRCV_DEV_ERROR _DETECT OFF shall be generated. Define shall be part of file CanTrcv_Cfg.h.
      boolean CanTrcvGetVersionInfo: set at pre-compile, default-value=false  # Switches version information API on and off. If switched off, function need not be present in compiled code. / バージョン情報取得APIの有効／無効を指定する。 バージョン情報取得APIは未サポートのため無効固定である。
      integer CanTrcvIndex [0..0]: 0..255, set at pre-compile  # Specifies the InstanceId of this module instance. If only one instance is present it shall have the Id 0.
      float CanTrcvMainFunctionDiagnosticsPeriod [0..0]: 0.001..65.535, multiplicity set at pre-compile, set at pre-compile  # This parameter describes the period for cyclic call to CanTrcv_MainFunctionDiagnostics. Unit is seconds.
      float CanTrcvMainFunctionPeriod [0..0]: 0.001..65.535, multiplicity set at pre-compile, set at pre-compile  # This parameter describes the period for cyclic call to CanTrcv_MainFunction. Unit is seconds.
      enumeration CanTrcvTimerType [0..0]: {None, Timer_1us16bit}, multiplicity set at pre-compile, set at pre-compile  # Type of the Time Service Predefined Timer.
      float CanTrcvWaitTime [0..0]: 0..2.55E-4, multiplicity set at pre-compile, set at pre-compile  # Wait time for transceiver state changes in seconds.
      integer CanTrcvWaitCount: 0..4294967295, set at pre-compile, default-value=0  # Indicates the number of wait states to change the transceiver operation mode. Transceiver hardware may need wait states for some transitions. / CanTrcvの状態変化の待ち時間をTick単位で指定すること。
      enumeration CanTrcvWakeUpSupport: {CANTRCV_WAKEUP_NOT_SUPPORTED}, set at pre-compile, default-value=CANTRCV_WAKEUP_NOT_SUPPORTED  # Informs whether wake up is supported by polling or not supported. In case no / ウェイクアップ機能は未サポートのため、1 (CANTRCV_WAKEUP_NOT_SUPPORTED) 固定である。 | wake up is supported by the hardware, setting has to be NOT_SUPPORTED. Only in the case of wake up supported by polling, function CanTrcv_MainFunction has to be present and to be invoked by the scheduler.

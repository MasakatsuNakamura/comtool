AUTOSAR XML (schema 4-2-2)
package /QINeS
  ecuc definition collection AUTOSARParameterDefinition: module=Gpt
  module definition Gpt [0..1]: refined-module-def=Gpt, post-build-variant-support=true, variants post-build/pre-compile  # Configuration of the Gpt (General Purpose Timer) module. / Gptモジュールのコンフィグレーション。(MCAL ダミー)
    container GptChannelConfigSet  # This container is the base of a Configuration Set which contains the configured GPT channels. This way, different configuration sets can be defined for post-build process. / GPTチャネルのコンフィグレーションセット。
      container GptChannelConfiguration [1..*]  # Configuration of an individual GPT channel. / Gptドライバのチャンネル・コンフィグレーションの構造体ポインタ。
        integer GptChannelId: 0..4294967295, scope=ECU, set at pre-compile, symbolic-name-value=true  # Channel Id of the GPT channel. This value will be assigned to the symbolic name derived of the GptChannelConfiguration container short name. / GPTチャネル番号のチャネル番号ID。
        enumeration GptChannelMode: {GPT_CH_MODE_CONTINUOUS, GPT_CH_MODE_ONESHOT}, scope=ECU, post-build-variant-value=true, set at post-build in variant post-build / pre-compile in variant pre-compile  # Specifies the behavior of the timer channel after the target time is reached. / タイマチャネル番号の動作モード。
        float GptChannelTickFrequency: 0..Inf, scope=ECU, post-build-variant-value=true, set at post-build in variant post-build / pre-compile in variant pre-compile  # Specifies the tick frequency of the timer channel in Hz. / タイマチャネルの周波数（Hz）。
        integer GptChannelTickValueMax: 0..18446744073709551615, scope=ECU, post-build-variant-value=true, set at post-build in variant post-build / pre-compile in variant pre-compile  # Maximum value in ticks, the timer channel is able to count. With the next tick, the timer rolls over to zero. / タイマーチャネル番号がカウント可能なtick単位の最大値。この次のtickではタイマーは0にロールオーバーされる。
        boolean GptEnableWakeup: post-build-variant-value=true, set at post-build in variant post-build / pre-compile in variant pre-compile  # Enables wakeup capability of MCU for a channel. / チャネルのMCUに対するウェイクアップ機能の有効化。
        function name GptNotification [0..1]: multiplicity set at post-build in variant post-build / pre-compile in variant pre-compile, post-build-variant-multiplicity=true, post-build-variant-value=true, set at post-build in variant post-build / pre-compile in variant pre-compile  # Function pointer to callback function (for non-wakeup notification) / Callback関数（非ウェイクアップ通知用）への関数ポインタ。
        reference GptChannelClkSrcRef: post-build-variant-value=true, set at post-build in variant post-build / pre-compile in variant pre-compile, destination=GptClockReferencePoint  # Reference to the GptClockReferencePoint from which the channel / GptClockReferencePointへの参照（チャネルが使用するクロックの選択）。 | clock is derived.
        container GptWakeupConfiguration [0..1]  # Function pointer to callback function (for wakeup notification). / ウェイクアップ設定のコンテナ。
          symbolic name reference GptWakeupSourceRef: post-build-variant-value=true, set at post-build in variant post-build / pre-compile in variant pre-compile, destination=EcuMWakeupSource  # In case the wakeup-capability is true this value is transmitted to the Ecu State Manager. / ウェイクアップ機能が真である場合には、この値はEcuMステート・マネージャに送信される。実装タイプ：EcuM_WakeupSourceTypeを参照。 | Implementation Type: reference to EcuM_WakeupSourceType
    container GptConfigurationOfOptApiServices  # This container contains all configuration switches for configuring optional API services of the GPT driver. / このコンテナは、GPTドライバのオプションのAPIサービスを設定するためのすべてのコンフィグレーションスイッチが含まれる。
      boolean GptDeinitApi: set at pre-compile  # Adds / removes the service Gpt_DeInit() from the code. / API Gpt_Deinitを有効/無効にするプリプロセッサスイッチ。
      boolean GptEnableDisableNotificationApi: set at pre-compile  # Adds / removes the services Gpt_EnableNotification() and Gpt_DisableNotification from the code. / API Gpt_EnableNotification()を有効/無効にするプリプロセッサスイッチ。
      boolean GptTimeElapsedApi: set at pre-compile  # Adds / removes the service Gpt_GetTimeElapsed() from the code / API Gpt_GetTimeElapsed()を有効/無効にするプリプロセッサスイッチ。
      boolean GptTimeRemainingApi: set at pre-compile  # Adds / removes the service Gpt_GetTimeRemaining() from the code. / API Gpt_GetTimeRemaining()を有効/無効にするプリプロセッサスイッチ。
      boolean GptVersionInfoApi: set at pre-compile  # Adds / removes the service Gpt_GetVersionInfo() from the code. / API Gpt_GetVeraionInnfo()を有効/無効にするプリプロセッサスイッチ。
      boolean GptWakeupFunctionalityApi: set at pre-compile  # Adds / removes the services Gpt_SetMode(), Gpt_EnableWakeup() Gpt_DisableWakeup() and Gpt_CheckWakeup() from the code. / API Gpt_SetMode() ,Gpt_EnableWakeup(), Gpt_DisableWakeup(), Gpt_CheckWakeup() を有効/無効にするプリプロセッサスイッチ。
    container GptDriverConfiguration  # This container contains the module-wide configuration (parameters) of the GPT Driver / Gptドライバのコンフィグレーション（パラメータ）を含むコンテナ。
      boolean GptDevErrorDetect: set at pre-compile  # Switches the Default Error Tracer (Det) detection and notification ON or OFF. / 開発エラー検出と報告を有効にするためのプリプロセッサスイッチ。 | * true: enabled (ON). * false: disabled (OFF).
      boolean GptPredefTimer100us32bitEnable: scope=ECU, set at pre-compile  # Enables/disables the GPT Predef Timer 100µs32bit. / 100μsec32bitタイマの有効／無効にするためのプリプロセッサスイッチ。
      enumeration GptPredefTimer1usEnablingGrade: {GPT_PREDEF_TIMER_1US_16BIT_ENABLED, GPT_PREDEF_TIMER_1US_16_24BIT_ENABLED, GPT_PREDEF_TIMER_1US_16_24_32BIT_ENABLED, GPT_PREDEF_TIMER_1US_DISABLED}, scope=ECU, set at pre-compile  # Specifies the grade of enabling the GPT Predef Timers with 1µs tick duration. / 1μsecのプレデフタイマを有効/無効にするためのプリプロセッサスイッチ。
      boolean GptReportWakeupSource: set at pre-compile  # Enables/Disables wakeup source reporting. / Wakeup報告を有効にするためのプリプロセッサスイッチ。
      container GptClockReferencePoint [1..*]  # This container contains a parameter, which represents a reference to a container of the type McuClockReferencePoint (defined in module MCU). / このコンテナはタイプMcuClockReferencePoint（モジュールMCUで定義されている）のコンテナへの参照を表すパラメータが含まれている。 | A container is needed to support multiple clock references (hardware dependent).
        reference GptClockReference: set at pre-compile, destination=McuClockReferencePoint  # Reference to a container of the type McuClockReferencePoint, to select an input clock. / McuClockReferencePointコンテナへの参照（入力クロックの選択）。 | The configuration editor for the GPT module can support the integrator by only allowing a selection of those clock reference points that can be connected physically to the GPT hardware peripheral. The desired frequency (desired by GPT) has to be the same as the selected and provided frequency of the MCU configuration. This has to be checked automatically.

AUTOSAR XML (schema 4-2-2)
package /QINeS
  ecuc definition collection AUTOSARParameterDefinition: module=LinTrcv
  module definition LinTrcv [0..*]: refined-module-def=LinTrcv, variants pre-compile  # Configuration of LIN Transceiver Driver module / LinTrcvモジュールのコンフィグレーション。
    container LinTrcvChannel [1..*]  # Container gives LIN transceiver driver information about a single LIN transceiver channel. Any LIN transceiver driver has such LIN transceiver channels. / LinTrcvのチャネル毎の設定パラメータを定義する。
      integer LinTrcvChannelId: 0..255, set at pre-compile, symbolic-name-value=true  # Unique identifier of the LIN Transceiver Channel. / LinTrcvのIDを指定すること。(0..255)
      boolean LinTrcvChannelUsed [0..0]: set at pre-compile, default-value=true  # Shall the related LIN transceiver channel be used? / 未使用 | True: Is used False Is not used
      enumeration LinTrcvInitState: {LINTRCV_TRCV_MODE_NORMAL, LINTRCV_TRCV_MODE_SLEEP}, set at pre-compile, default-value=LINTRCV_TRCV_MODE_NORMAL  # State of LIN transceiver after call to LinTrcv_Init. / LinTrcv_Init関数が実行された後のLinTrcvの状態を以下から指定すること。 ・LINTRCV_TRCV_MODE_NORMAL(0)：LINトランシーバが使用可能である状態 ・LINTRCV_TRCV_MODE_SLEEP (2)：LINトランシーバが使用不可である状態
      boolean LinTrcvWakeupByBusUsed [0..0]: set at pre-compile, default-value=false  # Is wake up by bus supported? If LIN transceiver hardware does not support wake up by bus value is always FALSE. If LIN transceiver hardware supports wake up by bus value is TRUE or FALSE depending whether it is used or not. / 未使用 | TRUE = Is used. FALSE = Is not used.
      symbolic name reference LinTrcvIcuChannelRef [0..0]: scope=ECU, multiplicity set at pre-compile, set at pre-compile, destination=IcuChannel  # Reference to the IcuChannel to enable/disable the interrupts for wakeups. / 未使用
      symbolic name reference LinTrcvWakeupSourceRef [0..0]: scope=ECU, multiplicity set at pre-compile, set at pre-compile, destination=EcuMWakeupSource  # Reference to a wakeup source in the EcuM configuration. This reference is only needed if LinTrcvWakeupByBusUsed is true. Implementation Type: reference to EcuM_WakeupSourceType. / 未使用
      choice container LinTrcvAccess [0..1]  # Container gives LIN transceiver driver access about a single LIN transceiver channel. / チャネルが扱うDioモジュールへのアクセス情報への参照データを指定すること。
        container LinTrcvDioAccess [0..1]  # Container gives LIN transceiver driver information about accessing ports and port pins. In addition relation between LIN transceiver hardware pin names and Dio port access information is given. If a LIN transceiver hardware has no Dio interface, there is no instance of this container. / コンテナはLINトランシーバドライバにアクセスポートとポートピンに関する情報を与える。加えてLINトランシーバハードウェアのピン名とDioポートアクセス情報の関係が与えられる。もしLINトランシーバハードウェアがDioインターフェースを持たない場合、このコンテナのインスタンスは無い。
          container LinTrcvDioChannelAccess [1..*]  # Container gives DIO channel access by single Lin transceiver channel.
            string LinTrcvHardwareInterfaceName [0..0]: set at pre-compile  # LIN transceiver hardware interface name. It is typically the name of a pin. From a Dio point of view it is either a port, a single channel or a channel group. Depending on this fact either LINTRCV_DIO_PORT_SYMBOLIC_NAME or LINTRCV_DIO_CHANNEL_SYMBOLIC_NAME or LINTRCV_DIO_CHANNEL_GROUP_SYMBOLIC_NAME shall reference a Dio configuration. The LIN transceiver driver implementation description shall list up this name for the appropriate LIN transceiver hardware. / 未使用
            choice reference LinTrcvDioSymRefName: set at pre-compile, destination=[DioChannel, DioChannelGroup, DioPort]  # Choice Reference to a DIO Port, DIO Channel or DIO Channel Group. This reference replaces the LINTRCV_DIO_PORT_SYM_NAME, LINTRCV_DIO_CHANNEL_SYM_NAME and LINTRCV_DIO_GROUP_SYM_NAME references in the Lin Trcv SWS. / Dioのチャネル情報への参照データ。
        container LinTrcvSpiSequence [0..0]  # Container gives LIN transceiver driver information about one SPI sequence. / 未使用 | One SPI sequence used by LIN transceiver driver is in exclusive use for it. No other driver is allowed to access this sequence. LIN transceiver driver may use one sequence to access n LIN transceiver hardwares chips of the same type or n sequences are used to access one single LIN transceiver hardware chip. If a LIN transceiver hardware has no SPI interface, there is no instance of this container.
          symbolic name reference LinTrcvSpiSequenceName [0..0]: set at pre-compile, destination=SpiSequence  # Reference to a Spi sequence configuration container. / 未使用
    container LinTrcvGeneral  # Container gives LIN transceiver driver basic information. / LINトランシーバドライバの基本情報。
      boolean LinTrcvDevErrorDetect: set at pre-compile  # Switches the Default Error Tracer (Det) detection and notification ON or OFF. / TRUE：開発時エラーを有効にする FALSE：開発時エラーを無効にする | * true: enabled (ON). * false: disabled (OFF). If switched on, #define LINTRCV_DEV_ERROR_DETECT ON shall be generated. If switched off, #define LINTRCV_DEV_ERROR_DETECT OFF shall be generated. Define shall be part of file LinTrcv_Cfg.h.
      boolean LinTrcvGetVersionInfo: set at pre-compile, default-value=false  # Switches version information API on and off. If switched off, function need not be present in compiled code. / TRUE：バージョン取得関数を有効にする FALSE：バージョン取得関数を無効にする | True: Is used False: Is not used
      integer LinTrcvIndex [0..0]: 0..255, set at pre-compile  # Specifies the InstanceId of this module instance. If only one instance is present it shall have the Id 0. / 未使用
      enumeration LinTrcvTimerType [0..0]: {None, Timer_1us16bit}, multiplicity set at pre-compile, set at pre-compile  # Type of the Time Service Predefined Timer.
      integer LinTrcvWaitCount: 0..4294967295, set at pre-compile, origin=QINeS, default-value=0  # Wait count for transceiver state changes. / LinTrcvの状態変化の待ち時間をTick単位で指定すること。
      float LinTrcvWaitTime [0..0]: 0..2.55E-4, multiplicity set at pre-compile, set at pre-compile  # Wait time for transceiver state changes in seconds.
      boolean LinTrcvWakeUpSupport [0..0]: set at pre-compile  # Informs whether wake up is supported or not. In case wake up is not supported by LIN transceiver hardware the setting shall be false. The wake up ability may be switched on or off for each channel of one LIN transceiver by LinTrcvWakeupSourceRef. / 未使用 | True: Is used False: Is not used

AUTOSAR XML (schema 4-2-2)
package /QINeS
  ecuc definition collection AUTOSARParameterDefinition: module=LinSM
  module definition LinSM [0..1]: refined-module-def=LinSM, post-build-variant-support=true, variants link-time/post-build/pre-compile  # Configuration of the Lin State Manager module. / LinSMモジュールのコンフィグレーション。
    container LinSMConfigSet  # This container contains the configuration parameters and sub containers of the AUTOSAR LinSm module. / LinSMモジュールのコンフィグレーション。
      integer LinSMModeRequestRepetitionMax: 0..255, post-build-variant-value=true, set at link in variant link-time / post-build in variant post-build / pre-compile in variant pre-compile  # Specifies the maximal amount of mode request repetitions without a respective mode indication from the LinIf module until the LinSM module reports a Default Error to the Det and tries to go back to no communication.
      container LinSMChannel [1..*]  # Describes each LIN channel the LinSM is connected to. / LINチャネル情報のコンフィグレーション。
        float LinSMConfirmationTimeout: 0..4294967.295, set at link in variant link-time+post-build / pre-compile in variant pre-compile  # Timeout in seconds for the goto sleep, wakeup and schedule request calls to LinIf. The timeout must be longer than a goto-sleep command on the bus (i.e. it is bit rate dependent). / スリープ移行要求、ウェイクアップ実行要求、スケジュール要求を行う際のタイムアウトまでのタイマー。[sec]単位（小数第三位まで入力可）。
        boolean LinSMTransceiverPassiveMode [0..1]: multiplicity set at link in variant link-time+post-build / pre-compile in variant pre-compile, set at link in variant link-time+post-build / pre-compile in variant pre-compile, default-value=false  # Selects STANDBY (true) or SLEEP (false) transceiver mode when entering LINSM_NO_COM. / LINSM_NO_COMに遷移した際のトランシーバーモードの状態。
        symbolic name reference LinSMComMNetworkHandleRef: set at link in variant link-time+post-build / pre-compile in variant pre-compile, destination=ComMChannel  # Unique handle to identify one certain LIN network. Reference to one of the network handles configured in the ComM. / LINチャネルを参照するためのID。
        container LinSMSchedule [1..*]  # The schedule references to a schedule that is located in the LinIf configuration. Moreover, the PDU groups are located in the COM configuration. Note that there are two references to PDU groups. The simple reason is that a PDU group is only allowed to contain one direction (TX or RX). / スケジュール情報を設定するコンフィグレーション。
          integer LinSMScheduleIndex [0..1]: 0..255, set at pre-compile, symbolic-name-value=true  # This index parameter can be used by the BswM as a SymbolicNameReference target. The LinSM just forwards the request from the BswM to LinIf. Note that the value of the LinSMScheduleIndex shall be the same as the value from the LinIf. / BswMのから受け取ったスケジュールを参照するためのID。
          symbolic name reference LinSMScheduleIndexRef: post-build-variant-value=true, set at link in variant link-time / post-build in variant post-build / pre-compile in variant pre-compile, destination=LinIfScheduleTable  # Reference to a schedule table in the LinIf configuration / LinIfのスケジュールを参照するためのスケジュールのID。
    container LinSMGeneral  # This container contains general parameters of LIN State Manager module. / LINSMの一般的なコンフィグレーション。
      boolean LinSMDevErrorDetect: set at pre-compile  # Switches the Default Error Tracer (Det) detection and notification ON or OFF. / 実行時エラー検知・通知機能のオンオフ。 | * true: enabled (ON). * false: disabled (OFF).
      float LinSMMainProcessingPeriod: 0.001..0.255, set at pre-compile  # Fixed period that the MainFunction shall be called. / MainFunctionが呼び出される固定周期。[sec]単位（小数第三位まで入力可）。
      boolean LinSMVersionInfoApi: set at pre-compile  # Switches the LinSM_GetVersionInfo function ON or OFF. / バージョン情報取得API使用有無。

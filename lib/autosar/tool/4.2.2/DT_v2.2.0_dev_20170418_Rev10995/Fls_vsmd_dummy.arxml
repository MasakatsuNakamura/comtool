AUTOSAR XML (schema 4-2-2)
package /QINeS
  ecuc definition collection AUTOSARParameterDefinition: module=Fls
  module definition Fls [0..*]: refined-module-def=Fls, post-build-variant-support=true, variants post-build/pre-compile  # Configuration of the Fls (internal or external flash driver) module. / Flsモジュールのコンフィグレーション。(MCAL ダミー) | Its multiplicity describes the number of flash drivers present, so there will be one container for each flash driver in the ECUC template. When no flash driver is present then the multiplicity is 0.
    container FlsConfigSet  # Container for runtime configuration parameters of the flash driver. / フラッシュドライバ実行時のコンフィグレーションパラメータコンテナ。 | Implementation Type: Fls_ConfigType.
      integer FlsAcErase: 0..4294967295, post-build-variant-value=true, set at post-build in variant post-build / pre-compile in variant pre-compile  # Address offset in RAM to which the erase flash access code shall be loaded. / イレースフラッシュアクセスコードをロードするためのRAMのアドレスオフセット。 イレースフラッシュアクセスコードのポインタ機能として使用される。 | Used as function pointer to access the erase flash access code.
      integer FlsAcWrite: 0..4294967295, post-build-variant-value=true, set at post-build in variant post-build / pre-compile in variant pre-compile  # Address offset in RAM to which the write flash access code shall be loaded. / ライトフラッシュアクセスコードをロードするためのRAMのアドレスオフセット。 イレースフラッシュアクセスコードのポインタ機能として使用される。 | Used as function pointer to access the write flash access code.
      float FlsCallCycle: 0..1, post-build-variant-value=true, set at post-build in variant post-build / pre-compile in variant pre-compile  # Cycle time of calls of the flash driver's main function (in seconds). / Fls_MainFunction()関数を呼び出す周期(ミリ秒)。
      enumeration FlsDefaultMode: {MEMIF_MODE_FAST, MEMIF_MODE_SLOW}, post-build-variant-value=true, set at post-build in variant post-build / pre-compile in variant pre-compile, default-value=MEMIF_MODE_SLOW  # This parameter is the default FLS device mode after initialization. / 初期化後のデフォルトフラッシュデバイスモード。 | Implementation Type: MemIf_ModeType.
      function name FlsJobEndNotification [0..1]: multiplicity set at post-build in variant post-build / pre-compile in variant pre-compile, post-build-variant-multiplicity=true, post-build-variant-value=true, set at post-build in variant post-build / pre-compile in variant pre-compile  # Mapped to the job end notification routine provided by some upper layer module, typically the Fee module. / 上位レイヤ（Feeモジュール）へ提供するジョブ終了通知ルーチン。
      function name FlsJobErrorNotification [0..1]: multiplicity set at post-build in variant post-build / pre-compile in variant pre-compile, post-build-variant-multiplicity=true, post-build-variant-value=true, set at post-build in variant post-build / pre-compile in variant pre-compile  # Mapped to the job error notification routine provided by some upper layer module, typically the Fee module. / 上位レイヤ（Feeモジュール）ヘ提供するエラー通知ルーチン。
      integer FlsMaxReadFastMode: 0..4294967295, post-build-variant-value=true, set at post-build in variant post-build / pre-compile in variant pre-compile  # The maximum number of bytes to read or compare in one cycle of the flash driver's job processing function in fast mode. / 高速モード時のFlsドライバの1サイクルにおける最大リードバイト数。
      integer FlsMaxReadNormalMode: 0..4294967295, post-build-variant-value=true, set at post-build in variant post-build / pre-compile in variant pre-compile  # The maximum number of bytes to read or compare in one cycle of the flash driver's job processing function in normal mode. / 通常モード時のFlsドライバの1サイクルにおける最大リードバイト数。
      integer FlsMaxWriteFastMode: 0..4294967295, post-build-variant-value=true, set at post-build in variant post-build / pre-compile in variant pre-compile  # The maximum number of bytes to write in one cycle of the flash driver's job processing function in fast mode. / 高速モード時のFlsドライバの1サイクルにおける最大ライトバイト数。
      integer FlsMaxWriteNormalMode: 0..4294967295, post-build-variant-value=true, set at post-build in variant post-build / pre-compile in variant pre-compile  # The maximum number of bytes to write in one cycle of the flash driver's job processing function in normal mode. / 通常モード時のFlsドライバの1サイクルにおける最大ライトバイト数。
      integer FlsProtection: 0..4294967295, post-build-variant-value=true, set at post-build in variant post-build / pre-compile in variant pre-compile  # Erase/write protection settings. Only relevant if supported by hardware. / ハードウェアでサポートされている場合のみ、イレース/ライトの保護設定。
      container FlsDemEventParameterRefs [0..1]  # Container for the references to DemEventParameter elements which shall be invoked using the Dem_ReportErrorStatus API in case the corresponding error occurs. The EventId is taken from the referenced DemEventParameter's DemEventId value. The standardized errors are provided in the container and can be extended by vendor specific error references. Tags: atp.Status=obsolete, atp.StatusComment=This container is set to obsolete and will be removed in release 4.3., atp.StatusRevisionBegin=4.2.2 / エラー発生時にDem_ReportErrorStatus関数を使うためのDemEventParameter要素の参照群。
        symbolic name reference FLS_E_COMPARE_FAILED [0..1]: multiplicity set at post-build in variant post-build / pre-compile in variant pre-compile, post-build-variant-multiplicity=true, post-build-variant-value=true, set at post-build in variant post-build / pre-compile in variant pre-compile, destination=DemEventParameter  # Reference to the DemEventParameter which shall be issued when the error "Flash compare failed (HW)" has occurred. Tags: atp.Status=obsolete, atp.StatusComment=This reference is set to obsolete and will be removed in release 4.3., atp.StatusRevisionBegin=4.2.2 / DemEventParameterに報告する”フラシュデータの（HW)コンペアエラー発生”時のパラメータ。
        symbolic name reference FLS_E_ERASE_FAILED [0..1]: multiplicity set at post-build in variant post-build / pre-compile in variant pre-compile, post-build-variant-multiplicity=true, post-build-variant-value=true, set at post-build in variant post-build / pre-compile in variant pre-compile, destination=DemEventParameter  # Reference to the DemEventParameter which shall be issued when the error "Flash erase failed (HW)" has occurred. Tags: atp.Status=obsolete, atp.StatusComment=This reference is set to obsolete and will be removed in release 4.3., atp.StatusRevisionBegin=4.2.2 / DemEventParameterに報告する”フラシュデータの（HW)イレースエラー発生”時のパラメータ。
        symbolic name reference FLS_E_READ_FAILED [0..1]: multiplicity set at post-build in variant post-build / pre-compile in variant pre-compile, post-build-variant-multiplicity=true, post-build-variant-value=true, set at post-build in variant post-build / pre-compile in variant pre-compile, destination=DemEventParameter  # Reference to the DemEventParameter which shall be issued when the error "Flash read failed (HW)" has occurred. Tags: atp.Status=obsolete, atp.StatusComment=This reference is set to obsolete and will be removed in release 4.3., atp.StatusRevisionBegin=4.2.2 / DemEventParameterに報告する”フラシュデータの（HW)リードエラー発生”時のパラメータ。
        symbolic name reference FLS_E_UNEXPECTED_FLASH_ID [0..1]: multiplicity set at post-build in variant post-build / pre-compile in variant pre-compile, post-build-variant-multiplicity=true, post-build-variant-value=true, set at post-build in variant post-build / pre-compile in variant pre-compile, destination=DemEventParameter  # Reference to the DemEventParameter which shall be issued when the error "Expected hardware ID not matched" has occurred. Tags: atp.Status=obsolete, atp.StatusComment=This reference is set to obsolete and will be removed in release 4.3., atp.StatusRevisionBegin=4.2.2 / DemEventParameterに報告する”フラシュデータのハードウェアID不一致エラー発生”時のパラメータ。
        symbolic name reference FLS_E_WRITE_FAILED [0..1]: multiplicity set at post-build in variant post-build / pre-compile in variant pre-compile, post-build-variant-multiplicity=true, post-build-variant-value=true, set at post-build in variant post-build / pre-compile in variant pre-compile, destination=DemEventParameter  # Reference to the DemEventParameter which shall be issued when the error "Flash write failed (HW)" has occurred. Tags: atp.Status=obsolete, atp.StatusComment=This reference is set to obsolete and will be removed in release 4.3., atp.StatusRevisionBegin=4.2.2 / DemEventParameterに報告する”フラシュデータの（HW)ライトエラー発生”時のパラメータ。
      container FlsExternalDriver [0..1]  # This container is present for external Flash drivers only. Internal Flash drivers do not use the parameter listed in this container, hence its multiplicity is 0 for internal drivers. / 外部フラッシュドライバのためのコンフィグレーションパラメータ。 内部フラッシュドライバはこの群に含まれるパラメータは使用しない。 内部ドライバは多重度0とする。
        symbolic name reference FlsSpiReference [1..*]: multiplicity set at pre-compile, set at pre-compile, destination=SpiSequence  # Reference to SPI sequence (required for external Flash drivers). / SPIシーケンスのリファレンス（外部フラッシュドライバ用）(内蔵フラッシュドライバは0を設定する)。
      container FlsSectorList  # List of flashable sectors and pages. / フラッシュ可能なセクタやページのリスト。
        container FlsSector [1..*]  # Configuration description of a flashable sector / フラッシュ可能なセクタの設定値。
          integer FlsNumberOfSectors: 0..65535, set at pre-compile  # Number of continuous sectors with identical values for FlsSectorSize and / セクタサイズとページサイズに対して同じ値を持つ連続セクタ数。 セクタ開始アドレスは1番目のセクタの開始アドレスを示す。 | FlsPageSize. The parameter FlsSectorStartAddress denotes the start address of the first sector.
          integer FlsPageSize: 0..4294967295, set at pre-compile  # Size of one page of this sector. / セクタの1ページのサイズ。 | Implementation Type: Fls_LengthType.
          integer FlsSectorSize: 0..4294967295, set at pre-compile  # Size of this sector. / セクタのサイズ。 | Implementation Type: Fls_LengthType.
          integer FlsSectorStartaddress: 0..4294967295, set at pre-compile  # Start address of this sector. / 最初のセクタの開始アドレス。 | Implementation Type: Fls_AddressType.
    container FlsGeneral  # Container for general parameters of the flash driver. These parameters are always pre-compile. / フラッシュドライバの全般的なパラメータ群。これらは常にpre-compileである。
      boolean FlsAcLoadOnJobStart: set at pre-compile, default-value=false  # The flash driver shall load the flash access code to RAM whenever an erase or write job is started and unload (overwrite) it after that job has been finished or canceled. / FlashアクセスのためのコードをRAMにロードするか否か。 TRUE：ロードする FALSE：ロードしない | true: Flash access code loaded on job start / unloaded on job end or error. false: Flash access code not loaded to / unloaded from RAM at all.
      integer FlsBaseAddress: 0..4294967295, set at pre-compile  # The flash memory start address (see also SWS_Fls_00208 and SWS_Fls_00209). / Flashメモリの開始アドレス。 | This parameter defines the lower boundary for read / write / erase and compare jobs.
      boolean FlsBlankCheckApi: set at pre-compile, default-value=false  # Compile switch to enable/disable the Fls_BlankCheck function. | true: API supported / function provided. false: API not supported / function not provided
      boolean FlsCancelApi: set at pre-compile  # Compile switch to enable and disable the Fls_Cancel function. / Fls_Cancel()関数を実装するか否か。 TRUE：実装する FALSE：実装しない | true: API supported / function provided. false: API not supported / function not provided
      boolean FlsCompareApi: set at pre-compile  # Compile switch to enable and disable the Fls_Compare function. / Fls_Compare()関数を実装するか否か。 TRUE：実装する FALSE：実装しない | true: API supported / function provided. false: API not supported / function not provided
      boolean FlsDevErrorDetect: set at pre-compile, default-value=true  # Switches the Default Error Tracer (Det) detection and notification ON or OFF. / 開発エラー検出をするか否か。 TRUE：実装する FALSE：実装しない | * true: enabled (ON). * false: disabled (OFF).
      integer FlsDriverIndex: 0..254, scope=ECU, set at pre-compile, symbolic-name-value=true  # Index of the driver, used by FEE. / Feeが使うFlashドライバID。
      boolean FlsGetJobResultApi: set at pre-compile  # Compile switch to enable and disable the Fls_GetJobResult function. / Fls_GetJobResult()関数を実装する否か。 TRUE：実装する FALSE：実装しない | true: API supported / function provided. false: API not supported / function not provided
      boolean FlsGetStatusApi: set at pre-compile  # Compile switch to enable and disable the Fls_GetStatus function. / Fls_GetStatus()関数を実装するか否か。 TRUE：実装する FALSE：実装しない | true: API supported / function provided. false: API not supported / function not provided
      boolean FlsSetModeApi: set at pre-compile  # Compile switch to enable and disable the Fls_SetMode function. / Fls_SetMode()関数を実装するか否か。 TRUE：実装する FALSE：実装しない | true: API supported / function provided. false: API not supported / function not provided
      integer FlsTotalSize: 0..4294967295, set at pre-compile  # The total amount of flash memory in bytes (see also SWS_Fls_00208 and SWS_Fls_00209). / Flashメモリの総バイト数。 | This parameter in conjunction with FLS_BASE_ADDRESS defines the upper boundary for read / write / erase and compare jobs.
      boolean FlsUseInterrupts: set at pre-compile, default-value=false  # Job processing triggered by hardware interrupt. / ハードウェア割り込みによるジョブの起動を使うか否か。 TRUE：使う FALSE：使わない | true: Job processing triggered by interrupt (hardware controlled). false: Job processing not triggered by interrupt (software controlled) or the underlying hardware does not support interrupt mode for flash operations.
      boolean FlsVersionInfoApi: set at pre-compile  # Pre-processor switch to enable / disable the API to read out the modules version information. / Fls_GetVersionInfo()関数を実装するか否か。 TRUE：実装する FALSE：実装しない | true: Version info API enabled. false: Version info API disabled.
    container FlsPublishedInformation  # Additional published parameters not covered by CommonPublishedInformation container. / CommonPublishedInformationコンテナでカバーされていない追加の公開パラメータ。 これらのパラメータは公開情報であるからコンフィグレーションクラス設定を持たない。 | Note that these parameters do not have any configuration class setting, since they are published information.
      integer FlsAcLocationErase: 0..4294967295, set at published-information  # Position in RAM, to which the erase flash access code has to be loaded. / イレースフラッシュアクセスコードをロードするRAMの位置。 | Only relevant if the erase flash access code is not position independent. If this information is not provided it is assumed that the erase flash access code is position independent and that therefore the RAM position can be freely configured.
      integer FlsAcLocationWrite: 0..4294967295, set at published-information  # Position in RAM, to which the write flash access code has to be loaded. / ライトフラッシュアクセスコードをロードするRAMの位置。 | Only relevant if the write flash access code is not position independent. If this information is not provided it is assumed that the write flash access code is position independent and that therefore the RAM position can be freely configured.
      integer FlsAcSizeErase: 0..4294967295, set at published-information  # Number of bytes in RAM needed for the erase flash access code. / イレースフラッシュアクセスコードに必要なRAMのバイト数。
      integer FlsAcSizeWrite: 0..4294967295, set at published-information  # Number of bytes in RAM needed for the write flash access code. / ライトフラッシュアクセスコードに必要なRAMのバイト数。
      float FlsEraseTime: 0..Inf, set at published-information  # Maximum time to erase one complete flash sector. / 1つの完全なフラッシュセクタをイレースするための最大時間。
      integer FlsErasedValue: 0..4294967295, set at published-information  # The contents of an erased flash memory cell. / イレースされたフラッシュメモリセルの内容。
      string FlsExpectedHwId: set at published-information  # Unique identifier of the hardware device that is expected by this driver (the device for which this driver has been implemented). / HWデバイスのID(識別子、文字列)(外部フラッシュドライバ用)。 | Only relevant for external flash drivers.
      integer FlsSpecifiedEraseCycles: 0..4294967295, set at published-information  # Number of erase cycles specified for the flash device (usually given in the device data sheet). / イレースサイクルの数。 | If the number of specified erase cycles depends on the operating environment (temperature, voltage, ...) during reprogramming of the flash device, the minimum number for which a data retention of at least 15 years over the temperature range from -40°C .. +125°C can be guaranteed shall be given. Note: If there are different numbers of specified erase cycles for different flash sectors of the device this parameter has to be extended to a parameter list (similar to the sector list above).
      float FlsWriteTime: 0..Inf, set at published-information  # Maximum time to program one complete flash page. / 1つの完全なフラッシュページをプログラムする(ライト)ための最大時間。

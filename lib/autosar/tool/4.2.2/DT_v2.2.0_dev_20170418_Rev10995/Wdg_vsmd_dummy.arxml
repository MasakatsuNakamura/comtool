AUTOSAR XML (schema 4-2-2)
package /QINeS
  ecuc definition collection AUTOSARParameterDefinition: module=Wdg
  module definition Wdg [0..*]: refined-module-def=Wdg, post-build-variant-support=true, variants link-time/post-build/pre-compile  # Configuration of the Wdg (Watchdog driver) module. / Wdgモジュールのコンフィグレーション。(MCAL ダミー)
    container WdgDemEventParameterRefs [0..1]  # Container for the references to DemEventParameter elements which shall be invoked using the API Dem_ReportErrorStatus in case the corresponding error occurs. The EventId is taken from the referenced DemEventParameter's DemEventId value. / 対応するエラーが発生した場合にAPI Dem_ReportErrorStatusを使用して起動されなければならないDemEventParameterエレメントへの参照用のコンテナ。 EventIdは参照されたDemEventParameterのDemEventId値から取得される。 標準化されたエラーがコンテナ内に提供されており、ベンダー固有のエラーを参照することにより拡張することが可能。 | The standardized errors are provided in the container and can be extended by vendor-specific error references.
      symbolic name reference WDG_E_DISABLE_REJECTED [0..1]: multiplicity set at pre-compile, set at pre-compile, destination=DemEventParameter  # Reference to the DemEventParameter which shall be issued when the error "Initialization or mode switch failed because it would disable the watchdog" has occurred. / WatchdogのOFFモードが無効のため(初期化又はモード変更時）OFFモードへの遷移が出来ないDemエラー。
      symbolic name reference WDG_E_MODE_FAILED [0..1]: multiplicity set at pre-compile, set at pre-compile, destination=DemEventParameter  # Reference to the DemEventParameter which shall be issued when the error "Setting a watchdog mode failed (during initialization or mode switch)" has occurred. / Watchdogのモード遷移ができない(初期化又はモード切り替え)が不正時のDemエラー。
    container WdgGeneral  # All general parameters of the watchdog driver are collected here. / Wdgのジェネラルパラメータのコンテナである。
      boolean WdgDevErrorDetect: set at pre-compile  # Switches the Default Error Tracer (Det) detection and notification ON or OFF. / Devエラー検出有効／無効フラグ。 | * true: enabled (ON). * false: disabled (OFF).
      boolean WdgDisableAllowed: set at pre-compile  # Compile switch to allow / forbid disabling the watchdog driver during runtime. / OFFモード(実行中のwatchdog無効化許可)の有効／無効フラグ。 | True: Disabling the watchdog driver at runtime is allowed. False: Disabling the watchdog driver at runtime is not allowed.
      integer WdgIndex: 0..255, set at pre-compile, symbolic-name-value=true  # Represents the watchdog driver's ID so that it can be referenced by the watchdog interface. / Wdgドライバのインデックス。
      float WdgInitialTimeout: 0..65.535, set at pre-compile  # The initial timeout (sec) for the trigger condition to be initialized during Init function. It shall be not larger than WdgMaxTimeout. / 初期タイムアウト値。
      float WdgMaxTimeout: 0..65.535, set at pre-compile  # The maximum timeout (sec) to which the watchdog trigger condition can be initialized. / 最大タイムアウト値。
      enumeration WdgRunArea: {RAM, ROM}, set at pre-compile  # Represents the watchdog driver execution area is either from ROM(Flash) or RAM as required with the particular microcontroller. / ドライバ実行領域。
      function name WdgTriggerLocation: set at pre-compile  # Location (memory address) of the watchdog trigger routine. / トリガ関数のアドレス。
      boolean WdgVersionInfoApi: set at pre-compile  # Compile switch to enable / disable the version information API / Version Info API有効／無効フラグ。 | * True: API enabled * False: API disabled
    container WdgPublishedInformation  # Container holding all Wdg specific published information parameters / Wdgモジュールの公開情報。
      enumeration WdgTriggerMode: {WDG_BOTH, WDG_TOGGLE, WDG_WINDOW}, set at published-information  # Watchdog trigger mode (toggle/window/both) / トリガーモード。
    container WdgSettingsConfig  # Configuration items for the different watchdog settings, including those for external watchdog hardware. / 外部のハードウェアウォッチドッグを含む、ウォッチドッグの設定項目。 | Note: All postbuild parameters are handled via this container.
      enumeration WdgDefaultMode: {WDGIF_FAST_MODE, WDGIF_OFF_MODE, WDGIF_SLOW_MODE}, post-build-variant-value=true, set at link in variant link-time / post-build in variant post-build / pre-compile in variant pre-compile  # Default mode for watchdog driver initialization. / デフォルトモード。 | ImplementationType: WdgIf_ModeType
      container WdgExternalConfiguration [0..1]  # Configuration items for an external watchdog hardware / 外部のハードウェアウォッチドッグ用の設定項目。
        choice reference WdgExternalContainerRef [0..1]: multiplicity set at link in variant link-time / post-build in variant post-build / pre-compile in variant pre-compile, post-build-variant-multiplicity=true, post-build-variant-value=true, set at link in variant link-time / post-build in variant post-build / pre-compile in variant pre-compile, destination=[DioChannelGroup, SpiSequence]  # Reference to either / 外部コンテナ参照。 -ウオッチドッグハードウェアがDioを介して接続されている場合はDioChannelGroupのコンテナ -ウオッチドッグハードウェアがSpiを介して接続されている場合はSpiSequenceConfigurationのコンテナ | - a DioChannelGroup container in case the hardware watchdog is connected via DIO pins - an SpiSequenceConfiguration container in case the watchdog hardware is accessed via SPI
      container WdgSettingsFast  # Hardware dependent settings for the watchdog driver's "fast" mode. / FAST モード用のハードウェア依存設定のポインタ。
      container WdgSettingsOff  # Hardware dependent settings for the watchdog driver's "off" mode. / OFF モード用のハードウェア依存設定のポインタ。
      container WdgSettingsSlow  # Hardware dependent settings for the watchdog driver's "slow" mode. / SLOW モード用のハードウェア依存設定のポインタ。

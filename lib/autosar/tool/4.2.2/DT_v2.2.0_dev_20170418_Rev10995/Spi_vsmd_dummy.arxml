AUTOSAR XML (schema 4-2-2)
package /QINeS
  ecuc definition collection AUTOSARParameterDefinition: module=Spi
  module definition Spi [0..1]: refined-module-def=Spi, post-build-variant-support=true, variants link-time/post-build/pre-compile  # Configuration of the Spi (Serial Peripheral Interface) module. / Spiモジュールのコンフィグレーション。(MCAL ダミー)
    container SpiDemEventParameterRefs [0..1]  # Container for the references to DemEventParameter elements which shall be invoked using the API Dem_ReportErrorStatus API in case the corresponding error occurs. The EventId is taken from the referenced DemEventParameter's DemEventId value. The standardized errors are provided in the container and can be extended by vendor specific error references. / DemEventParameter 要素への参照コンテナ。
      symbolic name reference SPI_E_HARDWARE_ERROR [0..1]: multiplicity set at pre-compile, set at pre-compile, destination=DemEventParameter  # Reference to configured DEM event to report "Hardware failure". If the reference is not configured the error shall not be reported. / SPIハードウェアのエラーへの参照。
    container SpiDriver  # This container contains the configuration parameters and sub containers of the AUTOSAR Spi module. / SPIドライバインスタンス１つ分のコンフィグレーション。
      integer SpiMaxChannel [0..1]: 0..255, multiplicity set at link in variant link-time / post-build in variant post-build / pre-compile in variant pre-compile, post-build-variant-multiplicity=true, post-build-variant-value=true, set at link in variant link-time / post-build in variant post-build / pre-compile in variant pre-compile  # This parameter contains the number of Channels configured. It will be gathered by tools during the configuration stage. / このパラメータは、構成されたチャネルの数が含まれている。 これは、コンフィグレーション・ステージ中のツールによって収集される。
      integer SpiMaxJob [0..1]: 0..65535, multiplicity set at link in variant link-time / post-build in variant post-build / pre-compile in variant pre-compile, post-build-variant-multiplicity=true, post-build-variant-value=true, set at link in variant link-time / post-build in variant post-build / pre-compile in variant pre-compile  # Total number of Jobs configured. / 設定されたジョブの総数。
      integer SpiMaxSequence [0..1]: 0..255, multiplicity set at link in variant link-time / post-build in variant post-build / pre-compile in variant pre-compile, post-build-variant-multiplicity=true, post-build-variant-value=true, set at link in variant link-time / post-build in variant post-build / pre-compile in variant pre-compile  # Total number of Sequences configured. / 設定されたシーケンスの総数。
      container SpiChannel [1..*]  # All data needed to configure one SPI-channel / チャネルのリスト。
        integer SpiChannelId: 0..255, set at pre-compile, symbolic-name-value=true  # SPI Channel ID, used as parameter in SPI API functions. / チャネルid。
        enumeration SpiChannelType: {EB, IB}, post-build-variant-value=true, set at link in variant link-time / post-build in variant post-build / pre-compile in variant pre-compile  # Buffer usage with EB/IB channel. / チャネルバッファ種別。
        integer SpiDataWidth: 1..32, post-build-variant-value=true, set at link in variant link-time / post-build in variant post-build / pre-compile in variant pre-compile  # This parameter is the width of a transmitted data unit. / 転送データの幅。
        integer SpiDefaultData [0..1]: 0..4294967295, multiplicity set at link in variant link-time / post-build in variant post-build / pre-compile in variant pre-compile, post-build-variant-multiplicity=true, post-build-variant-value=true, set at link in variant link-time / post-build in variant post-build / pre-compile in variant pre-compile  # The default data to be transmitted when (for internal buffer or external buffer) the pointer passed to Spi_WriteIB (for internal buffer) or to Spi_SetupEB (for external buffer) is NULL. / 転送時デフォルトデータ。
        integer SpiEbMaxLength: 0..65535, post-build-variant-value=true, set at link in variant link-time / post-build in variant post-build / pre-compile in variant pre-compile  # This parameter contains the maximum size (number of data elements) of data buffers in case of EB Channels and only. / 外部バッファ使用時の最大サイズ。
        integer SpiIbNBuffers: 0..65535, post-build-variant-value=true, set at link in variant link-time / post-build in variant post-build / pre-compile in variant pre-compile  # This parameter contains the maximum number of data buffers in case of IB Channels and only. / 内部バッファ使用時の最大サイズ。
        enumeration SpiTransferStart: {LSB, MSB}, post-build-variant-value=true, set at link in variant link-time / post-build in variant post-build / pre-compile in variant pre-compile  # This parameter defines the first starting bit for transmission. / 転送開始ビット種別。
      container SpiExternalDevice [1..*]  # The communication settings of an external device. Closely linked to SpiJob. / 外部デバイスとの通信設定。
        float SpiBaudrate: 0..Inf, post-build-variant-value=true, set at link in variant link-time / post-build in variant post-build / pre-compile in variant pre-compile  # This parameter is the communication baudrate - This parameter allows / ボーレート。 Float型ではなくuint32とする。 単位はbps。 | using a range of values, from the point of view of configuration tools, from Hz up to MHz.
        string SpiCsIdentifier: set at pre-compile, symbolic-name-value=true  # This parameter is the symbolic name to identify the Chip Select (CS) allocated to this Job. / このジョブに割り当てられたチップセレクト（CS）を識別するためのシンボル名。
        enumeration SpiCsPolarity: {HIGH, LOW}, post-build-variant-value=true, set at link in variant link-time / post-build in variant post-build / pre-compile in variant pre-compile  # This parameter defines the active polarity of Chip Select. / チップセレクトの極性。
        enumeration SpiCsSelection [0..1]: {CS_VIA_GPIO, CS_VIA_PERIPHERAL_ENGINE}, multiplicity set at link in variant link-time / post-build in variant post-build / pre-compile in variant pre-compile, post-build-variant-multiplicity=true, post-build-variant-value=true, set at link in variant link-time / post-build in variant post-build / pre-compile in variant pre-compile, default-value=CS_VIA_PERIPHERAL_ENGINE  # When the Chip select handling is enabled (see SpiEnableCs), then this parameter specifies if the chip select is handled automatically by Peripheral HW engine or via general purpose IO by Spi driver. / チップセレクトの操作種別。
        enumeration SpiDataShiftEdge: {LEADING, TRAILING}, post-build-variant-value=true, set at link in variant link-time / post-build in variant post-build / pre-compile in variant pre-compile  # This parameter defines the SPI data shift edge. / SPIデータシフトエッジ。
        boolean SpiEnableCs: post-build-variant-value=true, set at link in variant link-time / post-build in variant post-build / pre-compile in variant pre-compile  # This parameter enables or not the Chip Select handling functions. If this parameter is enabled then parameter SpiCsSelection further details the type of chip selection. / チップセレクト機能の許可。
        enumeration SpiHwUnit: {CSIB0, CSIB1, CSIB2, CSIB3}, post-build-variant-value=true, set at link in variant link-time / post-build in variant post-build / pre-compile in variant pre-compile  # This parameter is the symbolic name to identify the HW SPI Hardware / このジョブに割り当てられたHWマイコン周辺機器のID。 | microcontroller peripheral allocated to this Job.
        enumeration SpiShiftClockIdleLevel: {HIGH, LOW}, post-build-variant-value=true, set at link in variant link-time / post-build in variant post-build / pre-compile in variant pre-compile  # This parameter defines the SPI shift clock idle level. / SPIシフトクロックのアイドルレベル。
        float SpiTimeClk2Cs: 0..1E-4, post-build-variant-value=true, set at link in variant link-time / post-build in variant post-build / pre-compile in variant pre-compile  # Timing between clock and chip select (in seconds) - This parameter allows to use a range of values from 0 up to 0.0001 seconds. / クロック-チップセレクト間のタイミング(秒)。 単位は秒ではなくμsec。 MAX=1E-4 MIN=0 | The real configuration-value used in software BSW-SPI is calculated out of this by the generator-tools
      container SpiJob [1..*]  # All data needed to configure one SPI-Job, amongst others the connection between the internal SPI unit and the special settings for an external device is done. / ジョブのリスト。
        enumeration SpiHwUnitSynchronous [0..1]: {ASYNCHRONOUS, SYNCHRONOUS}, multiplicity set at link in variant link-time / post-build in variant post-build / pre-compile in variant pre-compile, post-build-variant-multiplicity=true, post-build-variant-value=true, set at link in variant link-time / post-build in variant post-build / pre-compile in variant pre-compile  # If SpiHwUnitSynchronous is set to "SYNCHRONOUS", the SpiJob uses its containing SpiDriver in a synchronous manner. If it is set to "ASYNCHRONOUS", it uses the driver in an asynchronous way. If the parameter is not set, the SpiChannel uses the driver also in an asynchronous way. / ハードウェアユニットの同期/非同期転送設定。
        function name SpiJobEndNotification [0..1]: multiplicity set at link in variant link-time / post-build in variant post-build / pre-compile in variant pre-compile, post-build-variant-multiplicity=true, post-build-variant-value=true, set at link in variant link-time / post-build in variant post-build / pre-compile in variant pre-compile  # This parameter is a reference to a notification function. / ジョブ終了通知関数。
        integer SpiJobId: 0..65535, set at pre-compile, symbolic-name-value=true  # SPI Job ID, used as parameter in SPI API functions. / ジョブのID。
        integer SpiJobPriority: 0..3, post-build-variant-value=true, set at link in variant link-time / post-build in variant post-build / pre-compile in variant pre-compile  # Priority set accordingly to SPI093: 0, lowest, 3, highest priority / ジョブの優先度。
        reference SpiDeviceAssignment: set at pre-compile, destination=SpiExternalDevice  # Reference to the external device used by this job / ジョブが使用するデバイス情報への参照。
        container SpiChannelList [1..*]  # References to SPI channels and their order within the Job. / SPIチャネルとジョブ内での順序への参照。
          integer SpiChannelIndex: 0..255, post-build-variant-value=true, set at link in variant link-time / post-build in variant post-build / pre-compile in variant pre-compile  # This parameter specifies the order of Channels within the Job. / リストのインデックス。
          reference SpiChannelAssignment: post-build-variant-value=true, set at link in variant link-time / post-build in variant post-build / pre-compile in variant pre-compile, destination=SpiChannel  # A job reference to a SPI channel. / ジョブからチャネルへの参照。
      container SpiSequence [1..*]  # All data needed to configure one SPI-sequence / シーケンスのリスト。
        boolean SpiInterruptibleSequence: post-build-variant-value=true, set at link in variant link-time / post-build in variant post-build / pre-compile in variant pre-compile  # This parameter allows or not this Sequence to be suspended by another one. / シーケンスが、他のシーケンスの割り込みにより中断可能かどうかを表すパラメータ。
        function name SpiSeqEndNotification [0..1]: multiplicity set at link in variant link-time / post-build in variant post-build / pre-compile in variant pre-compile, post-build-variant-multiplicity=true, post-build-variant-value=true, set at link in variant link-time / post-build in variant post-build / pre-compile in variant pre-compile  # This parameter is a reference to a notification function. / シーケンス終了通知関数。
        integer SpiSequenceId: 0..255, scope=ECU, set at pre-compile, symbolic-name-value=true  # SPI Sequence ID, used as parameter in SPI API functions. / シーケンスid。
        reference SpiJobAssignment [1..*]: multiplicity set at link in variant link-time / post-build in variant post-build / pre-compile in variant pre-compile, post-build-variant-multiplicity=true, post-build-variant-value=true, set at link in variant link-time / post-build in variant post-build / pre-compile in variant pre-compile, destination=SpiJob  # A sequence references several jobs, which are executed during a communication sequence / シーケンスから複数のジョブへの参照。
    container SpiGeneral  # General configuration settings for SPI-Handler / Spiドライバのジェネラルコンフィグレーション。
      boolean SpiCancelApi: set at pre-compile  # Switches the Spi_Cancel function ON or OFF. / CancelApiの有効/無効スイッチ。
      integer SpiChannelBuffersAllowed: 0..2, set at pre-compile  # Selects the SPI Handler/Driver Channel Buffers usage allowed and / SPIハンドラ/ドライバのチャネルバッファ使用方法の選択。 | delivered. IB = 0; EB = 1; IB/EB = 2;
      boolean SpiDevErrorDetect: set at pre-compile  # Switches the Default Error Tracer (Det) detection and notification ON or OFF. / 開発エラー検出の有効/無効スイッチ。 | * true: enabled (ON). * false: disabled (OFF).
      boolean SpiHwStatusApi: set at pre-compile  # Switches the Spi_GetHWUnitStatus function ON or OFF. / GetHWUnitStatus の有効/無効スイッチ。
      boolean SpiInterruptibleSeqAllowed: set at pre-compile  # Switches the Interruptible Sequences handling functionality ON or OFF. / 割り込み可能シーケンス処理関数の有効/無効スイッチ。
      integer SpiLevelDelivered: 0..2, set at pre-compile  # Selects the SPI Handler/Driver level of scalable functionality that is / SPIハンドラ/ドライバレベル。 | available and delivered.
      float SpiMainFunctionPeriod [0..1]: 1E-7..1, multiplicity set at pre-compile, set at pre-compile, default-value=0.01  # This parameter defines the cycle time of the function Spi_MainFunction_Handling in seconds. The parameter is not used by the driver it self, but it is used by upper layer.
      boolean SpiSupportConcurrentSyncTransmit: set at pre-compile  # Specifies whether concurrent Spi_SyncTransmit() calls for different sequences shall be configurable. / Spi_SyncTransmit（）同時呼び出しの有効/無効スイッチ。
      string SpiUserCallbackHeaderFile [0..*]: multiplicity set at pre-compile, set at pre-compile  # Header file name which will be included by the Spi. The value of this parameter shall be used as h-char-sequence or q-char-sequence according to ISO C90 section 6.10.2 "source file inclusion". The parameter value MUST NOT represent a path, since ISO C90 does not specify how such a path is treated (i.e., this is implementation defined (and additionally depends on the operating system and the underlying file system)).
      boolean SpiVersionInfoApi: set at pre-compile  # Switches the Spi_GetVersionInfo function ON or OFF. / バージョン情報APIの有効/無効スイッチ。
    container SpiPublishedInformation  # Container holding all SPI specific published information parameters / このコンテナはSPI固有の公開情報パラメータを全て含む。
      integer SpiMaxHwUnit: 0..18446744073709551615, set at published-information  # Number of different SPI hardware microcontroller peripherals (units/busses) available and handled by this SPI Handler/Driver module. / SPI H/Wマイコン周辺機器の数。 （接続された外部デバイスではなくSPIポートの数と解釈する）

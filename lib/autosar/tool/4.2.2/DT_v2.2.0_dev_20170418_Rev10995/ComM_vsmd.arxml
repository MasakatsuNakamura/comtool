AUTOSAR XML (schema 4-2-2)
package /QINeS
  ecuc definition collection AUTOSARParameterDefinition: module=ComM
  module definition ComM [0..1]: refined-module-def=ComM, post-build-variant-support=true, variants post-build/pre-compile  # Configuration of the ComM (Communications Manager) module. / ComMモジュールのコンフィグレーション。
    container ComMConfigSet  # This container contains the configuration parameters and sub containers of the AUTOSAR ComM module. / 多重コンフィグレーションセットのベースコンテナ。
      boolean ComMPncEnabled [0..0]: scope=ECU, multiplicity set at post-build in variant post-build / pre-compile in variant pre-compile, post-build-variant-multiplicity=true, post-build-variant-value=true, set at post-build in variant post-build / pre-compile in variant pre-compile, default-value=false  # Defines whether in this configuration set the partial networking is enabled. / 未使用 | true: Enabled false: Disabled
      container ComMChannel [1..256]  # This container contains the configuration (parameters) of the bus channel(s). The channel parameters shall be harmonized within the whole communication stack. / チャネル毎に設定を定義する構造体。 このコンテナには、バスチャンネル（複数可）の設定（パラメータ）が含まれる。 チャネルパラメータは、通信スタック内の全体で調和されなければならない。
        enumeration ComMBusType: {COMM_BUS_TYPE_CAN, COMM_BUS_TYPE_LIN}, scope=ECU, set at pre-compile  # Identifies the bus type of the channel. / チャンネルのバスタイプを識別する。
        string ComMCDDBusPrefix [0..0]: multiplicity set at pre-compile, set at pre-compile  # Prefix to be used for API calls to CDD.
        integer ComMChannelId: 0..255, scope=ECU, set at pre-compile, symbolic-name-value=true  # Channel identification number of the corresponding channel. / 対応するチャネルのチャネル識別番号。
        boolean ComMFullCommRequestNotificationEnabled: set at pre-compile, default-value=false  # Defines if the optional SenderReceiver Port of Interface ComM_CurrentChannelRequest will be provided for this channel. / フルコム要求状態を管理するかどうかのフラグ。 インターフェース(ComM_CurrentChannelRequest)のオプションポート(Sender/Receiver)をこのチャネルに提供するかどうかを定義する。 TRUE：有効 FALSE：無効 | True means enabled. False means disabled
        float ComMMainFunctionPeriod: 0.001..0.1, scope=ECU, set at pre-compile, default-value=20  # Specifies the period in seconds that the MainFunction has to be triggered with. / MainFunctionの作動期間を指定する。 ComMのスケジューリングは少なくとも通信スタックと同じぐらいの速さになり、0.1secを超過するスケジュールは無効となる。[sec]単位（小数第三位まで入力可）。 | Comment: ComM scheduling shall be at least as fast as the communication stack and a schedule longer than 100ms makes no sense for communication.
        boolean ComMNoCom [0..0]: set at pre-compile, default-value=false  # Not allowed to change state of ComM channel to COMM_SILENT_COMMUNICATION or COMM_FULL_COMMUNICATION. / 未使用 | true: Enabled - Not allowed to switch to Communication Modes above. false: Disabled - Allowed to switch Communication Modes above. Shall be possible to change parameter during runtime with ComM API's. ECU/All channels: ComM_LimitECUToNoComMode(). Separate channels: ComM_LimitChannelToNoComMode().
        boolean ComMNoWakeUpInhibitionNvmStorage [0..0]: set at pre-compile  # If this parameter is set to "true", the NoWakeUp inhibition state of the channel shall be stored (in some implementation specific way) in the block pointed to by ComMGlobalNvmBlockDescriptor.
        boolean ComMNoWakeup [0..0]: set at pre-compile, default-value=false  # Defines if an ECU is not allowed to wake-up the channel. / 未使用 | true: Enabled (not allowed to wake-up)) false: Disabled This is the default/init value of a runtime variable that can be changed during runtime using ComM_PreventWakeUp().
        enumeration ComMPncGatewayType [0..0]: {COMM_GATEWAY_TYPE_ACTIVE, COMM_GATEWAY_TYPE_PASSIVE}, scope=ECU, multiplicity set at pre-compile, set at pre-compile  # Identifies the Partial Network Gateway behaviour of a ComMChannel. / 未使用
        container ComMNetworkManagement  # This container contains the configuration parameters of the networkmanagement. / ネットワーク管理用パラメータ。
          float ComMNmLightTimeout [0..1]: 0..255, multiplicity set at pre-compile, set at pre-compile, default-value=10000  # Defines the timeout (in seconds) after COMM_FULL_COMMUNICATION sub-state COMM_FULL_COM_READY_SLEEP is left. / ComM チャネルモードのサブステート。 「COMM_FULL_COM_READY_SLEEP」から別の状態に遷移したときのタイムアウト時間を指定する。(0..255[sec]) | The range shall be greater than 0.0 and less or equal to 255.0.
          enumeration ComMNmVariant: {FULL, LIGHT, NONE, PASSIVE}, set at pre-compile, default-value=FULL  # Defines the functionality of the networkmanagement. / NetworkManagementの機能を定義する。 | Shall be harmonized with NM configuration.
          boolean ComMPncNmRequest [0..0]: set at pre-compile, default-value=false  # If this parameter equals true then every time a FULL Communication is requested due to a change in the PNC state machine to PNC_REQUESTED Nm shall be called using the API Nm_NetworkRequest. / 未使用
        container ComMUserPerChannel [1..256]  # This container contains a list of identifiers that are needed to refer to a user in the system which is linked to a channel. / このコンテナには、チャネルにリンクされているシステムのユーザを参照が必要とされている識別子のリストが含まれる。
          reference ComMUserChannel: set at pre-compile, destination=ComMUser  # Reference to the ComMUser that corresponds to this channel user. / このチャネルのユーザーに対応するComMUserへの参照。 | ImplementationType: COMM_UserHandleType
      container ComMPnc [0..56]  # This container contains the configuration of the partial network cluster (PNC). / 未使用
        integer ComMPncId: 8..63, scope=ECU, set at pre-compile, symbolic-name-value=true  # Partial network cluster identification number. / 未使用
        reference ComMChannelPerPnc [0..0]: multiplicity set at post-build in variant post-build / pre-compile in variant pre-compile, post-build-variant-multiplicity=true, post-build-variant-value=true, set at post-build in variant post-build / pre-compile in variant pre-compile, destination=ComMChannel  # Reference to the ComMChannel that is required for this PNC. / 未使用 | ImplementationType: NetworkHandleType
        reference ComMUserPerPnc [0..0]: multiplicity set at post-build in variant post-build / pre-compile in variant pre-compile, post-build-variant-multiplicity=true, post-build-variant-value=true, set at post-build in variant post-build / pre-compile in variant pre-compile, destination=ComMUser  # Reference to the ComMUsers that correspond to this PNC. / 未使用 | ImplementationType: COMM_UserHandleType
        container ComMPncComSignal [0..0]  # Represents the PncComSignals which are used to communicate the EIRA and ERA status of this PNC. / 未使用
          enumeration ComMPncComSignalDirection [0..0]: {RX, TX}, set at pre-compile  # Indicates the communication direction of this PncComSignal. / 未使用
          enumeration ComMPncComSignalKind [0..0]: {EIRA, ERA}, multiplicity set at pre-compile, set at pre-compile  # Indicates whether this PncComSignal represents EIRA or ERA PNC information. / 未使用 | This parameter ComMPncComSignalKind is optional and shall be ignored when ComMPncComSignalDirection equals TX.
          reference ComMPncComSignalChannelRef [0..0]: multiplicity set at pre-compile, set at pre-compile, destination=ComMChannel  # Reference to the ComMChannel which is used to determine whether this PncComSignal shall participate in the active or passive role (via the parameter ComMPncGatewayType of the ComMChannel). / 未使用
          symbolic name reference ComMPncComSignalRef [0..0]: scope=ECU, set at pre-compile, destination=ComSignal  # Reference to the ComSignal which is used to transport the partial network channel request information. / 未使用
      container ComMUser [1..256]  # This container contains a list of identifiers that are needed to refer to a user in the system which is designated to request Communication modes. / ユーザー毎のコンフィグデータへのアクセスポインタを指定する。 このコンテナには、通信モードを要求するように示されているシステムのユーザを参照するために必要な識別子のリストが含まれる。
        integer ComMUserIdentifier: 0..255, set at pre-compile, symbolic-name-value=true  # An identifier that is needed to refer to a user in the system which is designated to request Communication Modes. / 通信モードを要求するように指定さているシステムのユーザを参照するために必要な識別子。 | ImplementationType: ComM_UserHandleType
        reference ComMUserEcucPartitionRef [0..1]: scope=ECU, multiplicity set at pre-compile, set at pre-compile, destination=EcucPartition  # Denotes in which "EcucPartition" the requester is executed. When the partition is stopped, the communication request shall be cancelled in the ComM / EcucPartitionの中でリクエスタが実行されることを意味する。 | to avoid a stay-awake situation of the bus due to a stopped partition.
    container ComMGeneral  # General configuration parameters of the Communication Manager. / Communication Managerの一般的なコンフィグレーションパラメータ。
      boolean ComMDevErrorDetect: set at pre-compile, default-value=false  # Switches the Default Error Tracer (Det) detection and notification ON or OFF. / 開発エラーの検知および通知を有効/無効に切り替える。 | * true: enabled (ON). * false: disabled (OFF).
      boolean ComMDirectUserMapping [0..0]: multiplicity set at pre-compile, set at pre-compile, default-value=false  # If this parameter is set to true the configuration tool shall automatically create a ComMUser per ComMPnc and a ComMUser per ComMChannel. / 未使用 | The shortName of the generated ComMUsers shall follow the following naming convention: PNCUser_ComMPncId, e.g. PNCUser_13 ChannelUser_ComMChannelId, e.g. ChannelUser_25 Restriction: ComMUser, which are created due to this configuration parameter, shall not be used by SWCs (only available for BswM).
      integer ComMEcuGroupClassification [0..0]: 0..255, set at pre-compile, default-value=3  # Defines whether a mode inhibition affects the ECU or not. / 未使用 | Examples: 000: No mode inhibition can be activated 001: Wake up inhibition can be enabled
      boolean ComMModeLimitationEnabled [0..0]: set at pre-compile, default-value=false  # true if mode limitation functionality shall be enabled. / 未使用 | true: Enabled false: Disabled
      boolean ComMNmPassiveModeEnable [0..1]: multiplicity set at pre-compile, set at pre-compile  # Enables support of Passive Mode.
      boolean ComMPncGatewayEnabled [0..0]: multiplicity set at pre-compile, set at pre-compile, default-value=false  # Enables or disables support of Partial Network Gateway. / 未使用 | False: Partial Networking Gateway is disabled True: Partial Networking Gateway is enabled
      float ComMPncPrepareSleepTimer [0..0]: 0..63, multiplicity set at pre-compile, set at pre-compile  # Time in seconds the PNC state machine shall wait in PNC_PREPARE_SLEEP. / 未使用
      boolean ComMPncSupport [0..0]: set at pre-compile, default-value=false  # Enables or disables support of partial networking. / 未使用 | False: Partial Networking is disabled True: Partial Networking is enabled
      boolean ComMResetAfterForcingNoComm [0..0]: set at pre-compile, default-value=false  # ComM shall perform a reset after entering "No Communication" mode because of an active mode limitation to "No Communication" mode. | true: Enabled false: Disabled
      boolean ComMSynchronousWakeUp: set at pre-compile, default-value=true  # Wake up of one channel shall lead to a wake up of all channels if true. / EcuM_WakeUpIndication による全チャネルの同期処理の有効/無効を設定します。TRUE：有効。１つのチャネルのウェイクアップにより、全チャネルのウェイクアップを導く。 FALSE：無効 | true: Enabled false: Disabled
      float ComMTMinFullComModeDuration: 0.001..65, set at pre-compile, default-value=5000  # Minimum time duration in seconds, spent in the COMM_FULL_COMMUNICATION sub-state COMM_FULL_COM_NETWORK_REQUESTED. / COMM_FULL_COMMUNICATIONのサブステートであるCOMM_FULL_COM_NETWORK_REQUESTED状態の最小持続時間を定義する。[sec]単位（小数第三位まで入力可）。
      boolean ComMVersionInfoApi [0..0]: set at pre-compile, default-value=true  # Switches the possibility to read the published information with the service ComM_GetPublishedInformation(). / 未使用 | true: Enabled false: Disabled
      boolean ComMWakeupInhibitionEnabled [0..0]: set at pre-compile, default-value=false  # true if wake up inhibition functionality enabled. / 未使用 | true: Enabled false: Disabled
      symbolic name reference ComMGlobalNvMBlockDescriptor [0..0]: scope=ECU, multiplicity set at pre-compile, set at pre-compile, destination=NvMBlockDescriptor  # Reference to NVRAM block containing the none volatile data. If this parameter is not configured it means that no NVRam is used at all. / 未使用

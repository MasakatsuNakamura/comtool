AUTOSAR XML (schema 4-2-2)
package /QINeS
  ecuc definition collection AUTOSARParameterDefinition: module=IpduM
  module definition IpduM [0..1]: refined-module-def=IpduM, post-build-variant-support=true, variants link-time/post-build/pre-compile  # Configuration of the IpduM (Ipdu Multiplexer) module. / IpduMモジュールのコンフィグレーション。
    container IpduMConfig  # This container contains the sub containers of the IpduM module. / IpduMモジュールのコンテナ。 | * The IpduMTxPathway subcontainer includes information about sent I-PDUs. * The IpduMRxPathway includes information about received I-PDUs. * The IpduMTxContainerPdu and IpduMTxContainedPdu include information about the sending of ContainerPdus. * The IpduMRxContainerPdu and IpduMRxContainedPdu include information about the reception of ContainerPdus.
      integer IpduMMaxTxBufferSize [0..0]: 0..65535, multiplicity set at link in variant link-time+post-build / pre-compile in variant pre-compile, set at link in variant link-time+post-build / pre-compile in variant pre-compile  # Maximum total size of all Tx buffers. This parameter is needed only in case of post-build loadable implementation using static memory allocation.
      integer IpduMMaxTxPathwayCnt [0..0]: 0..65535, multiplicity set at link in variant link-time+post-build / pre-compile in variant pre-compile, set at link in variant link-time+post-build / pre-compile in variant pre-compile  # Maximum number of transmitted IPdus. This parameter is needed only in case of post-build loadable implementation using static memory allocation.
      container IpduMContainedRxPdu [0..0]: multiplicity set at link in variant link-time / post-build in variant post-build / pre-compile in variant pre-compile, post-build-variant-multiplicity=true  # Configuration of a received contained Pdu.
        integer IpduMContainedPduHeaderId: 1..4294967295, post-build-variant-value=true, set at link in variant link-time / post-build in variant post-build / pre-compile in variant pre-compile  # Header Id which is part of the ContainerPdu when this ContainedPdu is inside.
        reference IpduMContainedRxInContainerPduRef [0..1]: multiplicity set at link in variant link-time / post-build in variant post-build / pre-compile in variant pre-compile, post-build-variant-multiplicity=true, post-build-variant-value=true, set at link in variant link-time / post-build in variant post-build / pre-compile in variant pre-compile, destination=IpduMContainerRxPdu  # Optional reference to a container Pdu this contained Pdu may be transported in. | The reference may be omitted in case IpduMContainerRxAcceptContainedPdu=IPDUM_ACCEPT_ALL.
        reference IpduMContainedRxPduRef: scope=ECU, post-build-variant-value=true, set at link in variant link-time / post-build in variant post-build / pre-compile in variant pre-compile, destination=Pdu  # Reference to the Pdu which represents this ContainedPdu and is used for reception indication.
      container IpduMContainedTxPdu [0..0]: multiplicity set at link in variant link-time / post-build in variant post-build / pre-compile in variant pre-compile, post-build-variant-multiplicity=true  # Configuration of a sender ContainedPdu.
        integer IpduMContainedPduHeaderId: 1..4294967295, post-build-variant-value=true, set at link in variant link-time / post-build in variant post-build / pre-compile in variant pre-compile  # Header Id which is part of the ContainerPdu when this ContainedPdu is inside.
        enumeration IpduMContainedTxPduCollectionSemantics: {IPDUM_COLLECT_LAST_IS_BEST, IPDUM_COLLECT_QUEUED}, post-build-variant-value=true, set at link in variant link-time / post-build in variant post-build / pre-compile in variant pre-compile  # Defines whether this IpduMContainedTxPdu shall be collected using a last-is-best or queued semantics.
        boolean IpduMContainedTxPduConfirmation [0..1]: multiplicity set at pre-compile, set at pre-compile, default-value=false  # This Parameter determines whether for this contained I-PDU a TxConfirmation shall be provided. If set to TRUE a TxConfirmation is issued. It is not used when an I-PDU is requested using the trigger transmit API. | If this Parameter is omitted, the default value shall be used.
        integer IpduMContainedTxPduHandleId: 0..65535, scope=ECU, set at pre-compile, symbolic-name-value=true  # Handle Id of the ContainedPdu.
        float IpduMContainedTxPduSendTimeout [0..1]: 0..65.535, multiplicity set at link in variant link-time / post-build in variant post-build / pre-compile in variant pre-compile, post-build-variant-multiplicity=true, post-build-variant-value=true, set at link in variant link-time / post-build in variant post-build / pre-compile in variant pre-compile  # Defines a ContainedPdu specific sender timeout which can reduce the ContainerPdu timer when this ContainedPdu is put inside the ContainerPdu. | Defined in seconds.
        enumeration IpduMContainedTxPduTrigger: {IPDUM_TRIGGER_ALWAYS, IPDUM_TRIGGER_NEVER}, post-build-variant-value=true, set at link in variant link-time / post-build in variant post-build / pre-compile in variant pre-compile  # Defines whether this Pdu triggers the sending of the ContainerPdu.
        reference IpduMContainedTxInContainerPduRef: post-build-variant-value=true, set at link in variant link-time / post-build in variant post-build / pre-compile in variant pre-compile, destination=IpduMContainerTxPdu  # Reference to the container Pdu which this contained Pdu shall be collected in.
        reference IpduMContainedTxPduRef: scope=ECU, post-build-variant-value=true, set at link in variant link-time / post-build in variant post-build / pre-compile in variant pre-compile, destination=Pdu  # Reference to the Pdu which represents this ContainedPdu and is used for transmission.
      container IpduMContainerRxPdu [0..0]: multiplicity set at link in variant link-time / post-build in variant post-build / pre-compile in variant pre-compile, post-build-variant-multiplicity=true  # Configuration of a receiver ContainerPdu which may collect several ContainedPdus.
        enumeration IpduMContainerHeaderSize: {IPDUM_HEADERTYPE_LONG, IPDUM_HEADERTYPE_SHORT}, post-build-variant-value=true, set at link in variant link-time / post-build in variant post-build / pre-compile in variant pre-compile  # Defines the layout of the header information (header id and length).
        enumeration IpduMContainerPduProcessing: {IPDUM_PROCESSING_DEFERRED, IPDUM_PROCESSING_IMMEDIATE}, post-build-variant-value=true, set at link in variant link-time / post-build in variant post-build / pre-compile in variant pre-compile  # Defines whether the handling of this ContainerPdu shall be done in the context of the caller (IMMEDIATE) or in the next IpduM main function (DEFERRED).
        integer IpduMContainerQueueSize [0..1]: 1..255, multiplicity set at link in variant link-time / post-build in variant post-build / pre-compile in variant pre-compile, post-build-variant-multiplicity=true, post-build-variant-value=true, set at link in variant link-time / post-build in variant post-build / pre-compile in variant pre-compile, default-value=1  # Defines a local queue for handling of each ContainerPdu. | Defined in number of instances of this ContainerPdu.
        enumeration IpduMContainerRxAcceptContainedPdu: {IPDUM_ACCEPT_ALL, IPDUM_ACCEPT_CONFIGURED}, post-build-variant-value=true, set at link in variant link-time / post-build in variant post-build / pre-compile in variant pre-compile  # Defines for the received IpduMRxContainerPdu whether the list of referencing IpduMRxContainedPdus (via the reference IpduMRxContainedPduContainerRef) is a closed set.
        integer IpduMContainerRxHandleId: 0..65535, scope=ECU, set at pre-compile, symbolic-name-value=true  # Handle Id used by the PduR for RxIndication.
        reference IpduMContainerRxPduRef: scope=ECU, post-build-variant-value=true, set at link in variant link-time / post-build in variant post-build / pre-compile in variant pre-compile, destination=Pdu  # Reference to the Pdu which represents the container and is used for reception.
      container IpduMContainerTxPdu [0..0]: multiplicity set at link in variant link-time / post-build in variant post-build / pre-compile in variant pre-compile, post-build-variant-multiplicity=true  # Configuration of a transmitted container Pdu.
        enumeration IpduMContainerHeaderSize: {IPDUM_HEADERTYPE_LONG, IPDUM_HEADERTYPE_SHORT}, post-build-variant-value=true, set at link in variant link-time / post-build in variant post-build / pre-compile in variant pre-compile  # Defines the layout of the header information (header id and length).
        integer IpduMContainerQueueSize [0..1]: 1..255, multiplicity set at link in variant link-time / post-build in variant post-build / pre-compile in variant pre-compile, post-build-variant-multiplicity=true, post-build-variant-value=true, set at link in variant link-time / post-build in variant post-build / pre-compile in variant pre-compile, default-value=1  # Defines a local queue for handling of each ContainerPdu. | Defined in number of instances of this ContainerPdu.
        float IpduMContainerTxConfirmationTimeout [0..1]: 0..65.535, multiplicity set at link in variant link-time / post-build in variant post-build / pre-compile in variant pre-compile, post-build-variant-multiplicity=true, post-build-variant-value=true, set at link in variant link-time / post-build in variant post-build / pre-compile in variant pre-compile  # This timeout (in seconds) defines the timeout period for monitoring the reception of the TxConfirmation. It is not used when an I-PDU is requested using the trigger transmit API. | If this Parameter is omitted, the default value shall be used.
        boolean IpduMContainerTxFirstContainedPduTrigger: post-build-variant-value=true, set at link in variant link-time / post-build in variant post-build / pre-compile in variant pre-compile  # Defines if the transmission of this IpduMContainerTxPdu shall be requested right after the first IpduMContainedTxPdu was put into it.
        integer IpduMContainerTxHandleId [0..1]: 0..65535, scope=ECU, multiplicity set at pre-compile, set at pre-compile, symbolic-name-value=true  # Handle Id used by the PduR for TxConfirmation and for TriggerTransmit of the ContainerPdu.
        float IpduMContainerTxSendTimeout [0..1]: 0..65.535, multiplicity set at link in variant link-time / post-build in variant post-build / pre-compile in variant pre-compile, post-build-variant-multiplicity=true, post-build-variant-value=true, set at link in variant link-time / post-build in variant post-build / pre-compile in variant pre-compile  # When this timeout expires the ContainerPdu is triggered for sending. The respective timer is started when the first Pdu is put into the ContainerPdu. | Defined in seconds.
        integer IpduMContainerTxSizeThreshold [0..1]: 0..4294967295, multiplicity set at link in variant link-time / post-build in variant post-build / pre-compile in variant pre-compile, post-build-variant-multiplicity=true, post-build-variant-value=true, set at link in variant link-time / post-build in variant post-build / pre-compile in variant pre-compile  # Defines the size threshold in bytes which, when exceeded, triggers the sending of the ContainerPdu although the maxium Pdu size (PduLength parameter of Pdu object) has not been reached yet.
        enumeration IpduMContainerTxTriggerMode: {IPDUM_DIRECT, IPDUM_TRIGGERTRANSMIT}, post-build-variant-value=true, set at link in variant link-time / post-build in variant post-build / pre-compile in variant pre-compile  # Defines whether this ContainerPdu is fetched via trigger transmit.
        reference IpduMContainerTxPduRef: scope=ECU, post-build-variant-value=true, set at link in variant link-time / post-build in variant post-build / pre-compile in variant pre-compile, destination=Pdu  # Reference to the Pdu which represents the container and is used for transmission.
      container IpduMRxPathway [0..65535]: multiplicity set at link in variant link-time / post-build in variant post-build / pre-compile in variant pre-compile, post-build-variant-multiplicity=true  # Contains the configuration parameters received I-PDUs by the IpduM module. / 受信I-PDUパスに関するコンテナ。
        container IpduMRxIndication  # Contains the configuration for incoming RxIndication calls. / 受信通知に関するコンテナ。
          enumeration IpduMByteOrder: {IPDUM_BIG_ENDIAN, IPDUM_LITTLE_ENDIAN}, post-build-variant-value=true, set at link in variant link-time / post-build in variant post-build / pre-compile in variant pre-compile  # This parameter defines the ByteOrder for all segments (static and dynamic part) and for the selectorField within the MultiplexedPdu. / スタティックパートとダイナミックパートの全てのセグメントと、セレクタフィールドのバイトオーダー設定。 | The absolute position of a segment in the MultiplexedIPdu is determined by the definition of the ByteOrder parameter: If BIG_ENDIAN is specified, the SegmentPosition indicates the bit position of the most significant bit in an IPDU. If LITTLE_ENDIAN is specified, the SegmentPosition indicates the bit position of the least significant bit in an IPDU.
          integer IpduMRxHandleId: 0..65535, scope=ECU, set at pre-compile, symbolic-name-value=true  # This is the I-PDU ID of the incoming I-PDU. If an incoming RxIndication's I-PDU ID matches this value then it is unpacked according to the specification in this container. / 受信通知元が参照するI-PDU ID。
          reference IpduMRxIndicationPduRef: scope=ECU, post-build-variant-value=true, set at link in variant link-time / post-build in variant post-build / pre-compile in variant pre-compile, destination=Pdu  # Reference to the received Pdu representation in the ECU Configuration Description exchange file. / 未使用
          container IpduMRxDynamicPart [0..65535]: multiplicity set at link in variant link-time / post-build in variant post-build / pre-compile in variant pre-compile, post-build-variant-multiplicity=true  # This container contains the configuration for the dynamic part of incoming RxIndication calls. When an incoming received I-PDU's selector field matches the IpduMRxSelectorValue, the new outgoing I-PDU for the dynamic part is constructed as defined by the segments (defined in the IpduMDynamicSegment container) and sent out with the I-PDU ID referenced by IpduMOutgoingDynamicPduRef. / 受信I-PDUのダイナミックパートに関するコンテナ。 | In case no dynamic part shall be extracted from this received I-PDU this container does not exist. This use-case can occur in case a MultiplexedIPdu is received by an ECU which is only interested in the static part of the MultiplexedIPdu.
            integer IpduMRxSelectorValue: 0..65535, post-build-variant-value=true, set at link in variant link-time / post-build in variant post-build / pre-compile in variant pre-compile  # This is the selector value that this container refers to. / セレクタフィールド値。
            reference IpduMOutgoingDynamicPduRef: scope=ECU, post-build-variant-value=true, set at link in variant link-time / post-build in variant post-build / pre-compile in variant pre-compile, destination=Pdu  # When the new I-PDU is sent out it is sent with this I-PDU ID. Reference to the sent PDU representation in the ECU Configuration Description exchange file. / ダイナミックパートの受信通知先のI-PDU ID。
          container IpduMRxDynamicSegment [0..2032]: multiplicity set at link in variant link-time / post-build in variant post-build / pre-compile in variant pre-compile, post-build-variant-multiplicity=true  # The dynamic part of the multiplexed incoming I-Pdu (referenced by IpduMRxIndicationPduRef) can be separated into several segments. | For each segment one IpduMRxDynamicSegment container shall be created that contains the location and the length of the segment. Please note that each configured segment will be copied into the destination I-Pdu that is referenced in the IpduMRxDynamicPart container and will be copied from the same location in the multiplexed incoming I-Pdu. The segment layout for all dynamic Parts is always identical.
            integer IpduMSegmentLength: 1..2032, post-build-variant-value=true, set at link in variant link-time / post-build in variant post-build / pre-compile in variant pre-compile  # Length of the segment in bits. / ダイナミックパートのセグメント長。
            integer IpduMSegmentPosition: 0..2031, post-build-variant-value=true, set at link in variant link-time / post-build in variant post-build / pre-compile in variant pre-compile  # Segments bit position in the multiplexed Pdu. / ダイナミックパートのセグメント開始ビット位置。
          container IpduMRxStaticPart [0..*]  # This container contains the configuration for the static part of incoming RxIndication calls. On reception, the new outgoing I-PDU for the static part is constructed as defined by the segments (defined in the IpduMStaticSegment container) and sent out with the I-PDU ID referenced by IpduMOutgoingStaticPduRef. / 受信I-PDUのスタティックパートに関するコンテナ。
            reference IpduMOutgoingStaticPduRef: scope=ECU, post-build-variant-value=true, set at link in variant link-time / post-build in variant post-build / pre-compile in variant pre-compile, destination=Pdu  # When the new I-PDU is sent out it is sent with this I-PDU ID. Reference to the sent Pdu representation in the ECU Configuration Description exchange file. / スタティックパートの受信通知先のI-PDU ID。
          container IpduMRxStaticSegment [0..2032]: multiplicity set at link in variant link-time / post-build in variant post-build / pre-compile in variant pre-compile, post-build-variant-multiplicity=true  # The static part of the multiplexed incoming I-Pdu (referenced by IpduMRxIndicationPduRef) can be separated into several segments. | For each segment one IpduMRxStaticSegment container shall be created that contains the location and the length of the segment. Please note that each configured segment will be copied into the destination I-Pdu that is referenced in the IpduMRxStaticPart container and will be copied from the same location in the multiplexed incoming I-Pdu.
            integer IpduMSegmentLength: 1..2032, post-build-variant-value=true, set at link in variant link-time / post-build in variant post-build / pre-compile in variant pre-compile  # Length of the segment in bits. / スタティックパートのセグメント長。
            integer IpduMSegmentPosition: 0..2031, post-build-variant-value=true, set at link in variant link-time / post-build in variant post-build / pre-compile in variant pre-compile  # Segments bit position in the multiplexed Pdu. / スタティックパートのセグメント開始ビット位置。
          container IpduMSelectorField  # This contains the location and the length of the selector field. / 受信I-PDUのセレクタフィールドに関するコンテナ。
            integer IpduMSelectorFieldLength: 1..16, post-build-variant-value=true, set at link in variant link-time / post-build in variant post-build / pre-compile in variant pre-compile  # Length of the selector field in bits. / セレクタフィールド長。
            integer IpduMSelectorFieldPosition: 0..2031, post-build-variant-value=true, set at link in variant link-time / post-build in variant post-build / pre-compile in variant pre-compile  # Selector field bit position in the multiplexed Pdu. / セレクタフィールド開始ビット位置。 | Range: 0..63 for CAN/ LIN I-PDUs, 0..511 for CAN FD I-PDUs, 0..2031 for FlexRay I-PDUs.
      container IpduMTxPathway [0..65535]: multiplicity set at link in variant link-time / post-build in variant post-build / pre-compile in variant pre-compile, post-build-variant-multiplicity=true  # Contains the configuration parameters transmitted I-PDUs by the IpduM module. / 送信I-PDUパスに関するコンテナ。
        container IpduMTxRequest  # This container is used to specify the configuration for Transmit requests. / 送信要求に関するコンテナ。 | There will be one instance of this container for each I-PDU that can be requested for transmission (the outgoing I-PDUs) by the IpduM.
          enumeration IpduMByteOrder: {IPDUM_BIG_ENDIAN, IPDUM_LITTLE_ENDIAN}, post-build-variant-value=true, set at link in variant link-time / post-build in variant post-build / pre-compile in variant pre-compile  # This parameter defines the ByteOrder for all segments (static and dynamic part) and for the selectorField within the MultiplexedPdu. / スタティックパートとダイナミックパートの全てのセグメントと、セレクタフィールドのバイトオーダー設定。 | The absolute position of a segment in the MultiplexedIPdu is determined by the definition of the ByteOrder parameter: If BIG_ENDIAN is specified, the SegmentPosition indicates the bit position of the most significant bit in an IPDU. If LITTLE_ENDIAN is specified, the SegmentPosition indicates the bit position of the least significant bit in an IPDU.
          integer IpduMIPduUnusedAreasDefault [0..1]: 0..255, multiplicity set at link in variant link-time / post-build in variant post-build / pre-compile in variant pre-compile, post-build-variant-multiplicity=true, post-build-variant-value=true, set at link in variant link-time / post-build in variant post-build / pre-compile in variant pre-compile  # IpduM module fills not used areas of an I-PDU with this bit-pattern / 送信I-PDUの未使用領域のデフォルト値。 | If this attribute is omitted the IpduM module does not fill the I-PDU.
          integer IpduM_Q_PduLength: 1..4294967295, multiplicity set at link in variant link-time / post-build in variant post-build / pre-compile in variant pre-compile, origin=QINeS, post-build-variant-multiplicity=true, post-build-variant-value=true, set at link in variant link-time / post-build in variant post-build / pre-compile in variant pre-compile  # size of I-PDU | size of I-PDU.
          integer IpduMTxConfirmationPduId: 0..65535, multiplicity set at pre-compile, set at pre-compile, symbolic-name-value=true  # Handle Id used by the PduR for confirmation (IpduM_TxConfirmation) and for TriggerTransmit (IpduM_TriggerTransmit). / 送信要求先が参照するI-PDU ID。 | The existence of this parameter is essential for the PduR generation tool to actually find a symbolicNameValue for the OutgoingPdu.
          float IpduMTxConfirmationTimeout [0..1]: 0..3600, multiplicity set at link in variant link-time / post-build in variant post-build / pre-compile in variant pre-compile, post-build-variant-multiplicity=true, post-build-variant-value=true, set at link in variant link-time / post-build in variant post-build / pre-compile in variant pre-compile  # This timeout (in seconds) defines the timeout period for monitoring the reception of the TxConfirmation. / 送信要求から送信完了通知までのタイムアウト値。[sec]単位（小数第三位まで入力可）。 | It is not used when an I-PDU is requested using the trigger transmit API.
          enumeration IpduMTxTriggerMode: {IPDUM_DYNAMIC_PART_TRIGGER, IPDUM_NONE, IPDUM_STATIC_OR_DYNAMIC_PART_TRIGGER, IPDUM_STATIC_PART_TRIGGER}, post-build-variant-value=true, set at link in variant link-time / post-build in variant post-build / pre-compile in variant pre-compile  # Selects whether to send the multiplexed I-PDU immediately or at some later date. / 送信I-PDUのスタティックパートまたはダイナミックパート更新時のトリガー送信モード。
          reference IpduMInitialDynamicPart: post-build-variant-value=true, set at link in variant link-time / post-build in variant post-build / pre-compile in variant pre-compile, destination=IpduMTxDynamicPart  # Reference to the dynamic part that shall be used to initialize this multiplexed TX-I-PDU. / 送信I-PDUのダイナミックパートの初期値。
          reference IpduMOutgoingPduRef: scope=ECU, post-build-variant-value=true, set at link in variant link-time / post-build in variant post-build / pre-compile in variant pre-compile, destination=Pdu  # Reference to the PDU defining the outgoing I-PDU. / 送信要求先のI-PDU ID。 | When the outgoing I-PDU is sent this is the I-PDU ID to give it. It is the IpduM I-PDU ID of the assembled I-PDU.
          container IpduMSelectorField  # This contains the location and the length of the selector field. / 受信I-PDUのセレクタフィールドに関するコンテナ。
            integer IpduMSelectorFieldLength: 1..16, post-build-variant-value=true, set at link in variant link-time / post-build in variant post-build / pre-compile in variant pre-compile  # Length of the selector field in bits. / セレクタフィールド長。
            integer IpduMSelectorFieldPosition: 0..2031, post-build-variant-value=true, set at link in variant link-time / post-build in variant post-build / pre-compile in variant pre-compile  # Selector field bit position in the multiplexed Pdu. / セレクタフィールド開始ビット位置。 | Range: 0..63 for CAN/ LIN I-PDUs, 0..511 for CAN FD I-PDUs, 0..2031 for FlexRay I-PDUs.
          container IpduMTxDynamicPart [1..65535]: multiplicity set at link in variant link-time / post-build in variant post-build / pre-compile in variant pre-compile, post-build-variant-multiplicity=true  # Configuration parameters for an instance of a TxRequest call into the IpduM. When a Tx Request with the IpduMTxDynamicHandleId is received by the IpduM, all segments (defined in the IpduMDynamicSegment container) are copied from the incoming I-PDU into the outgoing I-PDU buffer and then the send mode honored. This container is used by the dynamic part of a TxRequest configuration. Therefore, for each outgoing I-PDU there will be one instance of this container for the dynamic part. / 送信I-PDUのダイナミックパートに関するコンテナ。
            boolean IpduMJitUpdate [0..1]: multiplicity set at link in variant link-time / post-build in variant post-build / pre-compile in variant pre-compile, post-build-variant-multiplicity=true, post-build-variant-value=true, set at link in variant link-time / post-build in variant post-build / pre-compile in variant pre-compile, default-value=false  # If configured to true fetch the data of this part Just-In-Time via the triggerTransmit API of the PduR. / ダイナミックパートのJIT更新有無の設定。
            boolean IpduMTxDynamicConfirmation: post-build-variant-value=true, set at link in variant link-time / post-build in variant post-build / pre-compile in variant pre-compile  # A transmit request can be confirmed by the lower layer. If this parameter is set to true a confirmation of the I-PDU in COM representing the dynamic part is generated. / ダイナミックパートの送信完了通知有無の設定。
            integer IpduMTxDynamicHandleId: 0..65535, scope=ECU, set at pre-compile, symbolic-name-value=true  # This defines an incoming handle id. When the handle of an incoming Tx Request matches this id, the configured dynamic segments are copied and the IpduMTxTriggerMode is honored. / ダイナミックパートの送信要求元が参照するI-PDU ID。
            reference IpduMTxDynamicPduRef: scope=ECU, post-build-variant-value=true, set at link in variant link-time / post-build in variant post-build / pre-compile in variant pre-compile, destination=Pdu  # Reference to the Pdu representation in the ECU Configuration Description exchange file to be transmitted. / ダイナミックパートの送信完了通知先のI-PDU ID。
          container IpduMTxDynamicSegment [1..2032]: multiplicity set at link in variant link-time / post-build in variant post-build / pre-compile in variant pre-compile, post-build-variant-multiplicity=true  # The dynamic part of the multiplexed outgoing I-Pdu (referenced by IpduMOutgoingPduRef) can be separated into several segments. | For each segment one IpduMTxDynamicSegment container shall be created that contains the location and the length of the segment. Please note that each configured segment will be copied out of the source I-Pdu that is referenced in the IpduMTxDynamicPart container and will be copied to the same location in the multiplexed outgoing I-Pdu. The segment layout for all dynamic Parts is always identical.
            integer IpduMSegmentLength: 1..2032, post-build-variant-value=true, set at link in variant link-time / post-build in variant post-build / pre-compile in variant pre-compile  # Length of the segment in bits. / ダイナミックパートのセグメント長。
            integer IpduMSegmentPosition: 0..2031, post-build-variant-value=true, set at link in variant link-time / post-build in variant post-build / pre-compile in variant pre-compile  # Segments bit position in the multiplexed Pdu. / ダイナミックパートのセグメント開始ビット位置。
          container IpduMTxStaticPart [0..*]  # Configuration parameters for an instance of a Tx_Request call into the IpduM. When a Tx Request with the IpduMTxStaticHandleId is received by the IpduM, all segments (defined in the IpduMStaticSegment container) are copied from the incoming I-PDU into the outgoing I-PDU buffer and then the send mode honored. This container is used for the static part of a TxRequest configuration. Therefore, for each outgoing I-PDU there will be one instance of this container for the static part if it exists. / 送信I-PDUのスタティックパートに関するコンテナ。
            boolean IpduMJitUpdate [0..1]: multiplicity set at link in variant link-time / post-build in variant post-build / pre-compile in variant pre-compile, post-build-variant-multiplicity=true, post-build-variant-value=true, set at link in variant link-time / post-build in variant post-build / pre-compile in variant pre-compile, default-value=false  # If configured to true fetch the data of this part Just-In-Time via the triggerTransmit API of the PduR. / スタティックパートのJIT更新有無の設定。
            boolean IpduMTxStaticConfirmation: post-build-variant-value=true, set at link in variant link-time / post-build in variant post-build / pre-compile in variant pre-compile  # A transmit request can be confirmed by the lower layer. If this parameter is set to true a confirmation of the I-PDU in COM representing the static part is generated. / スタティックパートの送信完了通知有無の設定。
            integer IpduMTxStaticHandleId: 0..65535, scope=ECU, set at pre-compile, symbolic-name-value=true  # This defines an incoming handle id. When the handle of an incoming Tx Request matches this id, the configured static segments are copied and the IpduMTxTriggerMode is honored. / スタティックパートの送信要求元が参照するI-PDU ID。
            reference IpduMTxStaticPduRef: scope=ECU, post-build-variant-value=true, set at link in variant link-time / post-build in variant post-build / pre-compile in variant pre-compile, destination=Pdu  # Reference to the Pdu representation in the ECU Configuration Description exchange file to be transmitted. / スタティックパートの送信完了通知先のI-PDU ID。
          container IpduMTxStaticSegment [1..2032]: multiplicity set at link in variant link-time / post-build in variant post-build / pre-compile in variant pre-compile, post-build-variant-multiplicity=true  # The static part of the multiplexed outgoing I-Pdu (referenced by IpduMOutgoingPduRef) can be separated into several segments. | For each segment one IpduMTxStaticSegment container shall be created that contains the location and the length of the segment. Please note that each segment in the source I-Pdu that is referenced in the IpduMTxStaticPart container will be copied to the same location in the multiplexed outgoing I-Pdu.
            integer IpduMSegmentLength: 1..2032, post-build-variant-value=true, set at link in variant link-time / post-build in variant post-build / pre-compile in variant pre-compile  # Length of the segment in bits. / スタティックパートのセグメント長。
            integer IpduMSegmentPosition: 0..2031, post-build-variant-value=true, set at link in variant link-time / post-build in variant post-build / pre-compile in variant pre-compile  # Segments bit position in the multiplexed Pdu. / スタティックパートのセグメント開始ビット位置。
    container IpduMGeneral  # Contains the general configuration parameters of IpduM. / IpduMのジェネラルコンフィグレーション。
      float IpduMConfigurationTimeBase: 0.001..3600, set at pre-compile  # The cycle time with which IpduM_MainFunction should be invoked (in seconds). / IpduM_MainFunctionをコールする周期時間。[sec]単位（小数第三位まで入力可）。
      boolean IpduMDevErrorDetect: set at pre-compile  # Switches the Default Error Tracer (Det) detection and notification ON or OFF. / Detへの通知の有効化・無効化。 | * true: enabled (ON). * false: disabled (OFF).
      enumeration IpduMHeaderByteOrder [0..0]: {IPDUM_BIG_ENDIAN, IPDUM_LITTLE_ENDIAN}, set at pre-compile  # This parameter defines the ByteOrder of the headers inside a Container I-PDU.
      boolean IpduMStaticPartExists: set at pre-compile  # This is to allow optimizations in the case the IpduM will never be used with a static part. / スタティックパート使用有無。 | Note that this is a pre-compile option. If this is set to False then it will not be possible to add static parts after compilation. True: A static part may exist. False: A static part will never exist.
      boolean IpduMVersionInfoApi: set at pre-compile  # Active/Deactivate the version information API. / バージョン情報取得API使用有無。 | true: version information activated false: version information deactivated
    container IpduMPublishedInformation [0..0]  # Additional published parameters not covered by / 未使用 | CommonPublishedInformation container. Note that these parameters do not have any configuration class setting, since they are published information.
      boolean IpduMRxDirectComInvocation: set at published-information  # If set to TRUE the COM invocation optimization as defined in / 未使用 | IPDUM140 is implemented.

AUTOSAR XML (schema 4-2-2)
package /QINeS
  ecuc definition collection AUTOSARParameterDefinition: module=Port
  module definition Port [0..1]: refined-module-def=Port, post-build-variant-support=true, variants post-build/pre-compile  # Configuration of the Port module. / Portモジュールのコンフィグレーション。(MCAL ダミー)
    container PortConfigSet  # This container contains the configuration parameters and sub containers of the AUTOSAR Port module. / Portドライバのコンフィグレーションセット。
      container PortContainer [1..*]  # Container collecting the PortPins. / Portドライバに対する初期化データを含むコンテナのポインタ。
        integer PortNumberOfPortPins: 1..65535, set at pre-compile  # The number of specified PortPins in this PortContainer. / 個々のポート・ピンのコンフィグレーション用コンテナ型ポインタ数。
        container PortPin [1..*]  # Configuration of the individual port pins. / 個々のポート・ピンのコンフィグレーション用コンテナ型ポインタ。
          enumeration PortPinDirection: {PORT_PIN_IN, PORT_PIN_OUT}, post-build-variant-value=true, set at post-build in variant post-build / pre-compile in variant pre-compile  # The initial direction of the pin (IN or OUT). If the direction is not changeable, the value configured here is fixed. / ポート・ピン方向。 | The direction must match the pin mode. E.g. a pin used for an ADC must be configured to be an in port. Implementation Type: Port_PinDirectionType
          boolean PortPinDirectionChangeable: post-build-variant-value=true, set at post-build in variant post-build / pre-compile in variant pre-compile  # Parameter to indicate if the direction is changeable on a port pin during runtime. / ポート・ピン方向変更可否。 | true: Port Pin direction changeable enabled. false: Port Pin direction changeable disabled.
          integer PortPinId: 1..65535, set at pre-compile, symbolic-name-value=true  # Pin Id of the port pin. This value will be assigned to the symbolic name derived from the port pin container short name. / ポートピンのピンID。この値は、ポート・ピン・コンテナのショートネームに由来するシンボリック名に割り当てられる。
          enumeration PortPinInitialMode: {PORT_PIN_MODE_ADC, PORT_PIN_MODE_CAN, PORT_PIN_MODE_DIO, PORT_PIN_MODE_DIO_GPT, PORT_PIN_MODE_DIO_WDG, PORT_PIN_MODE_FLEXRAY, PORT_PIN_MODE_ICU, PORT_PIN_MODE_LIN, PORT_PIN_MODE_MEM, PORT_PIN_MODE_PWM, PORT_PIN_MODE_SPI}, post-build-variant-value=true, set at post-build in variant post-build / pre-compile in variant pre-compile  # Port pin mode from mode list for use with Port_Init() function. / ポート・ピン初期モード。
          enumeration PortPinLevelValue: {PORT_PIN_LEVEL_HIGH, PORT_PIN_LEVEL_LOW}, post-build-variant-value=true, set at post-build in variant post-build / pre-compile in variant pre-compile  # Port Pin Level value from Port pin list. / ポート・ピン・レベル値。
          enumeration PortPinMode [1..*]: {PORT_PIN_MODE_ADC, PORT_PIN_MODE_CAN, PORT_PIN_MODE_DIO, PORT_PIN_MODE_DIO_GPT, PORT_PIN_MODE_DIO_WDG, PORT_PIN_MODE_FLEXRAY, PORT_PIN_MODE_ICU, PORT_PIN_MODE_LIN, PORT_PIN_MODE_MEM, PORT_PIN_MODE_PWM, PORT_PIN_MODE_SPI}, multiplicity set at post-build in variant post-build / pre-compile in variant pre-compile, post-build-variant-multiplicity=true, post-build-variant-value=true, set at post-build in variant post-build / pre-compile in variant pre-compile  # Port pin mode from mode list. / ポート・ピン・モード設定。 | Note that more than one mode is allowed by default. That way it is e.g. possible to combine DIO with another mode such as ICU.
          boolean PortPinModeChangeable: post-build-variant-value=true, set at post-build in variant post-build / pre-compile in variant pre-compile  # Parameter to indicate if the mode is changeable on a port pin during runtime. True: Port Pin mode changeable allowed. False: Port Pin mode changeable not permitted. / ポート・ピン・モード変更可否。
    container PortGeneral  # Module wide configuration parameters of the PORT driver. / PORTドライバの全体のコンフィグレーションパラメータ。
      boolean PortDevErrorDetect: set at pre-compile  # Switches the Default Error Tracer (Det) detection and notification ON or OFF. / 開発エラー検出と報告を有効にするためのプリプロセッサスイッチ。 | * true: enabled (ON). * false: disabled (OFF).
      boolean PortSetPinDirectionApi: set at pre-compile  # Pre-processor switch to enable / disable the use of the function Port_SetPinDirection(). / API Port_SetPinDirectionを有効/無効にするプリプロセッサスイッチ。 （H/ Wが機能をサポートしていない場合などは、このパラメータは、APIを無効にするために使用することができる）。 | TRUE: Enabled - Function Port_SetPinDirection() is available. FALSE: Disabled - Function Port_SetPinDirection() is not available.
      boolean PortSetPinModeApi: set at pre-compile  # Pre-processor switch to enable / disable the use of the function Port_SetPinMode(). / API Port_SetPinModeを有効/無効にするプリプロセッサスイッチ。 （H/ Wが機能をサポートしていない場合などは、このパラメータは、APIを無効にするために使用することができる）。 | true: Enabled - Function Port_SetPinMode() is available. false: Disabled - Function Port_SetPinMode() is not available.
      boolean PortVersionInfoApi: set at pre-compile  # Pre-processor switch to enable / disable the API to read out the modules version information. / モジュールのバージョン情報を読み出すAPIを有効/無効にするためプリプロセッサスイッチ。 | true: Version info API enabled. false: Version info API disabled.

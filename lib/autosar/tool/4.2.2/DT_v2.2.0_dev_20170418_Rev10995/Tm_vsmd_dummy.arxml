AUTOSAR XML (schema 4-1-1)
package /QINeS
  ecuc definition collection AUTOSARParameterDefinition: module=Tm
  module definition Tm [0..1]: refined-module-def=Tm, variants pre-compile  # Configuration of the Time Service module. / Tmモジュールのコンフィグレーション。(MCAL ダミー)
    container TmGeneral  # General configuration of Time Service module.
      boolean TmDevErrorDetect: set at pre-compile  # Switches the Development Error Detection ON or OFF.
      boolean TmEnablePredefTimer100us32bit: scope=ECU, set at pre-compile  # Specifies if the Predef Timer 100µs32bit shall be enabled (functionality and set of API services). ON or OFF.
      boolean TmEnablePredefTimer1us16bit: scope=ECU, set at pre-compile  # Specifies if the Predef Timer 1µs16bit shall be enabled (functionality and set of API services). ON or OFF.
      boolean TmEnablePredefTimer1us24bit: scope=ECU, set at pre-compile  # Specifies if the Predef Timer 1µs24bit shall be enabled (functionality and set of API services). ON or OFF.
      boolean TmEnablePredefTimer1us32bit: scope=ECU, set at pre-compile  # Specifies if the Predef Timer 1µs32bit shall be enabled (functionality and set of API services). ON or OFF.
      boolean TmVersionInfoApi: set at pre-compile  # Adds / removes the service Tm_GetVersionInfo() from the code. ON or OFF.

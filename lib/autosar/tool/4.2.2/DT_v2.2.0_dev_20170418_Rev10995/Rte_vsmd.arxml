AUTOSAR XML (schema 4-2-2)
package /QINeS
  ecuc definition collection AUTOSARParameterDefinition: module=Rte
  module definition Rte [0..1]: refined-module-def=Rte, post-build-variant-support=true, variants post-build/pre-compile  # Configuration of the Rte (Runtime Environment) module. / Rteモジュールのコンフィグレーション。(ダミー)
    container RteBswGeneral  # General configuration parameters of the Bsw Scheduler section. / Bswスケジューラセクションのジェネラルコンフィグレーション。
      boolean RteSchMVersionInfoApi: set at pre-compile, default-value=false  # Enables the generation of the SchM_GetVersionInfo() API. / SchM_GetVersionInfo()APIの生成を可能にする。
      boolean RteUseComShadowSignalApi [0..0]: set at pre-compile, default-value=false  # This parameter defines whether the ComShadowSignalAPIs ((Com_UpdateShadowSignal, Com_InvalidateShadowSignal, Com_ReceiveShadowSignal) are used or not. / このパラメータは、ComShadowSignalAPI(Com_UpdateShadowSignal、Com_InvalidateShadowSignal、Com_ReceiveShadowSignal)が使用されるかどうかを定義する。 TRUE：ShadowSignal APIとSignal API(Com_SendSignal、Com_InvalidateSignal、Com_ReceiveSignal)が使用される FALSE：Signal API(Com_SendSignal、Com_InvalidateSignal、Com_ReceiveSignal)が使用される ※現行のQINeSでは未使用。 | If this parameter is set to true the ShadowSignal APIs and Signal APIs (Com_SendSignal, Com_InvalidateSignal, Com_ReceiveSignal) are used. If this parameter is set to false only the Signal APIs (Com_SendSignal, Com_InvalidateSignal, Com_ReceiveSignal) are used.
    container RteBswModuleInstance [0..*]  # Represents one instance of a Bsw-Module configured on one ECU. / 1つのECUで構成される1つのBsw-Moduleインスタンスを表す。
      foreign reference RteBswImplementationRef: set at pre-compile, destination-type=BSW-IMPLEMENTATION  # Reference to the BswImplementation for which the Rte /SchM is configured. / Rte/SchMを構成するBswImplementationへの参照。
      foreign reference RteBswModuleConfigurationRef [0..0]: multiplicity set at pre-compile, set at pre-compile, destination-type=ECUC-MODULE-CONFIGURATION-VALUES  # Reference to the ECU Configuration Values provided for this BswImplementation. / このBswImplementationに対して提供されるECU Configuration Valueへの参照。 ※現行のQINeSでは未使用。
      container RteBswEventToTaskMapping [0..*]  # Maps a BswModuleEntity onto an OsTask based on the activating BswEvent. A BswModuleEntity can be activated by more than one BswEvent and thus be mapped to more than one OsTask. In the case of a BswSchedulableEntity executed via a direct function call this RteBswEventToTaskMapping is still specified but no RteBswMappedToTaskRef element is included. The RteBswPositionInTask parameter is necessary to provide an ordering of events invoked by the same RTE API. / 活性化しているBswEventに基づいて、BswEntityを1つのOsTaskにマッピングする。BswEntityは、複数のBswEventによって活性化でき、したがって複数のOsTaskにもマッピングできる。
        float RteBswActivationOffset [0..0]: 0..Inf, multiplicity set at pre-compile, set at pre-compile  # Activation offset in seconds. / 活性化オフセット(秒単位)。 ※現行のQINeSでは未使用。
        boolean RteBswImmediateRestart [0..0]: set at pre-compile, default-value=false  # When RteBswImmediateRestart is set to true the BswSchedulableEntitiy shall be immediately re-started after termination if it was activated by this BswEvent while it was already started. / TRUE：既に起動されているときにこのBswEventによって活性化されたBswSchedulableEntitiyは、終了後に即座に再起動する。 マッピングされたBswEventが、minimumStartInterval属性が0より大きい値に設定されたBswSchedulableEntitiyを参照している場合、このパラメータをtrueに設定することはできない。 ※現行のQINeSでは未使用。 | This parameter shall not be set to true when the mapped BswEvent refers to a BswSchedulableEntitiy which minimumStartInterval attribute is > 0.
        integer RteBswPositionInTask [0..1]: 0..65535, multiplicity set at pre-compile, set at pre-compile  # Each BswSchedulableEntity activation mapped to an OsTask has a specific position within the task execution. / OsTaskにマッピングされた各BswSchedulableEntityの活性化は、タスク実行内に特定の位置を持つ。定期的な活性化では、これが実行順序になる。イベントドライバの活性化では、これは実際のBswSchedulableEntityが実行される評価順序である。 | For periodic activation this is the order of execution. For event driver activation this is the order of evaluation which actual BswSchedulableEntity has to be executed. In case of direct function calls this parameter is necessary to provide an ordering of events when several ExecutableEntities are invoked by the same RTE API.
        enumeration RteOsSchedulePoint [0..1]: {CONDITIONAL, NONE, UNCONDITIONAL}, multiplicity set at pre-compile, set at pre-compile  # Introduce a schedule point by explicitly calling Os Schedule service after the execution of the ExecutableEntity. The Rte generator is allowed to optimize several consecutive calls to Os schedule into one single call if the ExecutableEntity executions in between have been skipped. / ExecutableEntityの実行後にOs Scheduleサービスを明示的に呼び出すことで、スケジュールポイントを導入する。Rteジェネレータは、中間のExecutableEntityの実行が省略されている場合、連続するいくつかのOs Schedule呼び出しを1つの呼び出しに統合して最適化できる。 このパラメータがない場合は、"NONE" として解釈される。 タスクをプリエンプティブにでき、このパラメータの値が "NONE" にされていない、またはパラメータがない場合、これは無効な構成と見なされる。 | The absence of this parameter is interpreted as "NONE". It shall be considered an invalid configuration if the task is preemptable and the value of this parameter is not set to "NONE" or the parameter is absent.
        foreign reference RteBswEventRef: set at pre-compile, destination-type=BSW-EVENT  # Reference to the BswEvent. / BswEventへの参照。 BswSchedulableEntityを指しているBswEventへの参照がマッピングされている。これは、活性化されたBswEventに基づいてBswSchedulableEntitesのきめの細かいマッピングを可能にする。
        reference RteBswEventPredecessorSyncPointRef [0..0]: multiplicity set at pre-compile, set at pre-compile, destination=RteSyncPoint  # The RteBswEventPredecessorSyncPointRef is necessary to provide a cross core synchronization in case of BswEvents triggered by the same event source but mapped to tasks belonging to different partitions on different cores. | The synchronization point must be reached by all referencing BswEvents before the execution in all related tasks is continued. In case of RteBswEventPredecessorSyncPointRef the BswModuleEntity activated by the mapped BswEvent is executed after the synchronization point is passed.
        reference RteBswEventSuccessorSyncPointRef [0..0]: multiplicity set at pre-compile, set at pre-compile, destination=RteSyncPoint  # The RteBswEventSuccessorSyncPointRef is necessary to provide a cross core synchronization in case of BswEvents triggered by the same event source but mapped to tasks belonging to different partitions on different cores. | The synchronization point must be reached by all referencing BswEvents before the execution in all related tasks is continued. In case of RteBswEventSuccessorSyncPointRef the BswModuleEntity activated by the mapped BswEvent is executed before the synchronization point is entered.
        reference RteBswMappedToTaskRef [0..1]: multiplicity set at pre-compile, set at pre-compile, destination=OsTask  # Reference to the OsTask the BswSchedulableEntity activated by the RteBswEventRef is mapped to. / RteBswEventRefによって活性化されたBswSchedulableEntityがマッピングされているOsTaskへの参照。OsTaskへの参照が指定されていない場合、このBswEventによって活性化されたBswSchedulableEntityは、呼び出し元のコンテキストで実行される。 | If no reference to the OsTask is specified the BswSchedulableEntity activated by this BswEvent is executed in the context of the caller.
        reference RteBswUsedOsAlarmRef [0..1]: multiplicity set at pre-compile, set at pre-compile, destination=OsAlarm  # If an OsAlarm is used to activate the OsTask this BswEvent is mapped to it shall be referenced here. / OsAlarmを使用して、このBswEventがマッピングされるOsTaskを活性化する場合、ここでそれが参照される。 ※現行のQINeSでは未使用。
        reference RteBswUsedOsEventRef [0..1]: multiplicity set at pre-compile, set at pre-compile, destination=OsEvent  # If an OsEvent is used to activate the OsTask this BswEvent is mapped to it shall be referenced here. / OsEventを使用して、このBswEventがマッピングされるOsTaskを活性化する場合、ここでそれが参照される。
        reference RteBswUsedOsSchTblExpiryPointRef [0..1]: multiplicity set at pre-compile, set at pre-compile, destination=OsScheduleTableExpiryPoint  # If an OsScheduleTableExpiryPoint is used to activate the OsTask this BswEvent is mapped to it shall be referenced here. / OsScheduleTableExpiryPointを使用して、このBswEventがマッピングされるOsTaskを活性化する場合、ここでそれが参照される。 ※現行のQINeSでは未使用。
      container RteBswExclusiveAreaImpl [0..*]  # Represents one ExclusiveArea of one BswImplementation. Used to specify the implementation means of this ExclusiveArea. / 1つのBswImplementationの1つのExclusiveAreaを表す。このExclusiveAreaの実装方法を指定するために使用される。
        enumeration RteExclusiveAreaImplMechanism: {ALL_INTERRUPT_BLOCKING, COOPERATIVE_RUNNABLE_PLACEMENT, OS_INTERRUPT_BLOCKING, OS_RESOURCE, OS_SPINLOCK}, set at pre-compile  # To be used implementation mechanism for the specified ExclusiveArea. / 指定したExclusiveAreaに使用される実装メカニズム。
        foreign reference RteBswExclusiveAreaRef: set at pre-compile, destination-type=EXCLUSIVE-AREA  # Reference to the ExclusiveArea for which the implementation mechanism shall be specified. / 実装メカニズムが指定されるExclusiveAreaへの参照。
        reference RteBswExclusiveAreaOsResourceRef [0..1]: multiplicity set at pre-compile, set at pre-compile, destination=OsResource  # Optional reference to an OsResource in case RteExclusiveAreaImplMechanism is configured to OS_RESOURCE for this ExclusiveArea. / このExclusiveAreaに対してcaseRteExclusiveAreaImplMechanismがOS_RESOURCEに構成された場合のOsResourceへのオプションの参照。
        reference RteBswExclusiveAreaOsSpinlockRef [0..1]: multiplicity set at pre-compile, set at pre-compile, destination=OsSpinlock  # Optional reference to an OsSpinlock in case RteExclusiveAreaImplMechanism is configured to OS_SPINLOCK for this ExclusiveArea.
      container RteBswExternalTriggerConfig [0..0]  # Defines the configuration of Inter Basic Software Module Entity Triggering / Basic Softwareモジュールエンティティ間トリガーのコンフィグレーションを定義する。 ※現行のQINeSでは未使用。
        integer RteBswTriggerSourceQueueLength: 0..4294967295, set at pre-compile, default-value=0  # Length of trigger queue on the trigger source side. / トリガーソース側でのトリガーキューの長さ。 キューはRTEによって実装される。1以上の値の場合は、キュー登録された動作が要求される。RteTriggerSourceQueueLengthの値を0に設定すると、トリガー通信をキュー登録しない実装が要求される。 トリガーエミッターに対してRteBswTriggerSourceQueueLengthが設定されていない場合は、既定値の 0 が適用される。 ※現行のQINeSでは未使用。 | The queue is implemented by the RTE. A value greater or equal to 1 requests an queued behavior. Setting the value of RteTriggerSourceQueueLength to 0 requests an none queued implementation of the trigger communication. If there is no RteBswTriggerSourceQueueLength configured for a Trigger Emitter the default value of 0 applies as well.
        foreign reference RteBswTriggerSourceRef: set at pre-compile, destination-type=TRIGGER  # Reference to a Trigger instance in the role releasedTrigger of the related BSW Module instance. / 関連するBSWモジュールインスタンスのロールreleasedTriggerにあるTriggerインスタンスへの参照。 参照されるTriggerは、このパラメータを持つRteBswModuleInstanceの構成時に、同じBSWモジュールインスタンスに属している必要がある。 ※現行のQINeSでは未使用。 | The referenced Trigger has to belong to the same BSW Module instance as the RteBswModuleInstance owning this parameter configures.
      container RteBswInternalTriggerConfig [0..0]  # Defines the configuration of internal Basic Software Module Entity Triggering / Basic Softwareモジュールエンティティ内トリガーのコンフィグレーションを定義する。 ※現行のQINeSでは未使用。
        integer RteBswTriggerSourceQueueLength: 0..4294967295, set at pre-compile, default-value=0  # Length of trigger queue on the trigger source side. / トリガーソース側でのトリガーキューの長さ。 キューはRTEによって実装される。1以上の値の場合は、キュー登録された動作が要求される。RteTriggerSourceQueueLengthの値を0に設定すると、トリガー通信をキュー登録しない実装が要求される。 トリガーエミッターに対してRteBswTriggerSourceQueueLengthが設定されていない場合は、既定値の 0 が適用される。 ※現行のQINeSでは未使用。 | The queue is implemented by the RTE. A value greater or equal to 1 requests an queued behavior. Setting the value of RteTriggerSourceQueueLength to 0 requests an none queued implementation of the trigger communication. If there is no RteBswTriggerSourceQueueLength configured for a Trigger Emitter the default value of 0 applies as well.
        foreign reference RteBswTriggerSourceRef: set at pre-compile, destination-type=BSW-INTERNAL-TRIGGERING-POINT  # Reference to a BswInternalTriggeringPoint of the related BSW Module instance. / 関連するBSWモジュールインスタンスのロールreleasedTriggerにあるTriggerインスタンスへの参照。 参照されるTriggerは、このパラメータを持つRteBswModuleInstanceの構成時に、同じBSWモジュールインスタンスに属している必要がある。 ※現行のQINeSでは未使用。 | The referenced BswInternalTriggeringPoint has to belong to the same BSW Module instance as the RteBswModuleInstance owning this parameter configures.
      container RteBswRequiredClientServerConnection [0..0]  # Defines the connection between one requiredClientServerEntry and one providedClientServerEntry of a BswModuleDescription. This container shall be provided on the client side of the connection.
        foreign reference RteBswProvidedClientServerEntryRef: set at pre-compile, destination-type=BSW-MODULE-CLIENT-SERVER-ENTRY  # Reference the providedClientServerEntry for this connection.
        foreign reference RteBswRequiredClientServerEntryRef: set at pre-compile, destination-type=BSW-MODULE-CLIENT-SERVER-ENTRY  # Reference the requiredClientServerEntry for this connection.
        reference RteBswProvidedClientServerEntryModInstRef: set at pre-compile, destination=RteBswModuleInstance  # Reference to the RteBswModuleInstance configuration container which identifies the instance of the BSW Module. | Used with the RteBswProvidedClientServerEntryRef to unambiguously identify the BswModuleClientServerEntry instance.
      container RteBswRequiredModeGroupConnection [0..*]  # Defines the connection between one requiredModeGroup of this BSW Module instance and one providedModeGroup instance. / このBSWモジュールインスタンスの1つのrequiredModeGroupと、1つのprovidedModeGroupインスタンスとの間の接続を定義する。
        foreign reference RteBswProvidedModeGroupRef: set at pre-compile, destination-type=MODE-DECLARATION-GROUP-PROTOTYPE  # References the providedModeGroupPrototype to which this requiredModeGroup shall be connected. / このrequiredModeGroupが接続されるprovidedModeGroupPrototypeを参照する。
        foreign reference RteBswRequiredModeGroupRef: set at pre-compile, destination-type=MODE-DECLARATION-GROUP-PROTOTYPE  # References requiredModeGroupPrototype which shall be connected to the providedModeGroupPrototype. / providedModeGroupPrototypeに接続されるrequiredModeGroupPrototypeを参照する。
        foreign reference RteModeDeclarationMappingSetRef [0..1]: multiplicity set at pre-compile, set at pre-compile, destination-type=MODE-DECLARATION-MAPPING-SET  # This defines the effective ModeDeclarationMappingSet in the case that the provided ModeDeclarationGroupPrototype and the required ModeDeclarationGroupPrototype are not compatible.
        reference RteBswProvidedModeGrpModInstRef: set at pre-compile, destination=RteBswModuleInstance  # Reference to the RteBswModuleInstance configuration container which identifies the instance of the BSW Module. / BSWモジュールのインスタンスを識別するRteBswModuleInstanceコンフィグレーションコンテナへの参照。ModeDeclarationGroupPrototypeインスタンスを一義的に識別するため、RteBswProvidedModeGroupRefとともに使用される。 | Used with the RteBswProvidedModeGroupRef to unambiguously identify the ModeDeclarationGroupPrototype instance.
      container RteBswRequiredSenderReceiverConnection [0..0]  # Defines the connection between one requiredData and one providedData of a BswModuleDescription. This container shall be provided on the receiver side of the connection.
        foreign reference RteBswProvidedVariableDataPrototypeRef: set at pre-compile, destination-type=VARIABLE-DATA-PROTOTYPE  # Reference the providedData for this connection.
        foreign reference RteBswRequiredVariableDataPrototypeRef: set at pre-compile, destination-type=VARIABLE-DATA-PROTOTYPE  # Reference the requiredData for this connection.
        reference RteBswProvidedDataModInstRef: set at pre-compile, destination=RteBswModuleInstance  # Reference to the RteBswModuleInstance configuration container which identifies the instance of the BSW Module. | Used with the RteBswProvidedVariableDataPrototypeRef to unambiguously identify the VariableDataPrototype instance.
      container RteBswRequiredTriggerConnection [0..0]  # Defines the connection between one requiredTrigger of this BSW Module instance and one releasedTrigger instance. / このBSWモジュールインスタンスの1つのrequiredTriggerと、1つのreleasedTriggerインスタンスとの間の接続を定義する。 ※現行のQINeSでは未使用。
        foreign reference RteBswReleasedTriggerRef: set at pre-compile, destination-type=TRIGGER  # References the releasedTrigger to which this requiredTrigger shall be connected. / このrequiredTriggerが接続されるreleasedTriggerを参照する。 ※現行のQINeSでは未使用。
        foreign reference RteBswRequiredTriggerRef: set at pre-compile, destination-type=TRIGGER  # References one requiredTrigger which shall be connected to the releasedTrigger. / releasedTriggerに接続される1つのrequiredTriggerを参照する。 ※現行のQINeSでは未使用。
        reference RteBswReleasedTriggerModInstRef: set at pre-compile, destination=RteBswModuleInstance  # Reference to the RteBswModuleInstance configuration container which identifies the instance of the BSW Module. / BSWモジュールのインスタンスを識別するRteBswModuleInstanceコンフィグレーションコンテナへの参照。Triggerインスタンスを一義的に識別するため、RteBswReleasedTriggerRefとともに使用される。 ※現行のQINeSでは未使用。 | Used with the RteBswReleasedTriggerRef to unambiguously identify the Trigger instance.
    container RteGeneration  # This container holds the parameters for the configuration of the RTE Generation. / このコンテナは、RTE生成のコンフィグレーションのためのパラメータを保持する。 ※現行のQINeSでは未使用。
      enumeration RteBypassSupport [0..0]: {COMPONENT_WRAPPER, NONE}, set at pre-compile, default-value=NONE  # General switch to enable and select the bypass support method.
      enumeration RteCalibrationSupport [0..0]: {DOUBLE_POINTERED, INITIALIZED_RAM, NONE, SINGLE_POINTERED}, set at pre-compile, default-value=NONE  # The RTE generator shall have the option to switch off support for calibration for generated RTE code. This option shall influence complete RTE code at once. / RTEジェネレータには、生成されたRTEコードのキャリブレーションに対するサポートを無効にするオプションを設ける必要がある。このオプションは、即時に完全なRTEコードに作用するものである必要がある。 ※現行のQINeSでは未使用。
      integer RteCodeVendorId: 0..65535, set at pre-compile  # Holds the vendor ID of the generated Rte code. / 生成されたRteコードのベンダーIDを保持する。 ※現行のQINeSでは未使用。
      boolean RteDevErrorDetect [0..0]: set at pre-compile, default-value=false  # Switches the Default Error Tracer (Det) detection and notification ON or OFF. / Rteは、開発エラーをDetモジュールに記録する。 ※現行のQINeSでは未使用。 | * true: enabled (ON). * false: disabled (OFF).
      boolean RteDevErrorDetectUninit [0..0]: set at pre-compile, default-value=false  # The Rte shall detect if it is started when its APIs are called, and the BSW Scheduler shall check if it is initialized when its APIs are called. / Rteは、APIが呼び出されたときに起動するかどうかを検出する。BSWスケジューラは、APIが呼び出されたときに初期化するかどうかを確認する。 ※現行のQINeSでは未使用。
      enumeration RteGenerationMode [0..0]: {COMPATIBILITY_MODE, VENDOR_MODE}, set at pre-compile, default-value=COMPATIBILITY_MODE  # Switch between the two available generation modes of the RTE generator. / RTEジェネレータで使用可能な2つの生成モード間を切り替える。 ※現行のQINeSでは未使用。
      boolean RteInExclusiveAreaCheckEnabled [0..0]: set at pre-compile, default-value=true  # Enables the check for RTE_E_IN_EXCLUSIVE_AREA (for blocking APIs).
      enumeration RteIocInteractionReturnValue [0..0]: {RTE_COM, RTE_IOC}, set at pre-compile, default-value=RTE_IOC  # Defines whether the return value of RTE APIs is based on RTE-IOC interaction or RTE-COM interaction. / RTE APIの戻り値を、RTE-IOCインタラクションとRTE-COMインタラクションのどちらをベースにするかを定義する。 ※現行のQINeSでは未使用。
      boolean RteMeasurementSupport [0..0]: set at pre-compile, default-value=false  # The RTE generator shall have the option to switch off support for measurement for generated RTE code. This option shall influence complete RTE code at once. / RTEジェネレータには、生成されたRTEコードの測定に対するサポートを無効にするオプションを設ける必要がある。このオプションは、即時に完全なRTEコードに作用するものである必要がある。 ※現行のQINeSでは未使用。
      enumeration RteOptimizationMode [0..0]: {MEMORY, RUNTIME}, set at pre-compile, default-value=RUNTIME  # Switch between the two available optimization modes of the RTE generator. / RTEジェネレータで使用可能な2つの最適化モード間を切り替える。 ※現行のQINeSでは未使用。
      integer RteToolChainSignificantCharacters [0..0]: 0..65535, multiplicity set at pre-compile, set at pre-compile, default-value=31  # If present, the RTE generator shall provide the list of C RTE identifiers whose name is not unique when only the first RteToolChainSignificantCharacters characters are considered. / 設定されている場合、RTEジェネレータはRTEが生成する識別子のうち、最初のRteToolChainSignificantCharacters文字数までユニークでないもののリストを提供する。 ※現行のQINeSでは未使用。
      boolean RteValueRangeCheckEnabled [0..0]: set at pre-compile, default-value=false  # If set to true the RTE generator shall enable the value range checking for the specified VariableDataPrototypes. / TRUE：RTEジェネレータは、指定したVariableDataPrototypeに対する値の範囲の確認を有効にする。 ※現行のQINeSでは未使用。
      linker symbol RteVfbTraceClientPrefix [0..0]: multiplicity set at pre-compile, set at pre-compile  # Defines an additional prefix for all VFB trace functions to be generated. With this approach it is possible to have debugging and DLT trace functions at the same time. / 生成するすべてのVFBトレース関数に対する追加の接頭辞を定義する。この手法により、デバッグとDLTトレースの関数を同時に持つことが可能である。 ※現行のQINeSでは未使用。
      boolean RteVfbTraceEnabled [0..0]: set at pre-compile, default-value=false  # The RTE generator shall globally enable VFB tracing when RteVfbTrace is set to "true". / TURE：RTEジェネレータはVFBトレーシングをグローバルに有効化する。 ※現行のQINeSでは未使用。
      function name RteVfbTraceFunction [0..0]: multiplicity set at pre-compile, set at pre-compile  # The RTE generator shall enable VFB tracing for a given hook function when there is a #define in the RTE configuration header file for the hook function name and tracing is globally enabled. / RTEジェネレータは、フック関数名に対する#defineがRTEコンフィグレーションヘッダーファイル内にあり、トレーシングがグローバルに有効化されている場合に、その特定のフック関数に対しVFBトレーシングを有効化する。 例：#define Rte_WriteHook_i1_p1_a_Start これは、RteVfbTraceClientPrefixを使ったVFBトレース関数にも当てはまる。 (例：Rte_Dbg_WriteHook_I1_P1_a_Start) ※現行のQINeSでは未使用。 | Example: #define Rte_WriteHook_i1_p1_a_Start This also applies to VFB trace functions with a RteVfbTraceClientPrefix, e.g. Rte_Dbg_WriteHook_I1_P1_a_Start.
      container RteQinesExclusiveImplementation
        enumeration RteQinesExclusiveImplMechanism: {ALL_INTERRUPT_BLOCKING, NONE, OS_INTERRUPT_BLOCKING, OS_RESOURCE}, origin=QINeS, set at pre-compile, default-value=ALL_INTERRUPT_BLOCKING
        reference RteQinesExclusiveOsResourceRef [0..1]: multiplicity set at pre-compile, origin=QINeS, set at pre-compile, destination=OsResource
    container RteImplicitCommunication [0..0]  # Configuration of the Implicit Communication behavior to be generated. / 生成される暗黙的通信動作のコンフィグレーション。 ※現行のQINeSでは未使用。
      boolean RteCoherentAccess: set at pre-compile, default-value=false  # If set to true the referenced VariableAccess'es of this RteImplicitCommunication container are in one CoherencyGroup. / TRUE：このRteImplicitCommunicationコンテナの、参照されるVariableAccessは、1つのCoherencyGroupに含まれる。 コヒーレントな暗黙的読み取りアクセスのデータ値は、最初の読み取りRunnbaleEntityが開始する前に読み取られ、すべての読み取りRunnableEntityが実行されている間は安定している (コヒーレントな暗黙的書き込みアクセスが同じコヒーレンシグループに属する場合を除く)。コヒーレントな暗黙的書き込みアクセスによって書き込まれたデータ値は、最後の書き込みRunnableEntityが終了したあとで、コヒーレンシグループに属さない読み取り側で使用できる。 コヒーレントな暗黙的データアクセスは、同じまたは異なるVariableDataElementへのVariableAccessに対して定義できる。しかし、1つのコヒーレンシグループに含まれるすべてのコヒーレントな暗黙的データアクセスは、同じタスクで実行される必要がある。 ※現行のQINeSでは未使用。 | Data values for Coherent Implicit Read Access'es are read before the first reading RunnbaleEntity starts and are stable during the execution of all the reading RunnableEntitys; except Coherent Implicit Write Access'es belongs to the same Coherency Group. Data values written by Coherent Implicit Write Access'es are available for readers not belonging to the Coherency Group after the last writing RunnableEntity has terminated. Please note that a Coherent Implicit Data Access can be defined for VariableAccess'es to same and different data element. Nevertheless all Coherent Implicit Data Access'es of one Coherency Group have to be executed in the same task.
      boolean RteImmediateBufferUpdate: set at pre-compile, default-value=false  # If set to true the RTE will perform preemption area specific buffer update immediately before (for VariableAccess in the role dataReadAccess) resp. after (for VariableAccess in the role dataWriteAccess) Runnable execution. / TRUE：RTEは、応答の前(ロールdataReadAccessのVariableAccessの場合)およびランナブルの実行後(ロールdataWriteAccessのVariableAccessの場合)に、プリエンプション領域固有のバッファー更新を即座に実行する。 ※現行のQINeSでは未使用。
      foreign reference RteVariableReadAccessRef [0..*]: multiplicity set at pre-compile, set at pre-compile, destination-type=VARIABLE-ACCESS  # Reference to the VariableAccess in the dataReadAccess role. / dataReadAccessロールのVariableAccessへの参照。 ※現行のQINeSでは未使用。
      foreign reference RteVariableWriteAccessRef [0..*]: multiplicity set at pre-compile, set at pre-compile, destination-type=VARIABLE-ACCESS  # Reference to the VariableAccess in the dataWriteAccess role. / dataWriteAccessロールのVariableAccessへの参照。 ※現行のQINeSでは未使用。
      instance reference RteSoftwareComponentInstanceRef [1..*]: multiplicity set at pre-compile, set at pre-compile, destination-context=ROOT-SW-COMPOSITION-PROTOTYPE, destination-type=SW-COMPONENT-PROTOTYPE  # Reference to a SwComponentPrototype. / SwComponentPrototypeへの参照。 ※現行のQINeSでは未使用。 | This denotes the instances of the VariableAccess belonging to the RteImplicitCommunication.
    container RteInitializationBehavior [0..0]  # Specifies the initialization strategy for variables allocated by RTE with the purpose to implement VariableDataPrototypes. / VariableDataPrototype の実装を目的として、RTEによって割り当てられた変数の初期化ストラテジーを指定する。 コンテナは、RteSectionInitializationPolicyのセットと、このセットに適用できる1つのRteInitializationStrategyを定義する。 ※現行のQINeSでは未使用。 | The container defines a set of RteSectionInitializationPolicys and one RteInitializationStrategy which is applicable for this set.
      enumeration RteInitializationStrategy: {RTE_INITIALIZATION_STRATEGY_AT_DATA_DECLARATION, RTE_INITIALIZATION_STRATEGY_AT_DATA_DECLARATION_AND_PARTITION_RESTART, RTE_INITIALIZATION_STRATEGY_AT_RTE_START_AND_PARTITION_RESTART, RTE_INITIALIZATION_STRATEGY_NONE}, set at pre-compile  # Definition of the initialization strategy applicable for the SectionInitializationPolicys selected by RteSectionInitializationPolicy. / RteSectionInitializationPolicyによって選択されたSectionInitializationPolicysに適用される初期化ストラテジーの定義。 ※現行のQINeSでは未使用。
      string RteSectionInitializationPolicy [1..*]: multiplicity set at pre-compile, set at pre-compile  # This parameter describes the SectionInitializationPolicys for which a particular RTE initialization strategy applies. / このパラメータは、特定のRTE初期化ストラテジーを適用するSectionInitializationPolicyを記述する。 SectionInitializationPolicyは、目的とするMemorySectionの初期化を記述する。 次の値がAUTOSAR手法で標準化される。 ・NO-INIT：初期化も消去も実行されない。そのようなデータ要素を、それに値が書き込まれる前に読み取ることはできない。 ・INIT：指定した値(initValue)へのリセットのたびに初期化されるデータに使用される。 ・POWER-ON-INIT：指定した値(initValue)への「パワーオン」時に初期化されるデータに使用される。注：パワーオンリセットから次のパワーオンリセットの間に、リセットが複数回行われる場合がある。 ・CLEARED：ゼロにリセットされるたびに初期化されるデータに使用される。 ・POWER-ON-CLEARED：「パワーオン」によってゼロに初期化されるデータに使用される。注：パワーオンリセットから次のパワーオンリセットの間に、リセットが複数回行われる場合がある。 ※現行のQINeSでは未使用。 | The SectionInitializationPolicy describes the intended initialization of MemorySections. The following values are standardized in AUTOSAR Methodology: * '''NO-INIT''': No initialization and no clearing is performed. Such data elements must not be read before one has written a value into it. * '''INIT''': To be used for data that are initialized by every reset to the specified value (initValue). * '''POWER-ON-INIT''': To be used for data that are initialized by "Power On" to the specified value (initValue). Note: there might be several resets between power on resets. * '''CLEARED''': To be used for data that are initialized by every reset to zero. * '''POWER-ON-CLEARED''': To be used for data that are initialized by "Power On" to zero. Note: there might be several resets between power on resets.
    container RteInitializationRunnableBatch [0..*]  # This container corresponds to an Rte_Init_<shortName of this container> function invoking the mapped RunnableEntities.
    container RteOsInteraction [1..*]  # Interaction of the Rte with the Os. / RteのOsとのインタラクション。
      container RteModeToScheduleTableMapping [0..*]  # Provides configuration input in which Modes of a ModeDeclarionGroupPrototype of a Mode Manager a OsScheudleTable shall be active. / OsScheudleTableがアクティブになる、モードマネージャのModeDeclarionGroupPrototypeのモードのコンフィグレーションの入力を提供する。モードマネージャーは、SwComponentPrototype(RteModeSchtblMapSwc)またはBSW-Module(RteModeSchtblMapBsw)として指定される。 | The Mode Manager is either specified as a SwComponentPrototype (RteModeSchtblMapSwc) or as a BSW-Module (RteModeSchtblMapBsw).
        foreign reference RteModeSchtblMapModeDeclarationRef [1..*]: multiplicity set at pre-compile, set at pre-compile, destination-type=MODE-DECLARATION  # Reference to the ModeDeclarations. / ModeDeclarationへの参照。
        reference RteModeScheduleTableRef: set at pre-compile, destination=OsScheduleTable  # Reference to the OsScheduleTable which shall be active in the specified RteModeSchblMapModeDeclarationRefs. / 指定したRteModeSchblMapModeDeclarationRefsで活性化されるOsScheduleTableへの参照。
        container RteModeSchtblMapBsw [0..1]  # Specifies an instance of a ModeDeclarationGroupPrototype of a Bsw-Module. / Bsw-ModuleのModeDeclarationGroupPrototypeのインスタンスを指定する。
          foreign reference RteModeSchtblMapBswProvidedModeGroupRef: set at pre-compile, destination-type=MODE-DECLARATION-GROUP-PROTOTYPE  # Reference to an instance of a ModeDeclarationGroupPrototype of a Bsw-Module. / Bsw-ModuleのModeDeclarationGroupPrototypeのインスタンスへの参照。
          reference RteModeSchtblMapBswInstanceRef: set at pre-compile, destination=RteBswModuleInstance  # Reference to an instance specification of a Bsw-Module. / Bsw-Moduleのインスタンスを特定する参照。
        container RteModeSchtblMapSwc [0..1]  # Specifies an instance of a ModeDeclarationGroupPrototype of a SwComponentPrototype. / SwComponentPrototypeのModeDeclarationGroupPrototypeのインスタンスを指定する。
          foreign reference RteModeSchtblMapSwcPortRef: set at pre-compile, destination-type=ABSTRACT-PROVIDED-PORT-PROTOTYPE  # Reference to the PPortPrototype of a SwComponentPrototype. / SwComponentPrototypeのPPortPrototypeへの参照。
          reference RteModeSchtblMapSwcInstanceRef: set at pre-compile, destination=RteSwComponentInstance  # Reference to an instance specification of a SwComponentPrototype. / SwComponentPrototypeのインスタンスを特定する参照。
      container RteSyncPoint [0..0]  # The RteSyncPoint is necessary to provide an cross core synchronization in case of RteEvents triggered by the same event source but mapped to tasks belonging to different partitions on different cores. | The synchronization point must be reached by all referencing RteEvents before the execution in all related tasks is continued. In case of Rte(Bsw)EventSuccessorSyncPointRef the ExecutableEntity activated by the mapped event is executed before the synchronization point is entered. In case of Rte(Bsw)EventPredecessorSyncPointRef the ExecutableEntity activated by the mapped event is executed after the synchronization point is passed.
      container RteUsedOsActivation [0..*]  # Attributes used in the activation of OsTasks and Runnable Entities. / OsTaskとランナブルエンティティの活性化で使用される属性。 ※現行のQINeSでは未使用。
        float RteExpectedActivationOffset: 0..Inf, set at pre-compile  # Activation offset in seconds. / 活性化オフセット(秒単位)。 重要：これは、RteからOs/Mcuセットアップに対する要件である。Rteジェネレータは、この活性化オフセットが満たされていることを前提とする。 ※現行のQINeSでは未使用。 | Important: This is a requirement from the Rte towards the Os/Mcu setup. The Rte Generator shall assume this activation offset to be fulfilled.
        float RteExpectedTickDuration: 0..Inf, set at pre-compile  # The expected tick duration in seconds which shall be configured to drive the OsScheduleTables or OsAlarm. / 期待される秒単位のティック期間。OsScheduleTableまたはOsAlarmを発生させるために構成される。 重要：これは、RteからOs/Mcuセットアップに対する要件である。Rteジェネレータは、このティック期間が満たされていることを前提とする。 ※現行のQINeSでは未使用。 | Important: This is a requirement from the Rte towards the Os/Mcu setup. The Rte Generator shall assume this tick duration to be fulfilled.
        reference RteActivationOsAlarmRef [0..1]: multiplicity set at pre-compile, set at pre-compile, destination=OsAlarm  # Reference to an OsAlarm. / OsAlarmへの参照。 ※現行のQINeSでは未使用。
        reference RteActivationOsSchTblRef [0..1]: multiplicity set at pre-compile, set at pre-compile, destination=OsScheduleTable  # Reference to an OsScheduleTable. / OsScheduleTableへの参照。 ※現行のQINeSでは未使用。
        reference RteActivationOsTaskRef [0..1]: multiplicity set at pre-compile, set at pre-compile, destination=OsTask  # Reference to an OsTask. / OsTaskへの参照。 ※現行のQINeSでは未使用。
    container RtePostBuildVariantConfiguration [0..0]  # Specifies the PostbuildVariantSets for each of the PostBuild configurations of the RTE. / RTEの各PostBuild configurationのPostbuildVariantSetを指定する。 このコンテナのshortNameはRtePostBuildVariantの名前を定義する。 ※現行のQINeSでは未使用。 | The shortName of this container defines the name of the RtePostBuildVariant.
      foreign reference RtePostBuildUsedPredefinedVariant [1..*]: multiplicity set at post-build in variant post-build / pre-compile in variant pre-compile, post-build-variant-multiplicity=true, post-build-variant-value=true, set at post-build in variant post-build / pre-compile in variant pre-compile, destination-type=PREDEFINED-VARIANT  # Reference to the PredefinedVariant element which defines the values for PostBuildVariationCriterion elements. / PostBuildVariationCriterion要素の値を定義するPredefinedVariant要素への参照。 ※現行のQINeSでは未使用。
    container RteSwComponentInstance [0..*]  # Representation of one SwComponentPrototype located on the to be configured ECU. All subcontainer configuration aspects are in relation to this SwComponentPrototype. / 構成するECUにある1つのSwComponentPrototypeの表現。すべてのサブコンテナコンフィグレーションの側面は、このSwComponentPrototypeに関連する。 RteSwComponentInstanceは、AtomicSwComponentTypeまたはParameterSwComponentTypeと関連付けることができる。 | The RteSwComponentInstance can be associated with either a AtomicSwComponentType or ParameterSwComponentType.
      foreign reference RteSoftwareComponentInstanceRef [0..1]: multiplicity set at pre-compile, set at pre-compile, destination-type=SW-COMPONENT-PROTOTYPE  # Reference to a SwComponentPrototype. / SwComponentPrototypeへの参照。
      container RteEventToTaskMapping [0..*]  # Maps an instance of a RunnableEntity onto one OsTask based on the activating RTEEvent. / 活性化しているRTEEventに基づいて、RunnableEntityを1つのOsTaskにマッピングする。RunnableEntityが関数の直接呼び出しから実行されるとしても、このRteEventToTaskMappingは指定する必要がある。ただし、RteMappedToTask要素とRtePositionInTask要素は指定されない。 | In the case of a RunnableEntity executed via a direct function call this RteEventToTaskMapping is still specified but no RteMappedToTask element is included. The RtePositionInTask parameter is necessary to provide an ordering of events invoked by the same RTE API.
        float RteActivationOffset [0..0]: 0..Inf, multiplicity set at pre-compile, set at pre-compile  # Activation offset in seconds. / 活性化オフセット(秒単位)。 ※現行のQINeSでは未使用。
        boolean RteImmediateRestart [0..0]: set at pre-compile, default-value=false  # When RteImmediateRestart is set to true the RunnableEntitiy shall be immediately re-started after termination if it was activated by this RTEEvent while it was already started. / RteImmediateRestartがtrueに設定されると、既に起動されているときにこのRTEEventによって活性化されたRunnableEntitiyは、終了後に即座に再起動する。 マッピングされたRTEEventが、minimumStartInterval属性が0より大きい値に設定された RunnableEntityを参照している場合、このパラメータをtrueに設定することはできない。 ※現行のQINeSでは未使用。 | This parameter shall not be set to true when the mapped RTEEvent refers to a RunnableEntity which minimumStartInterval attribute is > 0.
        enumeration RteOsSchedulePoint [0..1]: {CONDITIONAL, NONE, UNCONDITIONAL}, multiplicity set at pre-compile, set at pre-compile  # Introduce a schedule point by explicitly calling Os Schedule service after the execution of the ExecutableEntity. The Rte generator is allowed to optimize several consecutive calls to Os schedule into one single call if the ExecutableEntity executions in between have been skipped. / ExecutableEntityの実行後にOs Scheduleサービスを明示的に呼び出すことで、スケジュールポイントを導入する。Rteジェネレータは、中間のExecutableEntityの実行が省略されている場合、連続するいくつかのOs Schedule呼び出しを1つの呼び出しに統合して最適化できる。 このパラメータがない場合は、"NONE" として解釈される。 タスクをプリエンプティブにでき、このパラメータの値が "NONE" にされていない、またはパラメータがない場合、これは無効な構成と見なされる。 | The absence of this parameter is interpreted as "NONE". It shall be considered an invalid configuration if the task is preemptable and the value of this parameter is not set to "NONE" or the parameter is absent.
        integer RtePositionInTask [0..1]: 0..65535, multiplicity set at pre-compile, set at pre-compile  # Each RunnableEntity mapped to an OsTask has a specific position within the task execution. / OsTaskにマッピングされた各RunnableEntityは、タスク実行内に特定の位置を持つ。定期的な活性化では、これが実行順序になる。イベントドライバの活性化では、これは実際のRunnableEntityが実行される評価順序となる。 | For periodic activation this is the order of execution. For event driver activation this is the order of evaluation which actual RunnableEntity has to be executed. In case of direct function calls this parameter is necessary to provide an ordering of events when several ExecutableEntities are invoked by the same RTE API.
        foreign reference RteEventRef: set at pre-compile, destination-type=RTE-EVENT  # Reference to the description of the RTEEvent which is pointing to the RunnableEntity being mapped. This allows a fine grained mapping of RunnableEntites based on the activating RTEEvent. / マッピングされているRunnableEntityをポイントするRTEEventの記述への参照。これにより、活性化しているRTEEventに基づいた、RunnableEntityの詳細なマッピングが可能になる。
        reference RteEventPredecessorSyncPointRef [0..0]: multiplicity set at pre-compile, set at pre-compile, destination=RteSyncPoint  # The RteEventPredecessorSyncPointRef is necessary to provide a cross core synchronization in case of RteEvents triggered by the same event source but mapped to tasks belonging to different partitions on different cores. | The synchronization point must be reached by all referencing RteEvents before the execution in all related tasks is continued. In case of RteEventPredecessorSyncPointRef the RunnableEntity activated by the mapped RteEvent is executed after the synchronization point is passed.
        reference RteEventSuccessorSyncPointRef [0..0]: multiplicity set at pre-compile, set at pre-compile, destination=RteSyncPoint  # The RteEventSuccessorSyncPointRef is necessary to provide a cross core synchronization in case of RteEvents triggered by the same event source but mapped to tasks belonging to different partitions on different cores. | The synchronization point must be reached by all referencing RteEvents before the execution in all related tasks is continued. In case of RteEventSuccessorSyncPointRef the RunnableEntity activated by the mapped RteEvent is executed before the synchronization point is entered.
        reference RteMappedToTaskRef [0..1]: multiplicity set at pre-compile, set at pre-compile, destination=OsTask  # Reference to the OsTask the RunnableEntity activated by the RteEventRef is mapped to. / RteEventRefによって活性化されたRunnableEntityがマッピングされているOsTaskへの参照。OsTaskへの参照が指定されていない場合、RunnableEntityは関数の直接呼び出しによって実行される。 | If no reference to the OsTask is specified the RunnableEntity shall be executed via a direct function call. The fact that no reference to an OsTask is specified for a RunnableEntity does not necessarily imply that every RTE generator has to support the implementation of this RunnableEntity as a direct function call. The standard set of use cases for direct function calls that has to be supported by every RTE generator is explicitly stated as requirements in this document. For further optimization RTE vendors are free to support additional scenarios of direct function call implementations that are not explicitly required in this document.
        reference RteUsedInitFnc [0..1]: multiplicity set at pre-compile, set at pre-compile, destination=RteInitializationRunnableBatch  # The RunnableEntity is executed during initialization in the context of the Rte_Init_<InitContainer> function.
        reference RteUsedOsAlarmRef [0..1]: multiplicity set at pre-compile, set at pre-compile, destination=OsAlarm  # If an OsAlarm is used to activate the OsTask this RteEvent is mapped to it shall be referenced here. / OsAlarmを使用して、このRteEventがマッピングされるOsTaskを活性化する場合、ここでそれが参照される。 ※現行のQINeSでは未使用。
        reference RteUsedOsEventRef [0..1]: multiplicity set at pre-compile, set at pre-compile, destination=OsEvent  # If an OsEvent is used to activate the OsTask this RteEvent is mapped to it shall be referenced here. / OsEventを使用して、このRteEventがマッピングされるOsTaskを活性化する場合、ここでそれが参照される。
        reference RteUsedOsSchTblExpiryPointRef [0..1]: multiplicity set at pre-compile, set at pre-compile, destination=OsScheduleTableExpiryPoint  # If an OsScheduleTableExpiryPoint is used to activate the OsTask this RteEvent is mapped to it shall be referenced here. / OsScheduleTableExpiryPointを使用して、このRteEventがマッピングされるOsTaskを活性化する場合、ここでそれが参照される。 ※現行のQINeSでは未使用。
        reference RteVirtuallyMappedToTaskRef [0..1]: multiplicity set at pre-compile, set at pre-compile, destination=OsTask  # Optional reference to an OsTask where the activation of this RteEvent shall be evaluated. The actual execution of the Runnable Entity shall happen in the OsTask referenced by RteMappedToTaskRef. / このRteEventの活性化が評価されるOsTaskへのオプションの参照。ランナブルエンティティの実際の実行は、RteMappedToTaskRefによって参照されるOsTaskで行われる。
      container RteExclusiveAreaImplementation [0..*]  # Specifies the implementation to be used for the data consistency of this ExclusiveArea. / このExclusiveAreaのデータ整合性のために使用する実装を指定する。
        enumeration RteExclusiveAreaImplMechanism: {ALL_INTERRUPT_BLOCKING, COOPERATIVE_RUNNABLE_PLACEMENT, OS_INTERRUPT_BLOCKING, OS_RESOURCE}, set at pre-compile  # To be used implementation mechanism for the specified ExclusiveArea. / 指定したExclusiveAreaに使用される実装メカニズム。
        foreign reference RteExclusiveAreaRef: set at pre-compile, destination-type=EXCLUSIVE-AREA  # Reference to the ExclusiveArea. / ExclusiveAreaへの参照。
        reference RteExclusiveAreaOsResourceRef [0..1]: multiplicity set at pre-compile, set at pre-compile, destination=OsResource  # Optional reference to an OsResource in case RteExclusiveAreaImplMechanism is configured to OS_RESOURCE for this ExclusiveArea. / このExclusiveAreaに対してRteExclusiveAreaImplMechanismがOS_RESOURCEに構成された場合のOsResourceへのオプションの参照。
      container RteExternalTriggerConfig [0..0]  # Defines the configuration of External Trigger Event Communication for Software Components / ソフトウェアコンポーネントの外部トリガーイベント通信のコンフィグレーションを定義する。 ※現行のQINeSでは未使用。
        integer RteTriggerSourceQueueLength: 0..4294967295, set at pre-compile, default-value=0  # Length of trigger queue on the trigger source side. / トリガーソース側でのトリガーキューの長さ。 キューはRTEによって実装される。1以上の値の場合は、キュー登録された動作が要求される。RteTriggerSourceQueueLengthの値を0に設定すると、トリガー通信をキュー登録しない実装が要求される。 トリガーエミッターに対してRteTriggerSourceQueueLengthが設定されていない場合は、既定値の0が適用される。 ※現行のQINeSでは未使用。 | The queue is implemented by the RTE. A value greater or equal to 1 requests an queued behavior. Setting the value of RteTriggerSourceQueueLength to 0 requests an none queued implementation of the trigger communication. If there is no RteTriggerSourceQueueLength configured for a Trigger Emitter the default value of 0 applies as well.
        instance reference RteSwcTriggerSourceRef: set at pre-compile, destination-context=ABSTRACT-PROVIDED-PORT-PROTOTYPE, destination-type=TRIGGER  # Reference to a Trigger instance in the pPortPrototype of the related component instance. / 関連するコンポーネントインスタンスのpPortPrototypeにあるTriggerインスタンスへの参照。 参照されるTriggerインスタンスは、このパラメータを持つRteSwComponentInstanceの構成時に、同じソフトウェアコンポーネントインスタンスに属している必要がある。 ※現行のQINeSでは未使用。 | The referenced Trigger instance has to belong to the same software component instance as the RteSwComponentInstance owning this parameter configures.
      container RteInternalTriggerConfig [0..0]  # Defines the configuration of Inter Runnable Triggering for Software Components / ソフトウェアコンポーネントのランナブル間トリガーのコンフィグレーションを定義する。 ※現行のQINeSでは未使用。
        integer RteTriggerSourceQueueLength: 0..4294967295, set at pre-compile, default-value=0  # Length of trigger queue on the trigger source side. / トリガーソース側でのトリガーキューの長さ。 キューはRTEによって実装される。1以上の値の場合は、キュー登録された動作が要求される。RteTriggerSourceQueueLengthの値を0に設定すると、トリガー通信をキュー登録しない実装が要求される。 トリガーエミッターに対してRteTriggerSourceQueueLengthが設定されていない場合は、既定値の0が適用される。 ※現行のQINeSでは未使用。 | The queue is implemented by the RTE. A value greater or equal to 1 requests an queued behavior. Setting the value of RteTriggerSourceQueueLength to 0 requests an none queued implementation of the trigger communication. If there is no RteTriggerSourceQueueLength configured for a Trigger Emitter the default value of 0 applies as well.
        foreign reference RteSwcTriggerSourceRef: set at pre-compile, destination-type=INTERNAL-TRIGGERING-POINT  # Reference to an InternalTriggeringPoint of the related component instance. / 関連するコンポーネントインスタンスのpPortPrototypeにあるTriggerインスタンスへの参照。 参照されるTriggerインスタンスは、このパラメータを持つRteSwComponentInstanceの構成時に、同じソフトウェアコンポーネントインスタンスに属している必要がある。 ※現行のQINeSでは未使用。 | The referenced InternalTriggeringPoint has to belong to the same software component instance as the RteSwComponentInstance owning this parameter configures.
      container RteNvRamAllocation [0..0]  # Specifies the relationship between the AtomicSwComponentType's NVRAMMapping / NVRAM needs and the NvM module configuration. / AtomicSwComponentTypeのNVRAMMapping/NVRAMニーズとNvMモジュールコンフィグレーションの関係を指定する。 ※現行のQINeSでは未使用。
        linker symbol RteNvmRamBlockLocationSymbol [0..1]: multiplicity set at pre-compile, set at pre-compile  # This is the name of the linker object name where the NVRam Block will be mirrored by the Nvm. / これは、NVRamブロックがNvmによってミラーリングされるリンカーオブジェクトの名前である。このシンボルは、"NvmBlockDescriptor"からパラメータ"NvmRamBlockDataAddress"に解決される。 ※現行のQINeSでは未使用。 | This symbol will be resolved into the parameter "NvmRamBlockDataAddress" from the "NvmBlockDescriptor".
        linker symbol RteNvmRomBlockLocationSymbol [0..1]: multiplicity set at pre-compile, set at pre-compile  # This is the name of the linker object name where the NVRom Block will be accessed by the Nvm. / これは、NVRomブロックがNvmによってアクセスされるリンカーオブジェクトの名前である。このシンボルは、"NvmBlockDescriptor"からパラメータ"NvmRomBlockDataAddress"に解決される。 ※現行のQINeSでは未使用。 | This symbol will be resolved into the parameter "NvmRomBlockDataAddress" from the "NvmBlockDescriptor".
        foreign reference RteSwNvBlockDescriptorRef [0..1]: multiplicity set at pre-compile, set at pre-compile, destination-type=NV-BLOCK-DESCRIPTOR  # Reference to the NvBlockDescriptor in case the RTE needs to call the NvM directly (e.g. for the supportDirtyFlag feature). | XOR
        foreign reference RteSwNvRamMappingRef [0..1]: multiplicity set at pre-compile, set at pre-compile, destination-type=SWC-SERVICE-DEPENDENCY  # Reference to the SwSeriveDependency which is used to specify the NvBlockNeeds. / NvBlockNeedsを指定するために使用されるSwSeriveDependencyへの参照。 ※現行のQINeSでは未使用。
        symbolic name reference RteNvmBlockRef: set at pre-compile, destination=NvMBlockDescriptor  # Reference to the used NvM block for storage of the NVRAMMapping information. / NVRAMMapping情報のストレージに使用されるNvMブロックへの参照。 ※現行のQINeSでは未使用。
      container RteQinesSynchronousServerCallReturnsEvent [0..*]
        reference RteQinesOsEventRef: origin=QINeS, set at pre-compile, destination=OsEvent
        reference RteQinesOsTaskRef: origin=QINeS, set at pre-compile, destination=OsTask
        foreign reference RteQinesSynchronousServerCallPointRef: origin=QINeS, set at pre-compile, destination-type=SYNCHRONOUS-SERVER-CALL-POINT
    container RteSwComponentType [0..*]  # Representation of one SwComponentType for the base of all configuration parameter which are affecting the whole type and not a specific instance. / 特定のインスタンスではなく、全タイプに影響する、すべてのコンフィグレーションパラメータの基盤となる1つのSwComponentTypeの表現。
      boolean RteBypassSupportEnabled [0..0]: multiplicity set at pre-compile, set at pre-compile, default-value=false  # Individual switch to enable the bypass support for this software component type.
      foreign reference RteComponentTypeRef: set at pre-compile, destination-type=SW-COMPONENT-TYPE  # Reference to either AtomicSwComponentType or ParameterSwComponentType. / AtomicSwComponentTypeまたはParameterSwComponentTypeへの参照。
      foreign reference RteImplementationRef [0..1]: multiplicity set at pre-compile, set at pre-compile, destination-type=SWC-IMPLEMENTATION  # The Implementation which shall be assigned to the SwComponentType. / SwComponentTypeに割り当てられる実装。 ※現行のQINeSでは未使用。
      container RteComponentTypeCalibration [0..0]  # Specifies for each ParameterSwComponentType or AtomicSwComponentType whether calibration is enabled. / 各ParameterSwComponentTypeまたはAtomicSwComponentTypeに対してキャリブレーションを有効にするかどうかを指定する。RteCalibrationSwAddrMethodRefでSwAddrMethodへの参照が提供されると、参照されるSwAddrMethodを持つParameterDataPrototypeだけでキャリブレーションのサポートが有効になる。 ※現行のQINeSでは未使用。 | If references to SwAddrMethod are provided in RteCalibrationSwAddrMethodRef only ParameterDataPrototypes with the referenced SwAddrMethod shall have software calibration support enabled.
        boolean RteCalibrationSupportEnabled: set at pre-compile  # Enables calibration support for the specified ParameterSwComponentType or AtomicSwComponentType. / キャリブレーションサポートを指定したParameterSwComponentTypeまたはAtomicSwComponentTypeに対して有効にする。 ※現行のQINeSでは未使用。
        foreign reference RteCalibrationSwAddrMethodRef [0..*]: multiplicity set at pre-compile, set at pre-compile, destination-type=SW-ADDR-METHOD  # Reference to the SwAddrMethod for which software calibration support shall be enabled. / ソフトウェアキャリブレーションサポートを有効にするSwAddrMethod。 ※現行のQINeSでは未使用。

AUTOSAR XML (schema 4-2-2)
package /QINeS
  ecuc definition collection AUTOSARParameterDefinition: module=Det
  module definition Det [0..1]: refined-module-def=Det, variants pre-compile  # Det configuration includes the functions to be called at notification. On one / 通知機能を含むDetモジュールのコンフィグレーション。 | side the application functions are specified and in general it can be decided whether Dlt shall be called at each call of Det.
    container DetConfigSet [0..1]  # Configuration set container for Det.
      container DetModule [0..*]  # This container describes a non BSW module that is using the Det via Service Interface.
        integer DetModuleId: 4096..65535, set at pre-compile  # Only if the parameter is present and set to true, the Det requires the Dlt interface and forwards it's call to the function Dlt_DetForwardErrorTrace. In this case the optional interface to Dlt_Det is required.
    container DetGeneral  # Generic configuration parameters of the Det module. / Detモジュールのジェネラルコンフィグレーションパラメータ。
      boolean DetForwardToDlt: multiplicity set at pre-compile, set at pre-compile, default-value=false  # Only if the parameter is present and set to true, the Det requires the Dlt interface and forwards it's call to the function Dlt_DetForwardErrorTrace. In this case the optional interface to Dlt_Det is required. / Dltモジュールと連携する／しないを設定。 TRUE：Dltモジュールと連携する FALSE：Dltモジュールと連携しない
      boolean DetQDetnotificationEnabled: set at pre-compile, origin=QINeS, default-value=false  # DetNotificationコンテナを生成するかしないかを決める。 TRUE：エラーフック有効 FALSE：エラーフック無効
      function name DetReportRuntimeErrorCallout: set at pre-compile  # This parameter defines the existence and the name of a callout function for the corresponding runtime error handler.
      function name DetReportTransientFaultCallout: set at pre-compile  # This parameter defines the existence and the name of a callout function for the corresponding transient fault handler.
      boolean DetVersionInfoApi: set at pre-compile, default-value=true  # Pre-processor switch to enable / disable the API to read out the modules version information. / Det_GetVersionInfo関数の有効／無効スイッチ。 TRUE：Det_GetVersionInfo関数は有効 FALSE：Det_GetVersionInfo関数は無効 | true: Version info API enabled. false: Version info API disabled.
    container DetNotification [0..1]  # Configuration of the notification functions. / 通知機能のコンフィグレーション。
      function name DetErrorHook [0..65535]: multiplicity set at pre-compile, set at pre-compile  # Optional list of functions to be called by the Default Error Tracer in context of each call of Det_ReportError. / エラーフック関数のリストのポインタ。 Det_ErrorHookType型の配列を用意し、エラーフック関数のアドレスを定義した上で、その配列の先頭アドレスを設定すること。 使用しない場合は設定しないこと。 | The type of these functions shall be identical the type of Det_ReportError itself: Std_ReturnType (*f)(uint16, uint8, uint8, uint8).
      string DevErrorProcessFile [0..*]: set at pre-compile, origin=QINeS  # include file lists. / ファイル一覧を含む。

AUTOSAR XML (schema 4-2-2)
package /QINeS
  ecuc definition collection AUTOSARParameterDefinition: module=WdgM
  module definition WdgM [0..1]: refined-module-def=WdgM, post-build-variant-support=true, variants post-build/pre-compile  # Configuration of the WdgM (Watchdog Manager) module. / WdgMモジュールのコンフィグレーション。
    container WdgMConfigSet [1..65535]  # This container describes one of multiple configuration sets of WdgM. / WdgMのMultipleConfigurationContainerである。
      symbolic name reference WdgMDeInitialMode: set at post-build in variant post-build / pre-compile in variant pre-compile, origin=QINeS, destination=WdgMMode  # The mode that the Watchdog Manager is in after it has been initialized. / 本モジュールで提供する監視モードのうち、終了処理関数WdgM_Initの呼び出し後に使用される監視モードをWdgMModeから選択してここに設定する。
      symbolic name reference WdgMInitialMode: post-build-variant-value=true, set at post-build in variant post-build / pre-compile in variant pre-compile, destination=WdgMMode  # The mode that the Watchdog Manager is in after it has been initialized. / 本モジュールで提供する監視モードのうち、初期化関数WdgM_Initの呼び出し後に使用される監視モードをWdgMModeから選択してここに設定する。 この監視モードで設定するタイムアウト値（WdgMTriggerConditionValue）は、次にタイムアウト値が更新されるまでウォッチドッグリセットがかからないことを保証する必要がある。
      symbolic name reference WdgMQWatchdogCore: set at post-build in variant post-build / pre-compile in variant pre-compile, origin=QINeS, destination=EcucCoreDefinition  # - / 対象のコアID。
      container WdgMDemEventParameterRefs [0..0]  # Container for the references to DemEventParameter elements which shall be invoked using the API Dem_ReportErrorStatus API in case the corresponding error occurs. The EventId is taken from the referenced DemEventParameter's DemEventId value. The standardized errors are provided in the container and can be extended by vendor specific error references. / 未使用
        symbolic name reference WDGM_E_IMPROPER_CALLER [0..1]: multiplicity set at post-build in variant post-build / pre-compile in variant pre-compile, post-build-variant-multiplicity=true, post-build-variant-value=true, set at post-build in variant post-build / pre-compile in variant pre-compile, destination=DemEventParameter  # Reference to the DemEventParameter which shall be issued when the defensive behavior checks have detected an improper caller. Tags: atp.Status=obsolete, atp.StatusComment=This reference is set to obsolete and will be removed in R 4.3, atp.StatusRevisionBegin=4.2.2 / 未使用
        symbolic name reference WDGM_E_MONITORING [0..1]: multiplicity set at post-build in variant post-build / pre-compile in variant pre-compile, post-build-variant-multiplicity=true, post-build-variant-value=true, set at post-build in variant post-build / pre-compile in variant pre-compile, destination=DemEventParameter  # Reference to the DemEventParameter which shall be issued when the error "Monitoring has failed (Global Supervision Status has reached WDGM_GLOBAL_STATUS_STOPPED) and a watchdog reset will occur" has occurred. Tags: atp.Status=obsolete, atp.StatusComment=use WDGM_E_SUPERVISION instead, atp.StatusRevisionBegin=4.2.2 / 未使用
        symbolic name reference WDGM_E_SET_MODE [0..1]: multiplicity set at post-build in variant post-build / pre-compile in variant pre-compile, post-build-variant-multiplicity=true, post-build-variant-value=true, set at post-build in variant post-build / pre-compile in variant pre-compile, destination=DemEventParameter  # Reference to the DemEventParameter which shall be issued when the error "Watchdog drivers' mode switch has failed" has occurred. / 未使用
        symbolic name reference WDGM_E_SUPERVISION [0..1]: multiplicity set at post-build in variant post-build / pre-compile in variant pre-compile, post-build-variant-multiplicity=true, post-build-variant-value=true, set at post-build in variant post-build / pre-compile in variant pre-compile, destination=DemEventParameter  # Reference to the DemEventParameter which shall be issued when the error "Supervision has failed (Global Supervision Status has reached WDGM_GLOBAL_STATUS_STOPPED) and a watchdog reset will occur" has occurred.
      container WdgMMode [1..255]  # The container describes one of several modes of the Watchdog Manager. / 本モジュールで提供する監視モードの情報を格納する領域（WdgMMode）へのアドレスを設定する。
        integer WdgMExpiredSupervisionCycleTol: 0..65535, scope=ECU, post-build-variant-value=true, set at post-build in variant post-build / pre-compile in variant pre-compile  # This parameter shall be used to define a value that fixes the amount of expired supervision cycles for how long the blocking of watchdog triggering shall be postponed, AFTER THE GLOBAL SUPERVISION STATUS HAS REACHED THE STATE EXPIRED. / 対象の監視モードでグローバル監視ステータスが重故障状態（WDGM_GLOBAL_STATUS_EXPIRED）に陥ってからウォッチドッグリセットをかけるまでの監視回数を設定する。 この値により、ウォッチドッグリセットの実行を遅らせることができる。（ただし、重故障状態から故障状態もしくは正常状態に戻ることはない）
        integer WdgMModeId: 0..255, set at pre-compile, symbolic-name-value=true  # This parameter fixes the identifier for the mode. This identifier is for instance passed as a parameter to the WdgM_SetMode service. / 本モジュールの監視モードを識別する番号を設定する。 この値は0からの連続値となる。
        float WdgMSupervisionCycle: 0..4294.967295, scope=ECU, set at pre-compile  # This parameter defines the schedule period of the main function WdgM_MainFunction. / 本モジュールの周期関数WdgM_MainFunctionの呼び出し周期を設定する。 [sec]単位（小数第六位まで入力可）。 | Unit: [s]
        container WdgMAliveSupervision [0..65535]  # This container collects all configuration parameters of Alive-Supervision of one Checkpoint. Note that each Checkpoint may have different parameters. For example, it may have different min and max margin. / 対象の監視モードで実施するアライブ監視に関する情報格納用コンテナ。 モードに依存し、WdgMNumOfWdgMAliveSupervisionの数だけこの情報を定義する。 WdgMNumOfWdgMAliveSupervisionが0の場合、このコンテナは生成されない。
          integer WdgMExpectedAliveIndications: 0..65535, post-build-variant-value=true, set at post-build in variant post-build / pre-compile in variant pre-compile  # This parameter contains the amount of expected alive indications of the Checkpoint within the referenced amount of defined supervision cycles according to corresponding SE. / 対象の監視モードおよびWdgMSupervisionReferenceCycleの値に応じて決まる、アライブチェックポイント通過回数期待値を設定する。
          integer WdgMMaxMargin: 0..255, post-build-variant-value=true, set at post-build in variant post-build / pre-compile in variant pre-compile  # This parameter contains the amount of alive indications of the Checkpoint that are acceptable to be additional to the expected alive indications within the corresponding supervision reference cycle. / 対象のSEのアライブカウンタ期待値WdgMExpectedAliveIndicationsに対して、アライブカウンタの許容誤差上限を設定する。
          integer WdgMMinMargin: 0..255, post-build-variant-value=true, set at post-build in variant post-build / pre-compile in variant pre-compile  # This parameter contains the amount of alive indications of the Checkpoint that are acceptable to be missed from the expected alive indications within the corresponding supervision reference cycle. / 対象のSEのアライブカウンタ期待値WdgMExpectedAliveIndicationsに対して、アライブカウンタの許容誤差下限を設定する。
          integer WdgMSupervisionReferenceCycle: 1..65535, post-build-variant-value=true, set at post-build in variant post-build / pre-compile in variant pre-compile  # This parameter shall contain the amount of supervision cycles to be used as reference by the alive-supervision mechanism to perform the checkup with counted alive indications according to corresponding SE. / 対象の監視モードにおいてアライブカウンタとAI（アライブカウンタ期待値WdgMExpectedAliveIndications）を比較し、アライブ監視結果を計算する単位監視サイクル数を設定する。 ここで設定した回数のWdgM_MainFunctionの呼び出しに対してアライブ監視結果が１回計算される。
          symbolic name reference WdgMAliveSupervisionCheckpointRef: post-build-variant-value=true, set at post-build in variant post-build / pre-compile in variant pre-compile, destination=WdgMCheckpoint  # Reference to Checkpoint within a Supervised Entity that shall be supervised. / 対象の監視モード内でアライブ監視を実施するSE内部に設置するチェックポイントのCPIDを設定する。
        container WdgMDeadlineSupervision [0..65535]  # This container collects all configuration parameters for Deadline Supervision for a Supervised Entity. / 対象の監視モードで実施するデッドライン監視に関する情報格納用コンテナである。 監視モードに依存し、WdgMNumOfWdgMDeadlineSupervisionの数だけこの情報を定義する。 WdgMNumOfWdgMDeadlineSupervisionが0の場合、このコンテナは生成されない。
          float WdgMDeadlineMax: 0..4294.967295, post-build-variant-value=true, set at post-build in variant post-build / pre-compile in variant pre-compile  # This parameter contains the longest time span after which the deadline is considered to be met. / 対象の監視モードで実施されるデッドライン監視について、2点間の通過にかかる時間の許容最大値を設定する。 [sec]単位（小数第六位まで入力可）。 | Unit: [s]
          float WdgMDeadlineMin: 0..4294.967295, post-build-variant-value=true, set at post-build in variant post-build / pre-compile in variant pre-compile  # This parameter contains the shortest time span after which the deadline is considered to be met. / 対象の監視モードで実施されるデッドライン監視について、2点間の通過にかかる時間の許容最小値を設定する。 [sec]単位（小数第六位まで入力可）。 | Unit: [s]
          symbolic name reference WdgMDeadlineStartRef: post-build-variant-value=true, set at post-build in variant post-build / pre-compile in variant pre-compile, destination=WdgMCheckpoint  # This is the reference to the start Checkpoint for Deadline Supervision. / 対象の監視モードでデッドライン監視を実施するためのデッドラインスタートポイントとするチェックポイントのCPIDを設定する。
          symbolic name reference WdgMDeadlineStopRef: post-build-variant-value=true, set at post-build in variant post-build / pre-compile in variant pre-compile, destination=WdgMCheckpoint  # This is the reference to the stop Checkpoint for Deadline Supervision. / 対象の監視モードでデッドライン監視を実施するためのデッドラインエンドポイントとするチェックポイントのCPIDを設定する。
        container WdgMExternalLogicalSupervision [0..65535]  # This container collects all configuration parameters for Logical Supervision for one external graph. / 対象の監視モードで実施するエクスターナルロジック監視に関する情報格納用コンテナである。 監視モードに依存し、WdgMNumOfWdgMExternalLogicalSupervisionの数だけこの情報を定義する。 WdgMNumOfWdgMExternalLogicalSupervisionが0の場合、このコンテナは生成されない。
          symbolic name reference WdgMExternalCheckpointFinalRef [1..65535]: multiplicity set at post-build in variant post-build / pre-compile in variant pre-compile, post-build-variant-multiplicity=true, post-build-variant-value=true, set at post-build in variant post-build / pre-compile in variant pre-compile, destination=WdgMCheckpoint  # This is the reference to the final Checkpoint(s) for this External Graph. / 対象のエクスターナルロジック監視のグラフのエンドチェックポイント一覧の情報格納領域へのアドレスを設定する。 エンドチェックポイント一覧の格納領域には、対象チェックポイントのCPIDを設定する。
          symbolic name reference WdgMExternalCheckpointInitialRef [1..65535]: multiplicity set at post-build in variant post-build / pre-compile in variant pre-compile, post-build-variant-multiplicity=true, post-build-variant-value=true, set at post-build in variant post-build / pre-compile in variant pre-compile, destination=WdgMCheckpoint  # This is the reference to the initial Checkpoint(s) for this External Graph. / 対象のエクスターナルロジック監視のグラフの初期チェックポイント一覧の情報格納領域へのアドレスを設定する。 スタートチェックポイント一覧の情報格納領域には、対象チェックポイントのCPIDを設定する。
          container WdgMExternalTransition [0..65535]  # This container collects the Checkpoints for an External Transition across Supervised Entities. / 対象のエクスターナルロジック監視のグラフに設定するエクスターナルトランジッションの情報格納領域WdgMExternalTransitionへのアドレスを設定する。
            symbolic name reference WdgMExternalTransitionDestRef: post-build-variant-value=true, set at post-build in variant post-build / pre-compile in variant pre-compile, destination=WdgMCheckpoint  # This is the reference to the destination Checkpoint of an External Transition. / エクスターナルトランジッションの遷移先となるチェックポイントのCPIDを設定する。
            symbolic name reference WdgMExternalTransitionSourceRef: post-build-variant-value=true, set at post-build in variant post-build / pre-compile in variant pre-compile, destination=WdgMCheckpoint  # This is the reference to the source Checkpoint of an External Transition. / エクスターナルトランジッションの遷移元となるチェックポイントのCPIDを設定する。
        container WdgMLocalStatusParams [0..65535]  # This container collects all configuration parameters for the Local Status of a Supervised Entity. / 対象の監視モードで監視を実施するSEの情報を設定するコンテナである。監視モードに依存し、WdgMNumOfWdgMLocalStatusParamsの数だけこの情報を定義する。
          integer WdgMFailedAliveSupervisionRefCycleTol: 0..255, post-build-variant-value=true, set at post-build in variant post-build / pre-compile in variant pre-compile  # This parameter shall contain the acceptable amount of reference cycles with incorrect/failed alive supervisions for this Supervised Entity. / 対象SEのアライブ監視の故障許容回数を設定する。 アライブ監視の結果が“異常”となった回数がこの設定値を超えない限り、このSEは正常状態に回復可能である。
          symbolic name reference WdgMLocalStatusSupervisedEntityRef: post-build-variant-value=true, set at post-build in variant post-build / pre-compile in variant pre-compile, destination=WdgMSupervisedEntity  # This is the reference to the Supervised Entity for which the Local Status parameters are specified. / 対象の監視モードで監視を実施するSEのSEIDを設定する。
        container WdgMTrigger [0..255]  # This container collects all configuration parameters for the triggering of hardware watchdogs. / 対象の監視モードで設定する各Wdgに関する情報を設定するコンテナである。 監視モードに依存し、WDGM_Q_NUM_OF_WDGM_WATCHDOGの数だけこの情報を定義する。
          integer WdgMTriggerConditionValue: 1..65535, post-build-variant-value=true, set at post-build in variant post-build / pre-compile in variant pre-compile  # This parameter shall contain the value that is passed to WdgIf_SetTriggerCondition for this watchdog. / 対象監視モードで対象のWdgに設定するタイムアウト値[msec]を設定する。
          enumeration WdgMWatchdogMode: {WDGIF_FAST_MODE, WDGIF_OFF_MODE, WDGIF_SLOW_MODE}, post-build-variant-value=true, set at post-build in variant post-build / pre-compile in variant pre-compile  # This parameter contains the watchdog mode that shall be used for the referenced watchdog in this Watchdog Manager mode. / 対象監視モードで対象のWdgに設定するドライバモードを設定する。 ただし、WdgMOffModeEnabledがFALSEのときWDGIF_OFF_MODEを設定することはできない。 実装タイプ：WdgIf_ModeType WDGIF_FAST_MODE：Wdgドライバのセットアップ時間が短いモード WDGIF_SLOW_MODE：Wdgドライバのセットアップ時間が長いモード WDGIF_OFF_MODE：Wdgドライバのスイッチがoff | Implementation Type: WdgIf_ModeType
          symbolic name reference WdgMTriggerWatchdogRef: post-build-variant-value=true, set at post-build in variant post-build / pre-compile in variant pre-compile, destination=WdgMWatchdog  # This parameter is a reference to the configured watchdog. / Wdgドライバ関連コンテナ（WdgMWatchdog）のメンバ（WdgMWatchdogName）を設定する。
    container WdgMGeneral  # Container defines all general configuration parameters of the Watchdog Manager. / このコンテナは本モジュールで監視を実施するためのコンフィグレーションパラメータを定義する。
      integer WDGM_Q_COUNTER_ID [0..0]: 0..255, set at pre-compile, origin=QINeS  # - / デッドライン監視で使用するカウンタID。
      integer WDGM_Q_MAX_NUM_OF_ALIVE: 0..65535, set at pre-compile, origin=QINeS, default-value=2  # - / 監視対象モジュール単位におけるアライブ監視数の最大値。
      integer WDGM_Q_MAX_NUM_OF_DEADLINE: 0..65535, set at pre-compile, origin=QINeS, default-value=1  # - / 監視対象モジュール単位におけるデッドライン監視数の最大値。
      integer WDGM_Q_MAX_NUM_OF_EXTERNALLOGICAL: 0..65535, set at pre-compile, origin=QINeS, default-value=1  # - / 監視対象モジュール単位ごとのエクスターナルロジック監視数の最大数。
      integer WDGM_Q_NUM_OF_WDGM_CPTOSE: 0..65535, set at pre-compile, origin=QINeS, default-value=28  # - / チェックポイントの最大数。
      integer WDGM_Q_NUM_OF_WDGM_SUPERVISEDENTITY: 0..65535, set at pre-compile, origin=QINeS, default-value=0  # - / 監視対象モジュール数。
      integer WDGM_Q_NUM_OF_WDGM_WATCHDOG: 0..255, set at pre-compile, origin=QINeS  # - / Wdgモジュールのインスタンス数。
      boolean WDGM_Q_UPDATEALIVECOUNTER_ENABLED: set at pre-compile, origin=QINeS, default-value=false  # - / TRUE：本モジュールのアライブカウンタ更新処理WdgM_UpdateAliveCounterを使用可能にする FALSE：本モジュールのアライブカウンタ更新処理WdgM_UpdateAliveCounterを無効にする
      integer WdgMCPtoSE [0..65535]: 0..65535, set at pre-compile, origin=QINeS  # - / チェックポイントIDとSEIDの対応付けテーブルへのアドレスを設定する。 SEIDリストの配列インデックスにはチェックポイントIDが入る。 チェックポイントIDに対応するSEIDを設定する。 WdgMNumOfWdgMCPtoSEが0のときは設定しない。
      boolean WdgMCallerIdsEnabled: set at pre-compile, origin=QINeS, default-value=false  # - / 監視モード切替関数WdgM_SetModeを呼びだすモジュールを限定するかどうかを決定する。 定数マクロWDGM_Q_WDGM_CALLER_IDS_ENABLEDを設定する。 TRUE：呼び出しモジュールを限定する FALSE：呼び出しモジュールを限定しない この変数をTRUEにした場合に限り、コンフィグレーションデータWdgMCallerIdsが作成される。ユーザーはこのコンフィグレーションデータに値を設定する必要がある。
      boolean WdgMDefensiveBehavior: set at pre-compile, default-value=false  # Preprocessor switch to enable/disable the defensive behavior of the Watchdog Manager module. Tags: atp.Status=obsolete, atp.StatusComment=This parameter is set to obsolete and will be removed in R 4.3, atp.StatusRevisionBegin=4.2.2 / 本モジュールの周期関数WdgM_MainFunctionが呼ばれたとき、本モジュールが初期化済であることをチェックするかどうかを決定する。 定数マクロWDGM_DEFENSIVE_BEHAVIORと同じ値を設定する。 TRUE：初期化済チェックを実施する FALSE：初期化済チェックを実施しない
      boolean WdgMDemStoppedSupervisionReport: set at pre-compile, default-value=false  # Parameter to enable/disable the error reporting to DEM. / グローバル監視ステータスが停止状態（WDGM_GLOBAL_STATUS_STOPPED）となったとき、ウォッチドッグリセットがかかることを実行時エラーとしてDemに通知するかどうかを決定する。 定数マクロWDGM_DEM_ALIVE_SUPERVISION_REPORTと同じ値を設定する。 TRUE：Demに通知する FALSE：Demに通知しない | true: A notification to DEM is sent if the Watchdog Manager reaches the state WDGM_GLOBAL_STATUS_STOPPED. false: The notification is disabled.
      boolean WdgMDevErrorDetect: set at pre-compile, default-value=false  # Switches the Default Error Tracer (Det) detection and notification ON or OFF. / 開発時エラーの検出およびDetモジュールへの通知を行うかどうか決定する。 定数マクロWDGM_DEV_ERROR_DETECTと同じ値を設定する。 TRUE：開発時エラー検出/通知を行う FALSE：開発時エラー検出/通知を行わない | * true: enabled (ON). * false: disabled (OFF).
      boolean WdgMImmediateReset: set at pre-compile, default-value=false  # This parameter enables/disablse the immediate reset feature in case of alive-supervision failure. / Mcuモジュールの提供する関数Mcu_PerformResetが使用可能であればTRUEを設定する。 グローバル監視ステータスが停止状態（WDGM_GLOBAL_STATUS_STOPPED）となったとき、即時リセットを実施するかどうかを決定する。 定数マクロWDGM_IMMEDIATE_RESETと同じ値を設定する。 TRUE：即時リセットを実施する FALSE：即時リセットを実施しない | true: Immediate reset is enabled false: Immediate reset is disabled
      boolean WdgMOffModeEnabled: set at pre-compile, default-value=false  # This parameter enables/disables the selection of the "OffMode" of the watchdog driver. / WdgがドライバモードにOff-Mode（WDGIF_OFF_MODE）を選択できるかどうかを決定する。 定数マクロWDGM_OFF_MODE_ENABLEDと同じ値を設定する。 TRUE：Off-Mode設定可 FALSE：Off-Mode設定不可 | true: "OffMode" selection is allowed false: "OffMode" selection is disallowed
      boolean WdgMQModBswMEnabled: set at pre-compile, origin=QINeS, default-value=true  # - / BswMモジュールの有効/無効フラグ。
      boolean WdgMVersionInfoApi: set at pre-compile, default-value=false  # Preprocessor switch to enable/disable the existence of the API WdgM_GetVersionInfo. Shall be used to remove unneeded code segments. / WdgM_GetVersionInfoを使用可能にするかどうかを決定する。 定数マクロWDGM_VERSION_INFO_APIと同じ値を設定する。 TRUE：使用可能 FALSE：使用不可 | true: API is enabled false: API is disabled
      container WdgMCallerIds [0..1]  # Contains the definition of valid CallerIds for the callers who have permission to call the function WdgM_SetMode. Tags: atp.Status=obsolete, atp.StatusComment=This container is set to obsolete and will be removed in R4.3, atp.StatusRevisionBegin=4.2.2 / このコンテナは不正な監視モード切替を防止するため、監視モード切替関数WdgM_SetModeの呼び出しが可能なモジュール情報を定義する。 このメンバはプリプロセッサWDGM_Q_WDGM_CALLER_IDS_ENABLEDがTRUEの場合に限り、生成される。
        integer WdgMCallerId [0..255]: 0..65535, multiplicity set at pre-compile, set at pre-compile, default-value=13  # This parameter defines one valid CallerId for the callers who have permission to call the function WdgM_SetMode. Tags: atp.Status=obsolete, atp.StatusComment=This parameter is set to obsolete and will be removed in R4.3, atp.StatusRevisionBegin=4.2.2 / 監視モード切替関数WdgM_SetModeを呼びだすモジュールIDを設定する。
      container WdgMSupervisedEntity [0..65535]  # This container collects all common (mode-independent) parameters of a Supervised Entity to be supervised by the Watchdog Manager. / このコンテナはSEに関する情報を定義する。 定数マクロWDGM_Q_NUM_OF_WDGM_SUPERVISEDENTITYで定義されるSEの数だけ、この情報を定義する。 SEが存在しない場合（WDGM_Q_NUM_OF_WDGM_SUPERVISEDENTITYが0）、このコンテナは生成されない。
        integer WdgMSupervisedEntityId: 0..65535, set at pre-compile, symbolic-name-value=true, default-value=0  # This parameter shall contain the unique identifier of the supervised entity. / SEの識別用IDを設定する。 BSWのモジュールIDの範囲は0..255、SW-C及びCDDのモジュールIDの範囲は256..65535となる。 MAX=65535 MIN=0
        reference WdgMEcucPartitionRef [0..1]: multiplicity set at pre-compile, set at pre-compile, destination=EcucPartition  # Denotes in which "EcucPartition" the supervised entity is executed. When the partition is stopped, the supervised entity shall be de-activated in the WdgM to avoid an ECU reset. / SEの属するパーティションの情報格納領域へのアドレスを設定する。 SC1の場合はパーティションを実装しないため、設定しない。
        reference WdgMOsCounterRef: multiplicity set at pre-compile, origin=QINeS, set at pre-compile, destination=OsCounter  # -
        reference WdgMOSCounter [0..0]: multiplicity set at pre-compile, set at pre-compile, destination=OsCounter  # OS counter used by Watchdog Manager to perform the deadline supervision of the Supervised Entity.
        reference WdgMOsApplicationIndex: set at pre-compile, origin=QINeS, destination=OsApplication  # - / SEのローカル監視ステータスが故障状態（WDGM_LOCAL_STASTUS_FAILED）になった時、パーティションリセットを実施するための情報を格納するための変数である。
        reference WdgMOsApplicationRef [0..0]: multiplicity set at pre-compile, set at pre-compile, destination=OsApplication  # Optional reference to an OS Application. Beware, the Watchdog Manager module will trigger a partition restart of this OS Application when the corresponding Supervised Entity reaches WDGM_LOCAL_STATUS_FAILED. / SEのローカル監視ステータスが故障状態（WDGM_LOCAL_STASTUS_FAILED）になった時、パーティションリセットを実施するための情報を格納するための変数である。 SC1の場合、パーティションを実装しないため、設定しない。
        reference WdgMSecondsPerTick: multiplicity set at pre-compile, origin=QINeS, set at pre-compile, destination=OsCounter  # -
        symbolic name reference WdgMInternalCheckpointInitialRef: set at pre-compile, destination=WdgMCheckpoint  # This is the reference to the initial Checkpoint for this Supervised Entity. / SEのシーケンスにおいて、最初に通過するチェックポイントのCPIDを設定する。 インターナルロジック監視を行う場合、このチェックポイントはそのSEのインターナルグラフの初期ポイントとなる。
        symbolic name reference WdgMInternallCheckpointFinalRef [1..65535]: multiplicity set at pre-compile, set at pre-compile, destination=WdgMCheckpoint  # This is the reference to the final Checkpoint(s) for this Supervised Entity. / SE のシーケンスにおいて、最後に通過するチェックポイント情報格納領域リストへのアドレスを設定する。 この配列には、SE のシーケンスにおいて、最後に通過するチェックポインﾄのCPIDを設定する。 インターナルロジック監視を行う場合、このチェックポイントはそのSE のインターナルグラフのエンドポイントとなる。
        container WdgMCheckpoint [1..65535]  # This container collects all Checkpoints of this Supervised Entity. Each Supervised Entity has at least one Checkpoint. / SE内部に設置するチェックポイントの情報格納領域（WdgMCheckpoint）へのアドレスを設定する。
          integer WdgMCheckpointId: 0..65535, set at pre-compile, symbolic-name-value=true  # This parameter shall contain the unique identifier of Checkpoint. / 本モジュールで通過を確認するチェックポイントの識別番号を設定する。 この識別番号は0から始まる連続値とする。 異なるSEに属するチェックポイントに対しても異なるIDを設定する必要がある。
        container WdgMInternalTransition [0..65535]  # This container defines the graph of Internal Transitions within this Supervised Entity. / このコンテナは、SE内部に設置するインターナルトランジッションの情報を定義する。 WdgMNumOfWdgMInternalTransitionの数だけ、この情報を定義する。 対象のSEでインターナルロジック監視を行わない場合、このコンテナは生成されない。
          symbolic name reference WdgMInternalTransitionDestRef: set at pre-compile, destination=WdgMCheckpoint  # This is the reference to the destination Checkpoint of a Internal Transition within this Supervised Entity. / インターナルトランジッションの遷移先となるチェックポイントのCPIDを設定する。
          symbolic name reference WdgMInternalTransitionSourceRef: set at pre-compile, destination=WdgMCheckpoint  # This is the reference to the source Checkpoint of a Internal Transition within this Supervised Entity. / インターナルトランジッションの遷移元となるチェックポイントのCPIDを設定する。
      container WdgMWatchdog [0..255]  # This container collects all common (mode-independent) parameters of a Watchdog to be triggered by the Watchdog Manager. / このコンテナは、Wdgに関する情報を定義する。 定数マクロWDGM_Q_NUM_OF_WDGM_WATCHDOGの数だけこの情報を定義する。
        string WdgMWatchdogName: set at pre-compile, symbolic-name-value=true  # This parameter shall contain the symbolic name of the watchdog instance. / 任意のWdg名を設定する。 文字長は4バイトとする。
        symbolic name reference WdgMWatchdogDeviceRef: set at pre-compile, destination=WdgIfDevice  # Reference to one device container of Watchdog Interface. In the referenced container WdgIfDevice, the parameter WdgIfDeviceIndex contains the Index parameter that WdgM has to use for WdgIf_SetTriggerCondition calls for that watchdog instance. / WdgIfのWdgドライバ関連コンテナWdgIf_DeviceのメンバWdgIfDeviceIndexを設定する。 詳細はWdgIfを参照する。

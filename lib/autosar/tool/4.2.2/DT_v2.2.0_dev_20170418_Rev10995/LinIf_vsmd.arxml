AUTOSAR XML (schema 4-2-2)
package /QINeS
  ecuc definition collection AUTOSARParameterDefinition: module=LinIf
  module definition LinIf [0..1]: refined-module-def=LinIf, post-build-variant-support=true, variants link-time/post-build/pre-compile  # Configuration of the LinIf (LIN Interface) module. / LinIfモジュールのコンフィグレーション。
    container LinIfGeneral  # This container contains the general parameters of LIN Interface module. / LINインターフェースのジェネラルパラメータ。
      boolean LinIfCancelTransmitSupported: set at pre-compile  # Global Pre-Compile Switch to enable/disable the APIs LinIf_CancelTransmit/LinTp_CancelReceive. / TRUE：LinIf_CancelTransmit関数を有効にする FALSE：LinIf_CancelTransmit関数を無効にする
      boolean LinIfDevErrorDetect: set at pre-compile  # Switches the Default Error Tracer (Det) detection and notification ON or OFF. / TRUE：開発時エラーを有効にする FALSE：開発時エラーを無効にする | * true: enabled (ON). * false: disabled (OFF).
      boolean LinIfMultipleDriversSupported: set at pre-compile  # States if multiple drivers are supported by the LIN Interface or not. The reason for this parameter is to reduce the size of LIN Interface if multiple drivers are not used. / TRUE：複数のドライバをサポートする FALSE：複数のドライバをサポートしない
      boolean LinIfMultipleTrcvDriverSupported: set at pre-compile  # States if multiple transceiver drivers are supported by the LIN Interface or not. The reason for this parameter is to reduce the size of LIN Interface if multiple transceiver drivers are not used. / TRUE：複数のLinTrcvをサポートする FALSE：複数のLinTrcvをサポートしない
      boolean LinIfNcOptionalRequestSupported: set at pre-compile  # States if the node configuration commands Assign NAD and Conditional Change NAD are supported. / TRUE：Assign NADとConditional Change NADをサポートする FALSE：Assign NADとConditional Change NADをサポートしない
      string LinIfPublicCddHeaderFile [0..0]: scope=ECU, multiplicity set at pre-compile, set at pre-compile, max-length=32, min-length=1  # Defines header files for callback functions which shall be included in case of CDDs. Range of characters is 1.. 32. / 未使用
      boolean LinIfQTransceiverDrvConfigEnable: set at pre-compile, origin=QINeS  # States if the TP is included in the LIN Interface or not. The reason for this parameter is to reduce the size of LIN Interface if the TP is not used. / TRUE：LinIfTransceiverDrvConfigを有効にする FALSE：LinIfTransceiverDrvConfigを無効にする
      boolean LinIfTpSupported: set at pre-compile  # States if the TP is included in the LIN Interface or not. The reason for this parameter is to reduce the size of LIN Interface if the TP is not used. / TRUE：トランスポートプロトコルをサポートする FALSE：トランスポートプロトコルをサポートしない
      boolean LinIfTrcvDriverSupported: set at pre-compile  # States if transceiver driver support is included in the LIN Interface or not. The reason for this parameter is to reduce the size of LIN Interface if transceiver drivers are not used. / TRUE：LinTrcvをサポートする FALSE：LinTrcvをサポートしない
      boolean LinIfVersionInfoApi: set at pre-compile  # Switches the LinIf_GetVersionInfo function ON or OFF. / TRUE：LinIf_GetVersionInfoを有効にする FALSE：LinIf_GetVersionInfoを無効にする
    container LinIfGlobalConfig [1..*]  # This container contains the global configuration parameters of the LinIf. / LinIfの全体的な設定パラメータが含まれているコンテナである。
      float LinIfTimeBase: 0.001..0.255, post-build-variant-value=true, set at link in variant link-time / post-build in variant post-build / pre-compile in variant pre-compile  # Defines the interval of calls to main functions in seconds. / 周期処理の間隔を秒単位で指定すること。値は設定されたLinIfClusterTimeBaseの最大公約数を指定する。(0.001..0.255)
      container LinIfChannel [0..*]: multiplicity set at pre-compile  # Describes each LIN channel the LinIf is connected to. / LinIfモジュールが制御するチャネル情報。
        enumeration LinIfGotoSleepConfirmationUL [0..0]: {CDD, LIN_SM}, scope=ECU, post-build-variant-value=true, set at link in variant link-time+post-build / pre-compile in variant pre-compile  # This parameter defines the upper layer (UL) module to which the confirmation of the goto-sleep command shall be sent. / 未使用
        integer LinIfMaxFrameCnt [0..0]: 0..65535, multiplicity set at link in variant link-time+post-build / pre-compile in variant pre-compile, set at link in variant link-time+post-build / pre-compile in variant pre-compile  # Maximum number of Frames. This parameter is needed only in case of post-build loadable implementation using static memory allocation.
        enumeration LinIfScheduleRequestConfirmationUL [0..0]: {CDD, LIN_SM}, scope=ECU, post-build-variant-value=true, set at link in variant link-time+post-build / pre-compile in variant pre-compile  # This parameter defines the upper layer (UL) module to which the confirmation of the successfully performed schedule table change shall be sent. / 未使用
        enumeration LinIfStartupState: {LINIF_NORMAL, LINIF_SLEEP}, set at link in variant link-time+post-build / pre-compile in variant pre-compile  # Defines the state of each LIN channel after startup / 初期化後のLINチャネルの状態を以下より指定すること。 NORMAL(0)：初期化後にCHANNEL_OPERATIONALとなる SLEEP(1)：初期化後にCHANNEL_SLEEPとなる
        enumeration LinIfWakeupConfirmationUL [0..0]: {CDD, LIN_SM}, scope=ECU, post-build-variant-value=true, set at link in variant link-time+post-build / pre-compile in variant pre-compile  # This parameter defines the upper layer (UL) module to which the confirmation of the wake-up shall be sent. / 未使用
        foreign reference LinIfCddRef [0..0]: multiplicity set at pre-compile, set at pre-compile, destination-type=ECUC-MODULE-CONFIGURATION-VALUES  # Reference to the CDD module description. This parameter is only required when LinIfWakeupConfirmationUL, LinIfScheduleRequestConfirmationUL, and/or LinIfGotoSleepConfirmationUL is set to CDD.
        symbolic name reference LinIfChannelRef: scope=ECU, set at link in variant link-time+post-build / pre-compile in variant pre-compile, destination=LinChannel  # Reference to the channel definition in the LIN driver. / チャネルが紐付くLINチャネルへの参照データ。IDを指定すること。(0..255)
        symbolic name reference LinIfComMNetworkHandleRef: set at link in variant link-time+post-build / pre-compile in variant pre-compile, destination=ComMChannel  # Unique handle to identify one LIN network. Reference to one of the network handles configured for the ComM. / チャネルが紐付くComMで設定されたネットワークハンドルへの参照データ。
        container LinIfFrame [0..*]: multiplicity set at link in variant link-time / post-build in variant post-build / pre-compile in variant pre-compile, post-build-variant-multiplicity=true  # Generic container for all types of LIN frames. / チャネルが扱うフレーム情報。
          enumeration LinIfChecksumType: {LINIF_CLASSIC, LINIF_ENHANCED}, post-build-variant-value=true, set at link in variant link-time / post-build in variant post-build / pre-compile in variant pre-compile  # Type of checksum that the frame is using. / フレームのチェックサムの種類を指定すること。 CLASSIC(0)：Classicを選択する ENHANCED(1)：Enhancedを選択する
          integer LinIfFrameId [0..1]: 0..255, multiplicity set at link in variant link-time / post-build in variant post-build / pre-compile in variant pre-compile, post-build-variant-multiplicity=true, post-build-variant-value=true, set at link in variant link-time / post-build in variant post-build / pre-compile in variant pre-compile  # ID of the LIN frame. The Protected ID including parity is calculated by the generation tool.
          enumeration LinIfFrameType: {LINIF_MRF, LINIF_SRF, LINIF_UNCONDITIONAL}, post-build-variant-value=true, set at link in variant link-time / post-build in variant post-build / pre-compile in variant pre-compile  # Type of frame/slot. A sporadic slot may be used by a set of unconditional frames in the role of substitution frames. / フレームの種類を以下から指定すること。 ASSIGN(0) ASSIGN_FRAME_ID_RANGE(1) ASSIGN_NAD(2) CONDITIONAL(3) EVENT_TRIGGERED(4) FREE(5) MRF(6) SAVE_CONFIGURATION(7) SPORADIC(8) SRF(9) UNASSIGN(10) UNCONDITIONAL(11) UNCONDITIONALフレーム以外はMRF、SRF、UNCONDITIONAL フレーム以外は基本的 なLin 通信、診断機能には必須では無いため未サポート。
          integer LinIfLength: 1..8, set at link in variant link-time / post-build in variant post-build / pre-compile in variant pre-compile, origin=QINeS  # Length of the LIN SDU in bytes. / バイト単位でのSDUの長さを指定すること。(1..8)
          enumeration LinIfTypeOfPduDirection: {LINIF_Q_INTERNAL_PDU, LINIF_Q_RX_PDU, LINIF_Q_SLAVE_TO_SLAVE_PDU, LINIF_Q_TX_PDU}, set at link in variant link-time / post-build in variant post-build / pre-compile in variant pre-compile, origin=QINeS
          container LinIfFixedFrameSdu [0..0]  # In case this is a fixed frame this is the SDU (response). / 未使用 | This container represents an eight byte array. The Byte order shall be MSB first.
            container LinIfFixedFrameSduByte [8..8]  # This container represents a byte within the 8 byte array. / 未使用
              integer LinIfFixedFrameSduBytePos: 0..7, post-build-variant-value=true, set at link in variant link-time / post-build in variant post-build / pre-compile in variant pre-compile  # Index of the Byte in the SDU (response) 8 byte array. / 未使用
              integer LinIfFixedFrameSduByteVal: 0..255, post-build-variant-value=true, set at link in variant link-time / post-build in variant post-build / pre-compile in variant pre-compile  # Byte value in the SDU (response) 8-byte array. / 未使用
          choice container LinIfPduDirection  # Direction of the frame / フレームが紐付くPDU情報への参照データ。
            container LinIfInternalPdu [0..1]  # Represents a Diagnostic or Configuration frame : no Message ID (no PduId). / 未使用
              integer LinIfInternalDummy: 0..65535, set at link in variant link-time / post-build in variant post-build / pre-compile in variant pre-compile, origin=QINeS, default-value=0  # -
            container LinIfRxPdu [0..1]  # represents a received PDU/frame / 受信PDU情報。
              function name LinIfRxIndicationUL [0..1]: scope=ECU, multiplicity set at link in variant link-time+post-build / pre-compile in variant pre-compile, post-build-variant-multiplicity=true, post-build-variant-value=true, set at link in variant link-time+post-build / pre-compile in variant pre-compile  # This parameter defines the name of the <User_RxIndication>. This parameter depends on the parameter LinIfUserRxIndicationUL. / 受信完了時に呼ばれるCallback関数を指定すること。 | If LinIfUserRxIndicationUL equals PDUR, the name of the <User_RxIndication> is fixed. If LinIfUserRxIndicationUL equals CDD, the name of the <User_RxIndication> is selectable.
              enumeration LinIfUserRxIndicationUL [0..0]: {CDD, PDUR}, scope=ECU, post-build-variant-value=true, set at link in variant link-time+post-build / pre-compile in variant pre-compile  # This parameter defines the upper layer (UL) module to which the indication of the successfully received LinIfRxPdu has to be routed via <User_RxIndication>. / 未使用
              reference LinIfRxPduRef: scope=ECU, post-build-variant-value=true, set at link in variant link-time / post-build in variant post-build / pre-compile in variant pre-compile, destination=Pdu  # Reference to the PDU that is received in this frame. / 上位レイヤに受信完了を通知する際のPduID。上位レイヤで定義しているPduIDを指定すること。(0..255)
            container LinIfSlaveToSlavePdu [0..1]  # Represents a slave-to-slave PDU/frame. Master does only send the header but doesn't receive the response. / 未使用
              integer LinIfSlaveToSlaveDummy: 0..65535, set at link in variant link-time / post-build in variant post-build / pre-compile in variant pre-compile, origin=QINeS, default-value=0  # - / 未使用
            container LinIfTxPdu [0..1]  # represents a transmitted PDU/frame / 送信PDU情報。
              function name LinIfTxConfirmationUL [0..1]: scope=ECU, multiplicity set at link in variant link-time+post-build / pre-compile in variant pre-compile, post-build-variant-multiplicity=true, post-build-variant-value=true, set at link in variant link-time+post-build / pre-compile in variant pre-compile  # This parameter defines the name of the <User_TxConfirmation>. This parameter depends on the parameter LinIfUserTxUL. / 送信完了時に呼ばれるCallback関数を指定すること。 | If LinIfUserTxUL equals PDUR, the name of the <User_TxConfirmation> is fixed. If LinIfUserTxUL equals CDD, the name of the <User_TxConfirmation> is selectable.
              integer LinIfTxPduId: 0..65535, set at pre-compile, symbolic-name-value=true  # Identifier of the Pdu for the upper layer. / 上位レイヤに送信完了を通知する際のPduID。上位レイヤで定義しているPduIDを指定すること。(0..255)
              function name LinIfTxTriggerTransmitUL [0..1]: scope=ECU, multiplicity set at link in variant link-time+post-build / pre-compile in variant pre-compile, post-build-variant-multiplicity=true, post-build-variant-value=true, set at link in variant link-time+post-build / pre-compile in variant pre-compile  # This parameter defines the name of the <User_TriggerTransmit>. This parameter depends on the parameter LinIfUserTxUL. If LinIfUserTxUL equals PDUR, the name of the <User_TriggerTransmit> is fixed. / 送信要求があったときに呼ばれるCallback関数を指定すること。 | If LinIfUserTxUL equals CDD, the name of the <User_TriggerTransmit> is selectable.
              enumeration LinIfUserTxUL [0..0]: {CDD, PDUR}, scope=ECU, post-build-variant-value=true, set at link in variant link-time+post-build / pre-compile in variant pre-compile  # This parameter defines the upper layer (UL) module to which the trigger of the transmitted LinTxPdu (via the <User_TriggerTransmit>) or the confirmation of the successfully transmitted LinTxPdu has to be routed (via the <User_TxConfirmation>). / 未使用
              reference LinIfTxPduRef: scope=ECU, post-build-variant-value=true, set at link in variant link-time / post-build in variant post-build / pre-compile in variant pre-compile, destination=Pdu  # Reference to the PDU that is transmitted in this frame. / 上位レイヤに送信開始を通知する際のPduID。上位レイヤで定義しているPduIDを指定すること。(0..255)
          container LinIfSubstitutionFrames [0..0]  # List of sporadic frames that can be sent in a / 未使用 | sporadic frame slot.
            integer LinIfFramePriority: 0..255, post-build-variant-value=true, set at link in variant link-time / post-build in variant post-build / pre-compile in variant pre-compile  # Priority of sporadic frame. / 未使用
            reference LinIfSubstitutionFrameRef: post-build-variant-value=true, set at link in variant link-time / post-build in variant post-build / pre-compile in variant pre-compile, destination=LinIfFrame  # Reference to an unconditional Frame that is used as sporadic frame. / 未使用
        container LinIfMaster [0..0]  # Each Master can only be connected to one physical channel. This could be compared to the Node parameter in a LDF file. / LINマスター動作情報。
          float LinIfJitter: 0..0.255, set at pre-compile  # The jitter specifies the differences between the maximum and minimum delay from time base tick to the header sending start point in seconds. / 未使用
        container LinIfScheduleTable [1..*]: multiplicity set at link in variant link-time / post-build in variant post-build / pre-compile in variant pre-compile, post-build-variant-multiplicity=true  # Describes a schedule table. Each LinIfChannel may have several schedule tables. Each schedule table can only be connected to one channel. / スケジュールテーブル情報。 | The SHORT-NAME of the LinIfScheduleTable container represents the symbolic name of the schedule table.
          enumeration LinIfResumePosition: {LINIF_CONTINUE_AT_IT_POINT, LINIF_START_FROM_BEGINNING}, post-build-variant-value=true, set at link in variant link-time / post-build in variant post-build / pre-compile in variant pre-compile  # Defines where a schedule table shall proceed in case it has been interrupted by a RUN_ONCE table. / スケジュールテーブルによって割り込みが発生したあと、どのように復帰するのか設定する。 START_FROM_BEGINNING：スケジュールテーブルの初めから開始する CONTINUE_AT_IT_POINT：割り込みがあった地点から復帰する
          enumeration LinIfRunMode: {LINIF_RUN_CONTINUOUS, LINIF_RUN_ONCE}, post-build-variant-value=true, set at link in variant link-time / post-build in variant post-build / pre-compile in variant pre-compile  # The schedule table can be executed in two different modes. / スケジュールのモードを次の2つから指定すること。 RUN_CONTINUOUS： 継続して実行される RUN_ONCE：一度だけ実行される
          integer LinIfScheduleTableIndex: 0..255, set at pre-compile, symbolic-name-value=true  # This is the unique index used by upper layers to identify a schedule. Note that the NULL_SCHEDULE for each channel must have index 0. / 上位層によってスケジュールテーブルを識別するためのインデックスである。(0..255) NULL_SCHEDULEが指定された場合は0が指定されることに注意すること。
          container LinIfEntry [0..*]: multiplicity set at link in variant link-time / post-build in variant post-build / pre-compile in variant pre-compile, post-build-variant-multiplicity=true  # Describes an entry in the schedule table (also known as Frame Slot). / スケジュールテーブルが紐付くエントリ情報。
            float LinIfDelay: 0..0.255, post-build-variant-value=true, set at link in variant link-time / post-build in variant post-build / pre-compile in variant pre-compile  # Delay to next entry in schedule table in seconds. / 次のエントリまでの間隔を秒単位で指定すること。設定されたLinIfClusterTimeBaseの倍数を指定する。(0..0.255)
            integer LinIfEntryIndex: 0..255, post-build-variant-value=true, set at link in variant link-time / post-build in variant post-build / pre-compile in variant pre-compile  # Position of the Frame Entry in the Schedule Table. The first entry index in the schedule table is 0. / スケジュールテーブル中のフレームのエントリを指定すること。最初のエントリは0となる。
            reference LinIfCollisionResolvingRef [0..0]: post-build-variant-value=true, set at link in variant link-time / post-build in variant post-build / pre-compile in variant pre-compile, destination=LinIfScheduleTable  # Reference to the schedule table, which resolves the collision. This parameter is only used if the referenced frames are event triggered frames. / 未使用
            reference LinIfFrameRef [1..256]: post-build-variant-value=true, set at link in variant link-time / post-build in variant post-build / pre-compile in variant pre-compile, destination=LinIfFrame  # Reference to the frames that belong to this schedule table entry. / エントリが扱うフレーム情報への参照データ。
        container LinIfTransceiverDrvConfig [0..1]  # This container contains the configuration parameters of each underlying LIN Transceiver Driver. / チャネルが紐付くLINトランシーバドライバ情報。
          symbolic name reference LinIfTrcvIdRef: scope=ECU, set at link in variant link-time+post-build / pre-compile in variant pre-compile, destination=LinTrcvChannel  # Logical handle of the underlying LIN transceiver to be served by the LIN Interface. / LINトランシーバドライバ情報への参照データ。IDを指定すること。(0..255)

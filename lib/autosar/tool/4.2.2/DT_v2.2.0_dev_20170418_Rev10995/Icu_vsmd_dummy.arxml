AUTOSAR XML (schema 4-2-2)
package /QINeS
  ecuc definition collection AUTOSARParameterDefinition: module=Icu
  module definition Icu [0..*]: refined-module-def=Icu, post-build-variant-support=true, variants post-build/pre-compile  # Configuration of the Icu (Input Capture Unit) module. / Icuモジュールのコンフィグレーション。(MCAL ダミー)
    container IcuConfigSet  # This container contains the configuration parameters and sub containers of the AUTOSAR Icu module. / 多重コンフィグレーションセットのベースコンテナ。
      integer IcuMaxChannel: 0..65535, post-build-variant-value=true, set at post-build in variant post-build / pre-compile in variant pre-compile  # This parameter contains the number of Channels configured. It will be gathered by tools during the configuration stage. / ICUドライバのチャンネル・コンフィグレーションのコンテナ数。 | calculationFormula = Number of configured Icu Channels Implementation Type: Icu_ChannelType
      container IcuChannel [1..*]  # Configuration of an individual ICU channel. / 個々のICUチャネルのコンフィグレーション。
        integer IcuChannelId: 0..65535, scope=ECU, set at pre-compile, symbolic-name-value=true  # Channel Id of the ICU channel. This value will be assigned to the symbolic name derived of the IcuChannel container short name. / ICUチャネルのチャネルID。この値は、IcuChannelコンテナのショートネームから派生したシンボル名に割り当てられる。
        enumeration IcuDefaultStartEdge: {ICU_BOTH_EDGES, ICU_FALLING_EDGE, ICU_RISING_EDGE}, post-build-variant-value=true, set at post-build in variant post-build / pre-compile in variant pre-compile  # Configures the default-activation-edge which shall be used for this channel if there was no activation-edge configured by the call of service Icu_SetActivationCondition(). / Icu_SetActivationConditionサービスの呼び出しによって設定されるactivation-edgeがない場合は、このチャネルで使われるべきdefault-activation-edgeの設定を行う。 測定モードが「IcuSignalMeasurement」で、「DutyCycle」または「Period」のプロパティが設定されている場合、ここで設定されたエッジがデフォルトの周期開始エッジとして使用される。 実装タイプ：Icu_ActivationType ICU_BOTH_EDGES ICU_FALLING_EDGE ICU_RISING_EDGE | In case the Measurement Mode is "IcuSignalMeasurement" and the properties "DutyCycle" or "Period" are set, the edge configured here is used as Default Period Start Edge. Implementation Type: Icu_ActivationType
        enumeration IcuMeasurementMode: {ICU_MODE_EDGE_COUNTER, ICU_MODE_SIGNAL_EDGE_DETECT, ICU_MODE_SIGNAL_MEASUREMENT, ICU_MODE_TIMESTAMP}, post-build-variant-value=true, set at post-build in variant post-build / pre-compile in variant pre-compile  # Configures the measurement mode of this channel. / チャネルの測定モードを設定する。 実装タイプ：Icu_MeasurementModeType ICU_MODE_EDGE_COUNTER ICU_MODE_SIGNAL_EDGE_DETECT ICU_MODE_SIGNAL_MEASUREMENT ICU_MODE_TIMESTAMP | Implementation Type: Icu_MeasurementModeType
        boolean IcuWakeupCapability: post-build-variant-value=true, set at post-build in variant post-build / pre-compile in variant pre-compile  # Information about the wakeup-capability of this channel. / このチャネルのウェイクアップ機能に関する情報。 TRUE：チャネルはウェイクアップ可能 FALSE：チャネルはウェイクアップ可能ではない | true: Channel is wakeup capable. false: Channel is not wakeup capable.
        container IcuSignalEdgeDetection [0..1]  # This container contains the configuration (parameters) in case the measurement mode is "IcuSignalEdgeDetection" / このコンテナには、測定モードが「IcuSignalEdgeDetection」である場合のコンフィグレーション（パラメータ）が含まれている。
          function name IcuSignalNotification [0..1]: multiplicity set at post-build in variant post-build / pre-compile in variant pre-compile, post-build-variant-multiplicity=true, post-build-variant-value=true, set at post-build in variant post-build / pre-compile in variant pre-compile  # Notification function for signal notification. / 信号通知の通知関数。
        container IcuSignalMeasurement [0..1]  # This container contains the configuration (parameters) in case the measurement mode is "IcuSignalMeasurement" / このコンテナには、測定モードが「IcuSignalMeasurement」である場合のコンフィグレーション（パラメータ）が含まれている。
          enumeration IcuSignalMeasurementProperty: {ICU_DUTY_CYCLE, ICU_HIGH_TIME, ICU_LOW_TIME, ICU_PERIOD_TIME}, post-build-variant-value=true, set at post-build in variant post-build / pre-compile in variant pre-compile  # Configures the property that could be measured in case the mode is "IcuSignalMeasurement". / モードが「IcuSignalMeasurement」である場合に測定することができるプロパティを設定する。 このプロパティは、実行時に変更することはできない。 実装タイプ：Icu_SignalMeasurementPropertyType ICU_ACTIVE_TIME ICU_DUTY_CYCLE ICU_HIGH_TIME ICU_LOW_TIME ICU_PERIOD_TIME | This property can not be changed during runtime. Implementation Type: Icu_SignalMeasurementPropertyType
        container IcuTimestampMeasurement [0..1]  # This container contains the configuration (parameters) in case the measurement mode is "IcuTimestamp" / このコンテナには、測定モードが「IcuTimestamp」である場合のコンフィグレーション（パラメータ）が含まれている。
          enumeration IcuTimestampMeasurementProperty: {ICU_CIRCULAR_BUFFER, ICU_LINEAR_BUFFER}, post-build-variant-value=true, set at post-build in variant post-build / pre-compile in variant pre-compile  # Configures the handling of the buffer in case the mode is "Timestamp" / モードが「IcuTimestamp」の場合のバッファの使い方を設定する。 実装タイプ：IcuTimesutampBufferType | Implementation Type: Icu_TimestampBufferType
          function name IcuTimestampNotification [0..1]: multiplicity set at post-build in variant post-build / pre-compile in variant pre-compile, post-build-variant-multiplicity=true, post-build-variant-value=true, set at post-build in variant post-build / pre-compile in variant pre-compile  # Notification function if the number of requested timestamps / 要求されたタイムスタンプの数を取得した場合の通知機能。 | (Notification interval > 0) are acquired.
        container IcuWakeup [0..1]  # This container contains the configuration (parameters) needed to configure a wakeup capable channel / このコンテナは、ウェイクアップが可能なチャネルを設定するために必要なコンフィグレーション(パラメータ)が含まれている。
          symbolic name reference IcuChannelWakeupInfo [0..1]: multiplicity set at post-build in variant post-build / pre-compile in variant pre-compile, post-build-variant-multiplicity=true, post-build-variant-value=true, set at post-build in variant post-build / pre-compile in variant pre-compile, destination=EcuMWakeupSource  # If the wakeup-capability is true the wakeup source referenced is transmitted to the ECU State Manager (EcuM) . / ウェイクアップ機能がtrueの場合、参照されたウェイクアップソースはECU状態マネージャ(EcuM)へ送信される。 実装タイプ：参照EcuM_WakeupSourceType | Implementation Type: reference to EcuM_WakeupSourceType
    container IcuGeneral  # Configuration of general ICU parameters. / ICUパラメータ全体のジェネラルコンフィグレーション。
      boolean IcuDevErrorDetect: set at pre-compile  # Switches the Default Error Tracer (Det) detection and notification ON or OFF. / 開発エラーの検知および通知を有効/無効に切り替える。 TURE：有効 FALSE：無効 | * true: enabled (ON). * false: disabled (OFF).
      integer IcuIndex: 0..255, set at pre-compile  # Specifies the InstanceId of this module instance. If only one instance is present it shall have the Id 0. / このモジュールインスタンスのインスタンスIDを明記する。ひとつのインスタンスしか存在しない場合はID=0を設定する。
      boolean IcuReportWakeupSource: set at pre-compile  # Switch for enabling Wakeup source reporting. / wakeupソース通知を有効に切り替える。 TRUE：wakeupソースを通知する。 FALSE：wakeupソースを通知しない。 | true: Report Wakeup source. false: Do not report Wakeup source.
    container IcuOptionalApis  # This container contains all configuration switches for configuring optional API services of the ICU driver. / このコンテナには、ICUドライバのオプションAPIサービスコンフィグレーションのためのすべてのコンフィグレーションスイッチが含まれている。
      boolean IcuDeInitApi: set at pre-compile  # Adds / removes the service Icu_DeInit() from the code. / コードからIcu_DeInit()サービスを追加/削除する。 TURE：Icu_DeInit()が使用できる FALSE：Icu_DeInit() が使用できない | true: Icu_DeInit() can be used. false: Icu_DeInit() can not be used.
      boolean IcuDisableWakeupApi: set at pre-compile  # Adds / removes the service Icu_DisableWakeup() from the code. / コードからIcu_DisableWakeup()サービスを追加/削除する。 TRUE：Icu_DisableWakeup()が使用できる FALSE：Icu_DisableWakeup()が使用できない | true: Icu_DisableWakeup() can be used. false: Icu_DisableWakeup() can not be used.
      boolean IcuEdgeCountApi: set at pre-compile  # Adds / removes all services related to the edge counting functionality as listed below, from the code: Icu_ResetEdgeCount(), Icu_EnableEdgeCount(), Icu_DisableEdgeCount(), Icu_GetEdgeNumbers(). / コードからエッジカウント機能に関連するすべてのサービスを追加/削除する。 Icu_ResetEdgeCount()、Icu_EnableEdgeCount()、 Icu_DisableEdgeCount()、Icu_GetEdgeNumbers() TRUE：上記サービスが使用できる FALSE：上記サービスが使用できない | true: The services listed above can be used. false: The services listed above can not be used.
      boolean IcuEdgeDetectApi: set at pre-compile  # Adds / removes the services related to the edge detection functionality, from the code: / コードからエッジ検出機能に関連するすべてのサービスを追加/削除する。 Icu_EnableEdgeDetection()、Icu_DisableEdgeDetection() TRUE：上記サービスが使用できる FALSE：上記サービスが使用できない | Icu_EnableEdgeDetection() and Icu_DisableEdgeDetection(). true: These services can be used. false: These services can not be used.
      boolean IcuEnableWakeupApi: set at pre-compile  # Adds / removes the service Icu_EnableWakeup() from the code. / コードからIcu_EnableWakeup()サービスを追加/削除する。 TRUE：Icu_EnableWakeup() が使用できる FALSE：Icu_EnableWakeup() が使用できない | true: Icu_EnableWakeup() can be used. false: Icu_EnableWakeup() can not be used.
      boolean IcuGetDutyCycleValuesApi: set at pre-compile  # Adds / removes the service Icu_GetDutyCycleValues() from the code. / コードからIcu_GetDutyCycleValues()サービスを追加/削除する。 TRUE：Icu_GetDutyCycleValues()が使用できる FALSE：Icu_GetDutyCycleValues()が使用できない | true: Icu_GetDutyCycleValues() can be used. false: Icu_GetDutyCycleValues() can not be used.
      boolean IcuGetInputStateApi: set at pre-compile  # Adds / removes the service Icu_GetInputState() from the code. / コードからIcu_GetInputState()サービスを追加/削除する。 TRUE：Icu_GetInputState()が使用できる FALSE：Icu_GetInputState()が使用できない | true: Icu_GetInputState() can be used. false: Icu_GetInputState() can not be used.
      boolean IcuGetTimeElapsedApi: set at pre-compile  # Adds / removes the service Icu_GetTimeElapsed() from the code. / コードからサービスIcu_GetTimeElapsed()を追加/削除する。 TRUE：Icu_GetTimeElapsed()が使用できる FALSE：Icu_GetTimeElapsed()が使用できない | true: Icu_GetTimeElapsed() can be used. false: Icu_GetTimeElapsed() can not be used.
      boolean IcuGetVersionInfoApi: set at pre-compile  # Adds / removes the service Icu_GetVersionInfo() from the code. / コードからIcu_GetVersionInfo()サービスを追加/削除する。 TRUE：Icu_GetVersionInfo()が使用できる FALSE：Icu_GetVersionInfo()が使用できない | true: Icu_GetVersionInfo() can be used. false: Icu_GetVersionInfo() can not be used.
      boolean IcuSetModeApi: set at pre-compile  # Adds / removes the service Icu_SetMode() from the code. / コードからIcu_SetMode()サービス を追加/削除する。 TRUE：Icu_SetMode()が使用できる FALSE：Icu_SetMode()が使用できない | true: Icu_SetMode() can be used. false: Icu_SetMode() can not be used.
      boolean IcuSignalMeasurementApi: set at pre-compile  # Adds / removes the services Icu_StartSignalMeasurement() and Icu_StopSignalMeasurement() from the code. / コードからIcu_StartSignalMeasurement()とIcu_StopSignalMeasurement()サービスを追加/削除する。 TRUE：Icu_StartSignalMeasurement()とIcu_StopSignalMeasurement()が使用できる FALSE：Icu_StartSignalMeasurement()とIcu_StopSignalMeasurement()が使用できない | true: Icu_StartSignalMeasurement() and Icu_StopSignalMeasurement() can be used. false: Icu_StartSignalMeasurement() and Icu_StopSignalMeasurement() can not be used.
      boolean IcuTimestampApi: set at pre-compile  # Adds / removes all services related to the timestamping functionality as listed below from the code: Icu_StartTimestamp(), Icu_StopTimestamp(), Icu_GetTimestampIndex(). / コードから、下記のようにタイムスタンプ機能に関連するすべてのサービスを追加/削除する。 Icu_StartTimestamp()、Icu_StopTimestamp()、 Icu_GetTimestampIndex() TRUE：上記サービスが使用できる FALSE：上記サービスが使用できない | true: The services listed above can be used. false: The services listed above can not be used.
      boolean IcuWakeupFunctionalityApi: set at pre-compile  # Adds / removes the service Icu_CheckWakeup() from the code. / コードからIcu_CheckWakeup()サービスを追加/削除する。 TRUE：Icu_CheckWakeup()が使用できる FALSE：Icu_CheckWakeup()が使用できない | true: Icu_CheckWakeup() can be used. false: Icu_CheckWakeup() cannot be used.

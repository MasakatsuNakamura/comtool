AUTOSAR XML (schema 4-2-2)
package /QINeS
  ecuc definition collection AUTOSARParameterDefinition: module=LinNm
  module definition LinNm [0..1]: refined-module-def=LinNm, variants link-time/pre-compile  # Configuration Parameters for the Lin Nm module. / LinNmモジュールのコンフィグレーション。
    container LinNmGlobalConfig  # This container contains the global configuration parameter of the LinNm. / LinNmモジュールのコンテナ。
      boolean LinNmBusSynchronizationEnabled: set at pre-compile  # Pre-processor switch for enabling bus synchronization support of the LinNm. This feature is required for NM Coordinator nodes only. / バスシンクロナイゼーションの有効・無効設定。
      boolean LinNmComControlEnabled [0..0]: set at pre-compile  # Pre-processor switch for enabling the Communication Control support. / コミュニケーションコントロールの有効・無効設定。
      boolean LinNmComUserDataSupport [0..0]: set at pre-compile  # Pre-processor switch for enabling the NM COM user data support. Tags: atp.Status=obsolete / NM COMのユーザーデータサポートの有効・無効設定。 | This parameter is set to obsolete and will be removed in release 4.3. This element is obsolete and will be removed in a future revision.
      boolean LinNmCoordinatorSyncSupport: set at pre-compile  # Enables/disables the coordinator synchronization support. / コーディネータシンクロナイゼーションの有効・無効設定。
      boolean LinNmDevErrorDetect: set at pre-compile  # Switches the Default Error Tracer (Det) detection and notification ON or OFF. / Detエラー検出の有効・無効設定。 | * true: enabled (ON). * false: disabled (OFF).
      float LinNmMainFunctionPeriod: 0.001..0.255, set at link in variant link-time / pre-compile in variant pre-compile  # Call cycle in seconds of LinNm_MainFunction.
      boolean LinNmNodeDetectionEnabled [0..0]: set at pre-compile  # Pre-processor switch for enabling the Node Detection feature. / ノード検知の有効・無効設定。
      boolean LinNmNodeIdEnabled [0..0]: set at pre-compile  # Pre-processor switch for enabling transmission of the source node identifier in NM messages. / NMメッセージのノードIDの有効・無効設定。
      boolean LinNmPassiveModeEnabled: set at pre-compile  # Pre-processor switch for enabling support of the Passive Mode of the LinNm. / パッシブモードの有効・無効設定。
      boolean LinNmRemoteSleepIndicationEnabled: set at pre-compile  # Pre-processor switch for enabling Remote Sleep Indication support. This feature is required for NM Coordinator nodes only. / リモートスリープインディケーションの有効・無効設定。
      boolean LinNmStateChangeIndEnabled [0..0]: set at pre-compile  # Pre-processor switch for enabling the Network Management state change notification. / 状態変化通知の有効・無効設定。
      boolean LinNmSynchronizationPointEnabled: set at pre-compile, default-value=false  # Pre-processor switch for enabling the Synchronize NM feature. / シンクロナイゼーションポイントの有効・無効設定。
      boolean LinNmUserDataEnabled [0..0]: set at pre-compile  # Pre-processor switch for enabling User Data support. / ユーザーデータサポートの有効・無効設定。
      boolean LinNmVersionInfoApi: set at pre-compile, default-value=false  # Pre-processor switch for enabling version info API support. / バージョン取得APIサポートの有効・無効設定。
      container LinNmChannelConfig [1..*]  # This container contains the channel specific configuration parameter of the LinNm. / LinNmモジュールのチャネルコンテナ。
        float LinNmTimeoutTime: 0..65.535, scope=ECU, set at link in variant link-time / pre-compile in variant pre-compile  # Network Timeout after passive start-up. It denotes the time in seconds how long the NM shall stay in Network Mode in case of passive start-up before transition into Bus-Sleep Mode is initiated.
        symbolic name reference LinNmComMNetworkHandleRef: set at link in variant link-time / pre-compile in variant pre-compile, destination=ComMChannel  # This reference points to the unique channel defined by the ComMChannel and provides access to the unique channel index value in ComMChannelId. / ComMチャネルIDの参照。

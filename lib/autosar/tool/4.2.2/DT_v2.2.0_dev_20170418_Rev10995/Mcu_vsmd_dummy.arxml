AUTOSAR XML (schema 4-2-2)
package /QINeS
  ecuc definition collection AUTOSARParameterDefinition: module=Mcu
  module definition Mcu [0..1]: refined-module-def=Mcu, post-build-variant-support=true, variants post-build/pre-compile  # Configuration of the Mcu (Microcontroller Unit) module. / Mcuモジュールのコンフィグレーション。(MCAL ダミー)
    container McuGeneralConfiguration  # This container contains the configuration (parameters) of the MCU driver. / このコンテナにはMCUドライバのコンフィグレーション(パラメータ)が含まれる。
      boolean McuDevErrorDetect: set at pre-compile  # Switches the Default Error Tracer (Det) detection and notification ON or OFF. / 開発エラー検出と報告を有効にするためのプリプロセッサスイッチ。 | * true: enabled (ON). * false: disabled (OFF).
      boolean McuGetRamStateApi: set at pre-compile  # Pre-processor switch to enable/disable the API Mcu_GetRamState. / API Mcu_GetRamStateを有効/無効にするプリプロセッサスイッチ。 （H/ Wが機能をサポートしていない場合などは、このパラメータは、APIを無効にするために使用することができる）。 | (e.g. If the H/W does not support the functionality, this parameter can be used to disable the Api).
      boolean McuInitClock: set at pre-compile, default-value=true  # If this parameter is set to FALSE, the clock initialization has to be disabled from the MCU driver. This concept applies when there are some write once clock registers and a bootloader is present. If this parameter is set to TRUE, the MCU driver is responsible of the clock initialization. / このパラメータをFALSEに設定すると、クロックの初期化は、MCUドライバでは無効にする。 この概念は、一度のみ書き込むクロックレジスタおよびブートローダがある場合に適用される。 このパラメータをTRUEに設定すると、MCUドライバは、クロックの初期化を担当する。
      boolean McuNoPll: set at pre-compile, default-value=true  # This parameter shall be set True, if the H/W does not have a PLL or the PLL circuitry is enabled after the power on without S/W intervention. In this case MCU_DistributePllClock has to be disabled and MCU_GetPllStatus has to return MCU_PLL_STATUS_UNDEFINED. Otherwise this parameters has to be set False / H/ WがPLLを持っていない場合、またはPLL回路がS/Wの介入なしで電源投入後有効になる場合、このパラメータは、Trueに設定されなければならない。 このケースではMCU_DistributePllClock()を無効にする必要があり、MCU_GetPllStatus()がMCU_PLL_STATUS_UNDEFINEDを返す必要がある。 それ以外の場合、このパラメータはFalseに設定される必要がある。
      boolean McuPerformResetApi: set at pre-compile  # Pre-processor switch to enable / disable the use of the function Mcu_PerformReset() / 関数Mcu_PerformResetの使用を有効/無効にするプリプロセッサスイッチ。
      boolean McuVersionInfoApi: set at pre-compile  # Pre-processor switch to enable / disable the API to read out the modules version information. / モジュールのバージョン情報を読み出すAPIを有効/無効にするためプリプロセッサスイッチ。
    container McuModuleConfiguration  # This container contains the configuration (parameters) of the MCU driver / MCUドライバのコンフィグレーション（パラメータ）を含むコンテナ。
      enumeration McuClockSrcFailureNotification: {DISABLED, ENABLED}, post-build-variant-value=true, set at post-build in variant post-build / pre-compile in variant pre-compile  # Enables/Disables clock failure notification. In case this feature is not supported by HW the setting should be disabled. / クロック障害通知の有効/無効スイッチ。 この機能はハードウェアでサポートされていない場合、設定は無効にする必要がある。 0：DISABLED：無効 1：ENABLED：有効
      integer McuNumberOfMcuModes: 1..255, post-build-variant-value=true, set at post-build in variant post-build / pre-compile in variant pre-compile  # This parameter shall represent the number of Modes available for the MCU. / MCUで使用できるモードの数。 McuModeSettingConfコンテナ数がモード数となる。 | calculationFormula = Number of configured McuModeSettingConf
      integer McuRamSectors: 0..4294967295, post-build-variant-value=true, set at post-build in variant post-build / pre-compile in variant pre-compile  # This parameter shall represent the number of RAM sectors available for the MCU. / MCUの使用可能なRAMのセクタ数。 McuRamSectorSettingConfコンテナ数がセクタ数となる。 | calculationFormula = Number of configured McuRamSectorSettingConf
      integer McuResetSetting [0..1]: 1..255, multiplicity set at pre-compile, set at pre-compile  # This parameter relates to the MCU specific reset configuration. This applies to the function Mcu_PerformReset, which performs a microcontroller reset using the hardware feature of the microcontroller. / マイクロコントローラのハードウェア機能を使用して、マイコンのリセットを実行する関数のMcu_PerformReset()のリセットタイプ。
      container McuClockSettingConfig [1..*]  # This container contains the configuration (parameters) for the Clock settings of the MCU. Please see MCU031 for more information on the MCU clock settings. / このコンテナにはMCUのクロック設定のコンフィグレーション（パラメータ）が含まれる。 MCUのクロック設定についてはMCU031を参照のこと。
        integer McuClockSettingId: 0..255, set at pre-compile, symbolic-name-value=true  # The Id of this McuClockSettingConfig to be used as argument for the API call "Mcu_InitClock". / このMcuClockSettingConfigのIDはAPI呼び出し"Mcu_InitClock"の引数として使用される。
        container McuClockReferencePoint [1..*]  # This container defines a reference point in the Mcu Clock tree. It defines the frequency which then can be used by other modules as an input value. Lower multiplicity is 1, as even in the simplest case (only one frequency is used), there is one frequency to be defined. / このコンテナはMCUクロックツリーの参照点を定義する、他のモジュールで入力値として使用できる周波数を参照するデータ。 最小の多重度では1つの周波数が定義されている。（1つの周波数のみ使用の場合）
          float McuClockReferencePointFrequency: 0..Inf, scope=ECU, post-build-variant-value=true, set at post-build in variant post-build / pre-compile in variant pre-compile  # This is the frequency for the specific instance of the McuClockReferencePoint container. It shall be given in Hz. / これはMcuClockReferencePointコンテナの特定のインスタンスのための周波数である。 それはHzで与えられなければならない。
      container McuDemEventParameterRefs [0..1]  # Container for the references to DemEventParameter elements which shall be invoked using the API Dem_ReportErrorStatus API in case the corresponding error occurs. The EventId is taken from the referenced DemEventParameter's DemEventId symbolic name. The standardized errors are provided in the container and can be extended by vendor specific error references. / DemEventParameter要素への参照コンテナ。
        symbolic name reference MCU_E_CLOCK_FAILURE [0..1]: multiplicity set at pre-compile, set at pre-compile, destination=DemEventParameter  # Reference to configured DEM event to report "Clock source failure". / クロック障害通知が有効かつクロックソース障害エラーが発生した場合に通知されるDEMイベント。
      container McuModeSettingConf [1..*]  # This container contains the configuration (parameters) for the Mode setting of the MCU. Please see MCU035 for more information on the MCU mode settings. / このコンテナは、MCUモード設定用のコンフィグレーション（パラメータ）。MCUモードの詳細についてはMCU035を参照のこと。
        integer McuMode: 0..255, set at pre-compile, symbolic-name-value=true  # The parameter represents the MCU Mode settings. / このMcuClockSettingConfigのIDはAPI呼び出し"Mcu_InitClock"の引数として使用される。
      container McuRamSectorSettingConf [0..*]  # This container contains the configuration (parameters) for the RAM Sector setting. Please see MCU030 for more information on RAM sec-tor settings. / このコンテナは、RAMセクタ設定のコンフィグレーション（パラメータ）。 RAMセクタの設定詳細についてはMCU030を参照のこと。
        integer McuRamDefaultValue: 0..255, post-build-variant-value=true, set at post-build in variant post-build / pre-compile in variant pre-compile  # This parameter shall represent the Data pre-setting to be initialized / pre-settingで初期化される値。
        integer McuRamSectionBaseAddress: 0..4294967295, post-build-variant-value=true, set at post-build in variant post-build / pre-compile in variant pre-compile  # This parameter shall represent the MCU RAM section base address / MCU RAMセクションのベースアドレス。
        integer McuRamSectionSize: 0..4294967295, post-build-variant-value=true, set at post-build in variant post-build / pre-compile in variant pre-compile  # This parameter represents the MCU RAM Section size in bytes. / バイト単位のMCU RAMセクションサイズ。
    container McuPublishedInformation  # Container holding all MCU specific published information parameters / MCU固有の公開情報、パラメータ保持コンテナ。
      container McuResetReasonConf [1..*]  # This container contains the configuration for the different type of reset reason that can be retrieved from Mcu_GetResetReason Api. / このコンテナは Mcu_GetResetReason APIから取得できるリセットの理由の異なるタイプのコンフィグレーションが含まれる。
        integer McuResetReason: 0..255, scope=ECU, set at published-information, symbolic-name-value=true  # The parameter represents the different type of reset that a Micro supports. This parameter is referenced by the parameter EcuMResetReason in the ECU State manager module. / CPUがサポートするリセット理由。 このパラメータはECUステートマネジャーモジュールのパラメータ EcuMResetReasonに設定される。

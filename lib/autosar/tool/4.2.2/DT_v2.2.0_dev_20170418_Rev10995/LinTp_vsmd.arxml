AUTOSAR XML (schema 4-2-2)
package /QINeS
  ecuc definition collection AUTOSARParameterDefinition: module=LinTp
  module definition LinTp [0..1]: refined-module-def=LinTp, post-build-variant-support=true, variants link-time/post-build/pre-compile  # Configuration of the LIN Transport Protocol. / LIN TPのコンフィグレーション。
    container LinTpGeneral  # Container that holds all LIN transport protocol general parameters. / LIN TPのジェネラルパラメータ。
      boolean LinTpChangeParameterApi: set at pre-compile  # This parameter, if set to true, enables the LinTp_ChangeParameterRequest Api for this Module.
      boolean LinTpVersionInfoApi: set at pre-compile  # Switches the LinTp_GetVersionInfo function ON or OFF. / TRUE：LinTp_GetVersionInfoを有効にする FALSE：LinTp_GetVersionInfoを無効にする
    container LinTpGlobalConfig [1..*]  # This container contains the global configuration parameters of the LinTp. / LIN TPのグローバルコンフィグレーション。
      integer LinTpMaxNumberOfRespPendingFrames: 0..65535, post-build-variant-value=true, set at link in variant link-time / post-build in variant post-build / pre-compile in variant pre-compile  # Configures the maximum number of allowed response pending frames. / 保留可能なフレームの最大数。
      integer LinTpMaxRxNSduCnt [0..0]: 0..65535, set at link in variant link-time+post-build / pre-compile in variant pre-compile  # Maximum number of NSdus. This parameter is needed only in case of post-build loadable implementation using static memory allocation.
      integer LinTpMaxTxNSduCnt [0..0]: 0..65535, set at link in variant link-time+post-build / pre-compile in variant pre-compile  # Maximum number of NSdus. This parameter is needed only in case of post-build loadable implementation using static memory allocation.
      float LinTpP2Max: 0.05..2, post-build-variant-value=true, set at link in variant link-time / post-build in variant post-build / pre-compile in variant pre-compile  # P2*max timeout when a response pending frame is expected in seconds. / 保留フレームに対するP2タイマのタイムアウト値。 | Note that the minimum value of LinTpP2Max shall be more than or equal to the value of LinTpP2Timing.
      float LinTpP2Timing: 0.05..0.5, post-build-variant-value=true, set at link in variant link-time / post-build in variant post-build / pre-compile in variant pre-compile  # Definition of the P2max timeout observation parameter in seconds. / P2タイマのタイムアウト値。[sec]単位（小数第三位まで入力可）。
      container LinTpChannelConfig [0..*]: multiplicity set at link in variant link-time / post-build in variant post-build / pre-compile in variant pre-compile, post-build-variant-multiplicity=true  # This container contains the channel specific configuration parameters of LinTp. / LIN TPで使用するチャネルの設定。
        boolean LinTpDropNotRequestedNad: post-build-variant-value=true, set at link in variant link-time / post-build in variant post-build / pre-compile in variant pre-compile, default-value=false  # Configures if TP Frames of not requested LIN-Slaves are dropped or not. / リクエストしたスレーブ以外のNADからのTPフレームを受信するかどうかを決定するフラグ。 TRUE：リクエストしていないスレーブからのフレームをドロップする FALSE：リクエストしていないスレーブからのフレームをドロップしない | TRUE: Drop TP Frames of not requested LIN-Slaves FALSE: Keep TP Frames of not requested LIN-Slaves
        boolean LinTpScheduleChangeDiag: post-build-variant-value=true, set at link in variant link-time / post-build in variant post-build / pre-compile in variant pre-compile, default-value=true  # Enables or disables the call of BswM_LinTp_RequestMode() to diagnostic request/response schedule. / TPフレームの送受信完了時にBswMのサービスBswM_LinTp_RequestModeをコールして故障診断スケジュールの切替を行うかどうかを決定するフラグ。 TRUE：スケジュール切替を依頼する FALSE：スケジュール切替を依頼しない | false: BswM is not called true: BswM is called
        symbolic name reference LinTpChannelRef: post-build-variant-value=true, set at link in variant link-time / post-build in variant post-build / pre-compile in variant pre-compile, destination=ComMChannel  # Index of the channel this LinTp channel belongs to.
      container LinTpRxNSdu [0..*]: multiplicity set at link in variant link-time / post-build in variant post-build / pre-compile in variant pre-compile, post-build-variant-multiplicity=true  # This container exists once for each received N-SDU on any channel the node is connected to. / ノードがつながっている任意のチャネルが受信するN-SDUの情報。
        float LinTpNcr [0..1]: 0..1, multiplicity set at link in variant link-time / post-build in variant post-build / pre-compile in variant pre-compile, post-build-variant-multiplicity=true, post-build-variant-value=true, set at link in variant link-time / post-build in variant post-build / pre-compile in variant pre-compile  # Value in seconds of the N_Cr timeout. N_Cr is the time until reception of the next Consecutive Frame N_PDU. / N_Crタイマのタイムアウト値。[sec]単位（小数第三位まで入力可）。
        integer LinTpRxNSduId: 0..65535, set at pre-compile, symbolic-name-value=true  # The identifier of the Transport Protocol message. This ID will be used by upper layers to call LinTp_ChangeParameter and LinTp_CancelReceive. / TPメッセージID。 このIDは上位モジュールがLinTpに処理を依頼するときに使用される。
        integer LinTpRxNSduNad: 0..255, post-build-variant-value=true, set at link in variant link-time / post-build in variant post-build / pre-compile in variant pre-compile  # A N-SDU transported on LIN is identified using the NAD for the specific slave. / スレーブのNAD。
        reference LinTpRxNSduPduRef: scope=ECU, post-build-variant-value=true, set at link in variant link-time / post-build in variant post-build / pre-compile in variant pre-compile, destination=Pdu  # Reference to the global PDU / PDUへの参照。
        symbolic name reference LinTpRxNSduChannelRef: set at link in variant link-time+post-build / pre-compile in variant pre-compile, destination=ComMChannel  # Index of the channel this N-SDU belongs to. / N-SDUが属するチャネルのインデックス。
      container LinTpTxNSdu [0..*]: multiplicity set at link in variant link-time / post-build in variant post-build / pre-compile in variant pre-compile, post-build-variant-multiplicity=true  # This container exists once for each transmitted N-SDU on any channel the node is connected to. / ノードがつながっている任意のチャネルが送信するN-SDUの情報。
        integer LinTpMaxBufReq: 0..255, post-build-variant-value=true, set at link in variant link-time / post-build in variant post-build / pre-compile in variant pre-compile  # This parameter defines the maximum number of times the LinTp should request upper layer for the Tx Buffer. It is also used to limit the number of retries for PduR_LinTpCopyTxData when no timer is active.
        float LinTpNas: 0..1, post-build-variant-value=true, set at link in variant link-time / post-build in variant post-build / pre-compile in variant pre-compile  # Value in seconds of the N_As timeout. N_As is the time for transmission of a LIN frame (any N_PDU) on the part of the sender. / N_Asタイマのタイムアウト値。[sec]単位（小数第三位まで入力可）。
        float LinTpNcs [0..1]: 0..1, multiplicity set at link in variant link-time / post-build in variant post-build / pre-compile in variant pre-compile, post-build-variant-multiplicity=true, post-build-variant-value=true, set at link in variant link-time / post-build in variant post-build / pre-compile in variant pre-compile  # Value in seconds of the performance requirement of N_Cs. N_Cs is the time which elapses between the transmit request of a CF N-PDU until the transmit request of the next CF N-PDU. / N_Csタイマのタイムアウト値。[sec]単位（小数第三位まで入力可）。
        integer LinTpTxNSduId: 0..65535, set at pre-compile, symbolic-name-value=true  # The identifier of the Transport Protocol message. This ID will be the one that is communicated with upper layers. / TPメッセージID。 このIDは上位モジュールがLinTpに処理を依頼するときに使用される。
        integer LinTpTxNSduNad: 0..255, post-build-variant-value=true, set at link in variant link-time / post-build in variant post-build / pre-compile in variant pre-compile  # A N-SDU transported on LIN is identified using the NAD for the specific slave. / スレーブのNAD。
        reference LinTpTxNSduPduRef: scope=ECU, post-build-variant-value=true, set at link in variant link-time / post-build in variant post-build / pre-compile in variant pre-compile, destination=Pdu  # Reference to the global PDU / PDUへの参照。
        symbolic name reference LinTpTxNSduChannelRef: set at link in variant link-time+post-build / pre-compile in variant pre-compile, destination=ComMChannel  # Index of the channel this N-SDU belongs to. / N-SDUが属するチャネルのインデックス。

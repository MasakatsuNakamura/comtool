AUTOSAR XML (schema 4-2-2)
package /QINeS
  ecuc definition collection AUTOSARParameterDefinition: module=NvM
  module definition NvM [0..1]: refined-module-def=NvM, variants link-time/pre-compile  # Configuration of the NvM (NvRam Manager) module. / NvMモジュールのコンフィグレーション。
    container NvMBlockDescriptor [1..65536]  # Container for a management structure to configure the composition of a given NVRAM Block Management Type. Its multiplicity describes the number of configured NVRAM blocks, one block is required to be configured. The NVRAM block descriptors are condensed in the NVRAM block descriptor table. / ブロックディスクリプタデータ。 与えられたNVRAMブロック管理タイプの構成をコンフィグレーションするための管理構造のコンテナ。 NVRAMブロック数分のコンフィグレーションが記述され、少なくとも1ブロック分のコンフィグレーションが必要である。 NVRAMブロックディスクリプタは、NVRAMブロックディスクリプタテーブルに圧縮される。
      enumeration NvMBlockCrcType: {NVM_CRC16, NVM_CRC32}, multiplicity set at link in variant link-time / pre-compile in variant pre-compile, set at link in variant link-time / pre-compile in variant pre-compile  # Defines CRC data width for the NVRAM block. Default: NVM_CRC16, i.e. CRC16 will be used if NVM_BLOCK_USE_CRC==true / NVRAMブロックのCRC種別。
      string NvMBlockHeaderInclude: multiplicity set at link in variant link-time / pre-compile in variant pre-compile, set at link in variant link-time / pre-compile in variant pre-compile  # Defines the header file where the owner of the NVRAM block has the declarations of the permanent RAM data block, ROM data block (if configured) and the callback function prototype for each configured callback. If no permanent RAM block, ROM block or callback functions are configured then this configuration parameter shall be ignored.
      integer NvMBlockJobPriority: 0..255, set at link in variant link-time / pre-compile in variant pre-compile, default-value=1  # Defines the job priority for a NVRAM block (0 = Immediate priority). / NVRAMブロックのジョブ優先度。 0：即時優先度 1-255：優先度 ※サポートしていない。1を設定する。
      enumeration NvMBlockManagementType: {NVM_Q_BLOCK_NONE, NVM_BLOCK_DATASET, NVM_BLOCK_NATIVE, NVM_BLOCK_REDUNDANT}, set at link in variant link-time / pre-compile in variant pre-compile  # Defines the block management type for the NVRAM block.[NVM137] / NVRAMブロックのブロック管理タイプ。 NVM_Q_BLOCK_NONE：未定義（設定しない） NVM_BLOCK_NATIVE：ネイティブ NVM_BLOCK_REDUNDANT：冗長 NVM_BLOCK_DATASET：データセット
      boolean NvMBlockUseAutoValidation: set at link in variant link-time / pre-compile in variant pre-compile  # Defines whether the RAM Block shall be auto validated during shutdown phase. | true: if auto validation mechanism is used, false: otherwise
      boolean NvMBlockUseCRCCompMechanism: set at link in variant link-time / pre-compile in variant pre-compile  # Defines whether the CRC of the RAM Block shall be compared during a write job with the CRC which was calculated during the last successful read or write job. | true: if compare mechanism is used, false: otherwise
      boolean NvMBlockUseCrc: set at link in variant link-time / pre-compile in variant pre-compile  # Defines CRC usage for the NVRAM block, i.e. memory space for CRC is reserved in RAM and NV memory. / NVRAMブロックのCRC計算の有効/無効を設定する。 TRUE：CRC有効 FALSE：CRC無効 | true: CRC will be used for this NVRAM block. false: CRC will not be used for this NVRAM block.
      boolean NvMBlockUseSetRamBlockStatus: set at link in variant link-time / pre-compile in variant pre-compile  # Defines if NvMSetRamBlockStatusApi shall be used for this block or not. / RAMブロックのステータスの有効/無効を設定する。 TRUE：RAMブロックステータス有効 FALSE：RAMブロックステータス無効 | Note: If NvMSetRamBlockStatusApi is disabled this configuration parameter shall be ignored. true: calling of NvMSetRamBlockStatus for this RAM block shall set the status of the RAM block. false: calling of NvMSetRamBlockStatus for this RAM block shall be ignored.
      boolean NvMBlockUseSyncMechanism: set at link in variant link-time / pre-compile in variant pre-compile  # Defines whether an explicit synchronization mechanism with a RAM mirror and callback routines for transferring data to and from NvM module's RAM mirror is used for NV block. true if synchronization mechanism is used, false otherwise. / RAMミラーの同期メカニズムの有効/無効を設定する。 同期メカニズムを有効にした場合、リード実行後、ライト実行前にCallbackを呼び出す。 TRUE：同期メカニズムを有効 FALSE：同期メカニズムを無効
      boolean NvMBlockWriteProt: set at link in variant link-time / pre-compile in variant pre-compile  # Defines an initial write protection of the NV block / NVブロックのライトプロテクト初期設定。 TRUE：ライトプロテクトを有効 FALSE：ライトプロテクトを無効 | true: Initial block write protection is enabled. false: Initial block write protection is disabled.
      boolean NvMBswMBlockStatusInformation: set at link in variant link-time / pre-compile in variant pre-compile, default-value=false  # This parameter specifies whether BswM is informed about the current status of the specified block. / BswMへのステータス変更通知。 有効にした場合、BswM_NvM_CurrentBlockModeを呼び出す。 TRUE：BswMへのステータス変更通知を有効 FALSE：BswMへのステータス変更通知を無効 ※サポートしていない。 | True: Call BswM_NvM_CurrentBlockMode on changes False: Don&rsquo;t inform BswM at all
      boolean NvMCalcRamBlockCrc: multiplicity set at link in variant link-time / pre-compile in variant pre-compile, set at link in variant link-time / pre-compile in variant pre-compile, default-value=false  # Defines CRC (re)calculation for the permanent RAM block or NVRAM blocks which are configured to use explicit synchronization mechanism. / 同期メカニズム有効時のCRC計算の有効/無効を設定する。 TRUE：CRC有効 FALSE：CRC無効 ※サポートしていない。 | true: CRC will be (re)calculated for this permanent RAM block. false: CRC will not be (re)calculated for this permanent RAM block.
      function name NvMInitBlockCallback: multiplicity set at link in variant link-time / pre-compile in variant pre-compile, set at link in variant link-time / pre-compile in variant pre-compile  # Entry address of a block specific callback routine which shall be called if no ROM data is available for initialization of the NVRAM block. / NVRAMブロック初期化コールバック。 リストア処理時、NVRAMブロックにROMブロックがない場合に呼ばれるCallbackルーチンである。 NULL：初期化コールバックを呼ばない。 | If not configured, no specific callback routine shall be called for initialization of the NVRAM block with default data.
      integer NvMMaxNumOfReadRetries: 0..7, set at link in variant link-time / pre-compile in variant pre-compile, default-value=0  # Defines the maximum number of read retries. / リードリトライの最大回数。(0..7) ※サポートしていない。0を設定する。
      integer NvMMaxNumOfWriteRetries: 0..7, set at link in variant link-time / pre-compile in variant pre-compile  # Defines the maximum number of write retries for a NVRAM block with [ECUC_NvM_00061]. Regardless of configuration a consistency check (and maybe write retries) are always forced for each block which is processed by the request NvM_WriteAll and NvM_WriteBlock. / ライトリトライの最大回数。(0..7)
      integer NvMNvBlockBaseNumber: 1..65534, set at link in variant link-time / pre-compile in variant pre-compile  # Configuration parameter to perform the link between the NVM_NVRAM_BLOCK_IDENTIFIER used by the SW-Cs and the FEE_BLOCK_NUMBER expected by the memory abstraction modules. The parameter value equals the FEE_BLOCK_NUMBER or EA_BLOCK_NUMBER shifted to the right by NvMDatasetSelectionBits bits. (ref. to chapter 7.1.2.1). / ブロックベースナンバー。(1..65534) NVRAMブロックと下層モジュールのブロックを関連付けるためのパラメータ。 NvMNvBlockBaseNumberの値は、1つ目の値から始まり、コンテナの生成順にインクリメントされた値を入力しなければならない。 | Calculation Formula: value = TargetBlockReference.[Ea/Fee]BlockConfiguration.[Ea/Fee]BlockNumber >> NvMDatasetSelectionBits
      integer NvMNvBlockLength: 1..65535, set at link in variant link-time / pre-compile in variant pre-compile  # Defines the NV block data length in bytes. / NVブロックのデータ長のバイト数。(1..65535) | Note: The implementer can add the attribute 'withAuto' to the parameter definition which indicates that the length can be calculated by the generator automatically (e.g. by using the sizeof operator). When 'withAuto' is set to 'true' for this parameter definition the 'isAutoValue' can be set to 'true'. If 'isAutoValue' is set to 'true' the actual value will not be considered during ECU Configuration but will be (re-)calculated by the code generator and stored in the value attribute afterwards.
      integer NvMNvBlockNum: 1..255, set at link in variant link-time / pre-compile in variant pre-compile  # Defines the number of multiple NV blocks in a contiguous area according to the given block management type. / NVブロック数。 ブロック管理タイプによって、設定可能なNVブロック数が異なる。 1：NVM_BLOCK_NATIVE 2：NVM_BLOCK_REDUNDANT (1..255)：NVM_BLOCK_DATASET | 1-255 For NVRAM blocks to be configured of block management type NVM_BLOCK_DATASET. The actual range is limited according to SWS_NvM_00444. 1 For NVRAM blocks to be configured of block management type NVM_BLOCK_NATIVE 2 For NVRAM blocks to be configured of block management type NVM_BLOCK_REDUNDANT
      integer NvMNvramBlockIdentifier: 2..65535, set at pre-compile, symbolic-name-value=true  # Identification of a NVRAM block via a unique block identifier. / NVRAMブロックID範囲は以下の通りである。 2～2の(16- NVM_DATASET_SELECTION_BITS)乗-1とする。 0と1は予約NVRAMブロックIDである。 0：マルチブロックリクエスト結果を保持し、NvM_GetErrorStatus関数で取得することができる。 1：NVメモリレイアウトに関するコンフィグレーションIDを保持する冗長NVRAMブロック（サポートしていない） NvMNvramBlockIdentifierの値は、２から始まり、コンテナの生成順にインクリメントされた値を入力しなければならない。 | Implementation Type: NvM_BlockIdType. min = 1 max = 2^(16- NVM_DATASET_SELECTION_BITS)-1 Reserved NVRAM block IDs: 0 -> to derive multi block request results via NvM_GetErrorStatus 1 -> redundant NVRAM block which holds the configuration ID (generation tool should check that this block is correctly configured from type,CRC and size point of view)
      integer NvMNvramDeviceId: 0..254, set at link in variant link-time / pre-compile in variant pre-compile  # Defines the NVRAM device ID where the NVRAM block is located. / NVRAMデバイスID。(0..254) 下層モジュール（Ea/Fee）のコンフィグレーションのDeviceIndexを参照する。 | Calculation Formula: value = TargetBlockReference.[Ea/Fee]BlockConfiguration.[Ea/Fee]DeviceIndex
      string NvMRamBlockDataAddress: multiplicity set at link in variant link-time / pre-compile in variant pre-compile, set at link in variant link-time / pre-compile in variant pre-compile  # Defines the start address of the RAM block data. / RAMブロックの開始アドレス 。 NULLの場合、パーマネントRAMブロックは利用できない。 | If this is not configured, no permanent RAM data block is available for the selected block management type.
      function name NvMReadRamBlockFromNvCallback: multiplicity set at link in variant link-time / pre-compile in variant pre-compile, set at link in variant link-time / pre-compile in variant pre-compile  # Entry address of a block specific callback routine which shall be called in order to let the application copy data from the NvM module's mirror to RAM block. / RAMミラーリードコピーコールバック。 アプリケーションがデータをNvMモジュールのRAMミラーからRAMブロックへコピーするために呼ぶCallbackルーチンである。 | Implementation type: Std_ReturnType E_OK: copy was successful E_NOT_OK: copy was not successful, callback routine to be called again
      boolean NvMResistantToChangedSw: set at link in variant link-time / pre-compile in variant pre-compile, default-value=false  # Defines whether a NVRAM block shall be treated resistant to configuration changes or not. If there is no default data available at configuration time then the application shall be responsible for providing the default initialization data. In this case the application has to use NvM_GetErrorStatus()to be able to distinguish between first initialization and corrupted data. / コンフィグレーション変更の耐性スイッチ。 TRUE：コンフィグレーション変更の耐性が有効 FALSE：コンフィグレーション変更の耐性が無効 ※サポートしていない。 | true: NVRAM block is resistant to changed software. false: NVRAM block is not resistant to changed software.
      string NvMRomBlockDataAddress: multiplicity set at link in variant link-time / pre-compile in variant pre-compile, set at link in variant link-time / pre-compile in variant pre-compile  # Defines the start address of the ROM block data. / ROMブロックの開始アドレス。 NULLの場合、ROMブロックは利用できない。 | If not configured, no ROM block is available for the selected block management type.
      integer NvMRomBlockNum: 0..255, set at link in variant link-time / pre-compile in variant pre-compile  # Defines the number of multiple ROM blocks in a contiguous area according to the given block management type. / ROMブロック数。 ブロック管理タイプによって、連続領域内のROMブロックの数を設定する。 0..1：NVM_BLOCK_NATIVE 0..1：NVM_BLOCK_REDUNDANT 0..255：NVM_BLOCK_DATASET | 0-254 For NVRAM blocks to be configured of block management type NVM_BLOCK_DATASET. The actual range is limited according to SWS_NvM_00444. 0-1 For NVRAM blocks to be configured of block management type NVM_BLOCK_NATIVE 0-1 For NVRAM blocks to be configured of block management type NVM_BLOCK_REDUNDANT
      boolean NvMSelectBlockForReadAll: multiplicity set at link in variant link-time / pre-compile in variant pre-compile, set at link in variant link-time / pre-compile in variant pre-compile  # Defines whether a NVRAM block shall be processed during NvM_ReadAll or not. This configuration parameter has only influence on those NVRAM blocks which are configured to have a permanent RAM block or which are configured to use explicit synchronization mechanism. / NvM_ReadAll処理スイッチ。 NvM_ReadAllでリード処理を行うか設定する。 TRUE：NvM_ReadAllで処理する FALSE：NvM_ReadAllで処理しない MAX=1 MIN=0 | true: NVRAM block shall be processed by NvM_ReadAll false: NVRAM block shall not be processed by NvM_ReadAll
      boolean NvMSelectBlockForWriteAll: multiplicity set at link in variant link-time / pre-compile in variant pre-compile, set at link in variant link-time / pre-compile in variant pre-compile  # Defines whether a NVRAM block shall be processed during NvM_WriteAll or not. This configuration parameter has only influence on those NVRAM blocks which are configured to have a permanent RAM block or which are configured to use explicit synchronization mechanism. / NvM_WriteAll処理スイッチ。 NvM_WriteAllでライト処理を行うか設定する。 TRUE：NvM_WriteAllで処理する FALSE：NvM_WriteAllで処理しない MAX=1 MIN=0 | true: NVRAM block shall be processed by NvM_WriteAll false: NVRAM block shall not be processed by NvM_WriteAll
      function name NvMSingleBlockCallback: multiplicity set at link in variant link-time / pre-compile in variant pre-compile, set at link in variant link-time / pre-compile in variant pre-compile  # Entry address of the block specific callback routine which shall be invoked on termination of each asynchronous single block request [NVM113]. / シングルブロックコールバック。 シングルブロックリクエストの終了において呼び出されるCallbackルーチンである。 NULL：シングルブロックコールバックを呼ばない。
      boolean NvMStaticBlockIDCheck: set at link in variant link-time / pre-compile in variant pre-compile  # Defines if the Static Block ID check is enabled. / 静的ブロックIDチェックスイッチ。 静的ブロックIDチェックを行う場合に有効にする。 TRUE：静的ブロックIDチェックを有効 FALSE：静的ブロックIDチェックを無効 MAX=1 MIN=0 | false: Static Block ID check is disabled. true: Static Block ID check is enabled.
      boolean NvMWriteBlockOnce: set at link in variant link-time / pre-compile in variant pre-compile, default-value=false  # Defines write protection after first write. The NVRAM manager sets the write protection bit after the NV block was written the first time. This means that some of the NV blocks in the NVRAM should never be erased nor be replaced with the default ROM data after first initialization. [NVM276]. / ライトワンススイッチ。 ライトワンスを有効にすると、最初の書込み処理後にライトプロテクトをセットする。 TRUE：ライトワンスを有効 FALSE：ライトワンスを無効 ※サポートしていない。 MAX=1 MIN=0 | true: Defines write protection after first write is enabled. false: Defines write protection after first write is disabled.
      function name NvMWriteRamBlockToNvCallback: multiplicity set at link in variant link-time / pre-compile in variant pre-compile, set at link in variant link-time / pre-compile in variant pre-compile  # Entry address of a block specific callback routine which shall be called in order to let the application copy data from RAM block to NvM module's mirror. / RAMミラーライトコピーコールバック。 アプリケーションがデータをRAMブロックからNvMモジュールのRAMミラーへコピーするために呼ぶCallbackルーチンである。 | Implementation type: Std_ReturnType E_OK: copy was successful E_NOT_OK: copy was not successful, callback routine to be called again
      boolean NvMWriteVerification: set at link in variant link-time / pre-compile in variant pre-compile, default-value=false  # Defines if Write Verification is enabled. / ライト検証スイッチ。 TRUE：ライト検証を有効 FALSE：ライト検証を無効 ※サポートしていない。 | false: Write verification is disabled. true: Write Verification is enabled.
      integer NvMWriteVerificationDataSize: 1..65535, set at link in variant link-time / pre-compile in variant pre-compile, default-value=1  # Defines the number of bytes to compare in each step when comparing the content of a RAM Block and a block read back. / ライト検証データサイズ。（1..65535） ライトしたNVブロックの内容を検証するためのバイト数を設定する。 ※サポートしていない。1を設定する。 MAX=65535 MIN=1
      choice container NvMTargetBlockReference  # This parameter is just a container for the parameters for EA and FEE / 下層モジュールのパラメータコンテナ。 下層モジュール（Ea/Fee）のブロックコンフィグレーションの参照に使用する。 ※サポートしていない。
        container NvMEaRef [0..1]  # EEPROM Abstraction / Eaのパラメータのコンテナ。 ※サポートしていない。
          symbolic name reference NvMNameOfEaBlock: set at link in variant link-time / pre-compile in variant pre-compile, destination=EaBlockConfiguration  # reference to EaBlock / Eaのパラメータ ※サポートしていない。
        container NvMFeeRef [0..1]  # Flash EEPROM Emulation / Feeのパラメータのコンテナ。
          symbolic name reference NvMNameOfFeeBlock: set at link in variant link-time / pre-compile in variant pre-compile, destination=FeeBlockConfiguration  # reference to FeeBlock / Feeのパラメータ ※サポートしていない。
    container NvMCommon  # Container for common configuration options. / 共通コンフィグレーションオプションのコンテナ。
      enumeration NvMApiConfigClass: {NVM_API_CONFIG_CLASS_1, NVM_API_CONFIG_CLASS_2, NVM_API_CONFIG_CLASS_3}, set at pre-compile, default-value=NVM_API_CONFIG_CLASS_1  # Preprocessor switch to enable some API calls which are related to NVM API configuration classes. / NVM APIコンフィグレーションクラスに関係するAPIコールを有効にするスイッチ。 NVM_API_CONFIG_CLASS_1：NVM APIコンフィグレーションクラス1 NVM_API_CONFIG_CLASS_2：NVM APIコンフィグレーションクラス2 NVM_API_CONFIG_CLASS_3：NVM APIコンフィグレーションクラス3
      boolean NvMBswMMultiBlockJobStatusInformation: set at link in variant link-time / pre-compile in variant pre-compile, default-value=true  # This parameter specifies whether BswM is informed about the current status of the multiblock job. / BswMにマルチブロックジョブの現在のステータス通知のスイッチ。 TRUE：通知する FALSE：通知しない | True: call BswM_NvM_CurrentJobMode if ReadAll and WriteAll are started, finished, canceled False: do not inform BswM at all
      integer NvMCompiledConfigId: 0..65535, set at pre-compile, default-value=0  # Configuration ID regarding the NV memory layout. This configuration ID shall be published as e.g. a SW-C shall have the possibility to write it to NV memory. / NVメモリレイアウトのコンフィグレーションID。
      integer NvMCrcNumOfBytes: 1..65535, set at link in variant link-time / pre-compile in variant pre-compile, default-value=65535  # If CRC is configured for at least one NVRAM block, this parameter defines the maximum number of bytes which shall be processed within one cycle of job processing. / CRCが1サイクル内で処理できる最大バイト数。
      integer NvMDatasetSelectionBits: 0..8, set at link in variant link-time / pre-compile in variant pre-compile, default-value=3  # Defines the number of least significant bits which shall be used to address a certain dataset of a NVRAM block within the interface to the memory hardware abstraction. / データセット／冗長NVRAMブロックに関連する下層モジュールのブロックのコンフィグレーションに使われるビット数。 | 0..8: Number of bits which are used for dataset or redundant block addressing. 0: No dataset or redundant NVRAM blocks are configured at all, no selection bits required. 1: In case of redundant NVRAM blocks are configured, but no dataset NVRAM blocks.
      boolean NvMDevErrorDetect: set at pre-compile, default-value=true  # Switches the Default Error Tracer (Det) detection and notification ON or OFF. / 開発時エラー検出スイッチ。 TRUE：開発時エラー検出有効 FALSE：開発時エラー検出無効 | * true: enabled (ON). * false: disabled (OFF).
      boolean NvMDrvModeSwitch: set at link in variant link-time / pre-compile in variant pre-compile, default-value=false  # Preprocessor switch to enable switching memory drivers to fast mode during performing NvM_ReadAll and NvM_WriteAll / メモリドライバモードスイッチ。 TRUE：高速モード切り替え有効 FALSE：高速モード切り替え無効 | true: Fast mode enabled. false: Fast mode disabled.
      boolean NvMDynamicConfiguration: set at link in variant link-time / pre-compile in variant pre-compile, default-value=false  # Preprocessor switch to enable the dynamic configuration management handling by the NvM_ReadAll request. / マルチブロックリードリクエストによる動的コンフィグレーション管理スイッチ。 TRUE：動的コンフィグレーション管理有効 FALSE：動的コンフィグレーション管理無効 | true: Dynamic configuration management handling enabled. false: Dynamic configuration management handling disabled.
      boolean NvMJobPrioritization: set at link in variant link-time / pre-compile in variant pre-compile, default-value=false  # Preprocessor switch to enable job prioritization handling / ジョブ優先度スイッチ。 TRUE：ジョブ優先度有効 FALSE：ジョブ優先度無効 | true: Job prioritization handling enabled. false: Job prioritization handling disabled.
      float NvMMainFunctionPeriod [0..0]: 1E-3..Inf, scope=ECU, set at pre-compile  # The period between successive calls to the main function in seconds.
      function name NvMMultiBlockCallback [0..1]: multiplicity set at link in variant link-time / pre-compile in variant pre-compile, set at link in variant link-time / pre-compile in variant pre-compile  # Entry address of the common callback routine which shall be invoked on termination of each asynchronous multi block request / マルチブロックコールバック。
      boolean NvMPollingMode: set at link in variant link-time / pre-compile in variant pre-compile, default-value=false  # Preprocessor switch to enable/disable the polling mode in the NVRAM Manager and at the same time disable/enable the callback functions useable by lower layers / ポーリングモード有効/無効スイッチ。 TRUE：ポーリングモード有効 FALSE：ポーリングモード無効 | true: Polling mode enabled, callback function usage disabled. false: Polling mode disabled, callback function usage enabled.
      integer NVM_Q_NUM_OF_BLOCK_DESCRIPTOR: 1..65535, origin=QINeS, default-value=8  # - / ブロックディスクリプタ数。 | -
      boolean NVM_Q_USE_BSWM: set at link in variant link-time / pre-compile in variant pre-compile, origin=QINeS, default-value=true  # - / BswM使用フラグ。
      integer NvMRepeatMirrorOperations: 0..7, set at link in variant link-time / pre-compile in variant pre-compile, default-value=0  # Defines the number of retries to let the application copy data to or from the NvM module's mirror before postponing the current job. / RAMミラーコピーのリトライ回数。
      boolean NvMSetRamBlockStatusApi: set at pre-compile, default-value=true  # Preprocessor switch to enable the API NvM_SetRamBlockStatus. / NvM_SetRamBlockStatus APIスイッチ。 TRUE：NvM_SetRamBlockStatus有効 FALSE：NvM_SetRamBlockStatus無効 | true: API NvM_SetRamBlockStatus enabled. false: API NvM_SetRamBlockStatus disabled.
      integer NvMSizeImmediateJobQueue: 1..65535, multiplicity set at link in variant link-time / pre-compile in variant pre-compile, set at link in variant link-time / pre-compile in variant pre-compile, default-value=4  # Defines the number of queue entries for the immediate priority job queue. If NVM_JOB_PRIORITIZATION is switched OFF this parameter shall be out of scope. / 即時ジョブキューの登録可能数。
      integer NvMSizeStandardJobQueue: 1..65535, set at link in variant link-time / pre-compile in variant pre-compile, default-value=4  # Defines the number of queue entries for the standard job queue. / 標準ジョブキューの登録可能数。
      boolean NvMVersionInfoApi: set at pre-compile, default-value=true  # Pre-processor switch to enable / disable the API to read out the modules version information [NVM285], [NVM286]. / バージョン情報取得関数。 TRUE：バージョン情報取得関数有効 FALSE：バージョン情報取得関数無効 | true: Version info API enabled. false: Version info API disabled.
    container NvmDemEventParameterRefs [0..1]  # Container for the references to DemEventParameter elements which shall be invoked using the API Dem_ReportErrorStatus API in case the corresponding error occurs. The EventId is taken from the referenced DemEventParameter's DemEventId value. The standardized errors are provided in the container and can be extended by vendor specific error references. / NvmDemEventParameterRefsコンテナへの参照ポインタ。
      symbolic name reference NVM_E_HARDWARE [0..1]: scope=ECU, multiplicity set at pre-compile, set at pre-compile, destination=DemEventParameter  # Reference to the DemEventParameter which shall be issued when the hardware error has occured.
      symbolic name reference NVM_E_INTEGRITY_FAILED [0..1]: scope=ECU, multiplicity set at pre-compile, set at pre-compile, destination=DemEventParameter  # Reference to the DemEventParameter which shall be issued when the error "API request integrity failed" has occurred. / Demに通知される実行時エラー：CRCエラー。
      symbolic name reference NVM_E_LOSS_OF_REDUNDANCY [0..1]: scope=ECU, multiplicity set at pre-compile, set at pre-compile, destination=DemEventParameter  # Reference to the DemEventParameter which shall be issued when the error "loss of redundancy" has occurred. / Demに通知される実行時エラー：冗長性喪失。
      symbolic name reference NVM_E_QUEUE_OVERFLOW [0..1]: scope=ECU, multiplicity set at pre-compile, set at pre-compile, destination=DemEventParameter  # Reference to the DemEventParameter which shall be issued when the error "NVRAM Managers job queue overflow" has occurred. / Demに通知される実行時エラー：ジョブキューがオーバーフロー。
      symbolic name reference NVM_E_REQ_FAILED [0..1]: scope=ECU, multiplicity set at pre-compile, set at pre-compile, destination=DemEventParameter  # Reference to the DemEventParameter which shall be issued when the error "API request failed" has occurred. / Demに通知される実行時エラー：APIリクエストで不正エラー。
      symbolic name reference NVM_E_VERIFY_FAILED [0..1]: scope=ECU, multiplicity set at pre-compile, set at pre-compile, destination=DemEventParameter  # Reference to the DemEventParameter which shall be issued when the error "Write Verification failed" has occurred. / Demに通知される実行時エラー：ライト検証エラー。
      symbolic name reference NVM_E_WRITE_PROTECTED [0..1]: scope=ECU, multiplicity set at pre-compile, set at pre-compile, destination=DemEventParameter  # Reference to the DemEventParameter which shall be issued when the error "write attempt to NVRAM block with write protection" has occurred. / Demに通知される実行時エラー：ライトプロテクトエラー。
      symbolic name reference NVM_E_WRONG_BLOCK_ID [0..1]: scope=ECU, multiplicity set at pre-compile, set at pre-compile, destination=DemEventParameter  # Reference to the DemEventParameter which shall be issued when the error "Static Block ID check failed" has occurred. / Demに通知される実行時エラー：静的ブロックIDが不一致。

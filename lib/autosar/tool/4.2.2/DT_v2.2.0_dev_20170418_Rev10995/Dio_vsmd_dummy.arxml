AUTOSAR XML (schema 4-2-2)
package /QINeS
  ecuc definition collection AUTOSARParameterDefinition: module=Dio
  module definition Dio [0..1]: refined-module-def=Dio, post-build-variant-support=true, variants link-time/pre-compile  # Configuration of the Dio (Digital IO) module. / Dioモジュールのコンフィグレーション。(MCAL ダミー)
    container DioConfig  # This container contains the configuration parameters and sub containers of the AUTOSAR DIO module. / Dioのコンフィグレーション。
      container DioPort [1..*]  # Configuration of individual DIO ports, consisting of channels and possible channel groups. / Dioドライバのコンフィグレーション（パラメータ）を含むコンテナ。 | Note that this container definition does not explicitly define a symbolic name parameter. Instead, the container's short name will be used in the Ecu Configuration Description to specify the symbolic name of the port.
        integer DioPortId: 0..4294967295, scope=ECU, set at pre-compile, symbolic-name-value=true  # Numeric identifier of the DIO port. Not all MCU ports may be used for DIO, thus there may be "gaps" in the list of all IDs. This value will be / DIOポートの数値識別子。 すべてではないMCUポートがDIOに使用することができる、従ってすべてのID群のリスト内の"gaps"があるかもしれない。 | assigned to the DIO port symbolic name (i.e. the SHORT-NAME of the DioPort container).
        container DioChannel [0..*]  # Configuration of an individual DIO channel. / Dioのチャンネルのポインタ。
          integer DioChannelId: 0..4294967295, scope=ECU, set at pre-compile, symbolic-name-value=true  # Channel Id of the DIO channel. This value will be assigned to the symbolic names. / DIOチャネルのチャネルID。 この値は、シンボル名に割り当てられる。
        container DioChannelGroup [0..*]  # Definition and configuration of DIO channel groups. A channel group represents several adjoining DIO channels represented by a logical group. / Dioのチャンネル・グループのポインタ。 | Note hat this container definition does not explicitly define a symbolic name parameter. Instead, the container's short name will be used in the Ecu Configuration Description to specify the symbolic name of the channel group.
          string DioChannelGroupIdentification: scope=ECU, set at pre-compile, symbolic-name-value=true  # The DIO channel group is identified in DIO API by a pointer to a data structure (of type Dio_ChannelGroupType). That data structure contains the channel group information. / DIOチャネルグループID。 DIOチャネルグループは、Dio_ChannelGroupTypeのポインタによって識別される。 | This parameter contains the code fragment that has to be inserted in the API call of the calling module to get the address of the variable in memory which holds the channel group information. Example values are "&MyDioGroup1" or "&MyDioGroupArray[0]"
          integer DioPortMask: 0..4294967295, set at link in variant link-time / pre-compile in variant pre-compile  # This shall be the mask which defines the positions of the channel / チャネルグループの位置を定義するマスク。 チャネルは、同じポートに隣接するビットでコンフィグレーションされなければならない。 | group. The channels shall consist of adjoining bits in the same port. The data type depends on the port width.
          integer DioPortOffset: 0..31, set at link in variant link-time / pre-compile in variant pre-compile  # The position of the Channel Group on the port, counted / ポート上のチャネルグループの位置。 LSBから数えたもので、この値はDioPortMaskから導出することができる。 | from the LSB. This value can be derived from DioPortMask. calculationFormula = Position of the first bit of DioPortMask which is set to '1' counted from LSB
    container DioGeneral  # General DIO module configuration parameters. / ジェネラルDIOモジュールのコンフィグレーションパラメータ。
      boolean DioDevErrorDetect: set at pre-compile  # Switches the Default Error Tracer (Det) detection and notification ON or OFF. / 開発エラー検出と報告を有効にするためのプリプロセッサスイッチ。 | * true: enabled (ON). * false: disabled (OFF).
      boolean DioFlipChannelApi: set at pre-compile  # Adds / removes the service Dio_FlipChannel() from the code. / Dio_FlipChannelコードを追加/削除するサービスプリプロセッサ。
      boolean DioVersionInfoApi: set at pre-compile  # Adds / removes the service Dio_ GetVersionInfo() from the code. / Dio_GetVersionInfoコードを追加/削除するサービスプリプロセッサ。

AUTOSAR XML (schema 4-2-2)
package /QINeS
  ecuc definition collection AUTOSARParameterDefinition: module=BswM
  module definition BswM [0..1]: refined-module-def=BswM, post-build-variant-support=true, variants link-time/post-build/pre-compile  # Configuration of the BswM (Basic SW Mode Manager) module. / BswMモジュールのコンフィグレーション。 (ダミー)
    container BswMConfig [1..*]  # This container contains the configuration parameters and sub containers of the AUTOSAR BswM module. This container exists once per partition. / このコンテナは、設定パラメータとAUTOSAR BswMモジュールのサブコンテナが含まれている。このコンテナは複数の構成コンテナである。すなわちこのコンテナとそのサブコンテナがコンフィグレーションセットごとに一度存在する。
      reference BswMPartitionRef: multiplicity set at pre-compile, set at pre-compile, destination=EcucPartition  # This references the partition the BswM shall run inside. / これはBswMは、内部で実行しなければならないパーティションを参照する。
      container BswMArbitration  # This container includes all configuration sub-containers and parameters related to the mode arbitration functionality of the BswM. / このコンテナは、BswMのモード調停機能に関連するすべての設定サブコンテナおよびパラメータが含まれている。
        container BswMLogicalExpression [1..*]: multiplicity set at pre-compile  # This container describes the logical expressions that can be used for the mode arbitration. The logical expressions are built of a set of arguments and a logical operator. / このコンテナはモード調停のために使用する論理式を記述する。論理式は、引数のセットと論理演算子で構築されている。 | Each argument can either be a mode condition or a sub-expression to allow definition of more complex logical expressions. There may be an unlimited number of arguments in each logical expression. Note that the order of evaluation of the expressions is not defined.
          enumeration BswMLogicalOperator [0..1]: {BSWM_AND, BSWM_NAND, BSWM_OR, BSWM_XOR, BSWM_NO_OPE}, multiplicity set at link in variant link-time+post-build / pre-compile in variant pre-compile, set at link in variant link-time+post-build / pre-compile in variant pre-compile  # This parameter specifies the logical operator to be used in the logical expression. If the expression only consists of a single condition this parameter shall not be used. / このパラメータは、論理式で使用する論理演算子を指定する。式は単一の条件から構成されている場合、このパラメータは、使用してはならない。
          choice reference BswMArgumentRef [1..*]: multiplicity set at link in variant link-time+post-build / pre-compile in variant pre-compile, set at link in variant link-time+post-build / pre-compile in variant pre-compile, destination=[BswMLogicalExpression, BswMModeCondition]  # This is a choice reference either to a mode condition or a sub-expression. / これは、モード条件または部分式のいずれかの選択参照である。 | In case the BswMLogicalExpression.BswMLogicalOperator equals BSWM_NAND only two operands are supported.
        container BswMModeCondition [1..*]: multiplicity set at pre-compile  # This container describes the BswM mode conditions that can be used either by itself to form a rule or as a part of a logical expression. / このコンテナは、ルールを作成するために単独で、または論理式の一部として使用できるBswMモード条件を記述する。
          enumeration BswMConditionType: {BSWM_EQUALS, BSWM_EQUALS_NOT}, set at link in variant link-time+post-build / pre-compile in variant pre-compile  # This parameter specifies what kind of comparison that is made for the evaluation of the mode condition. / このパラメータはモード条件の評価のために作られ、その比較の種類を指定する。
          reference BswMConditionMode: set at link in variant link-time+post-build / pre-compile in variant pre-compile, destination=BswMModeRequestPort  # This parameter references the mode request port that is used for the condition. / このパラメータは、条件に使用されるモード要求ポートを参照する。
          choice container BswMConditionValue [0..1]  # This container holds the parameters and references necessary to identify the mode type and the value that the mode request is compared to. / このコンテナはモードのタイプとモード要求と比較される値を識別するのに必要なパラメータと参照を保持している。
            container BswMBswMode [0..1]  # This container defines the value and type of a mode in the BSW. The mode value is defined by configuring either BswMBswRequestedMode or BswMCompuScaleModeValue. / このコンテナは、BSWモードの値と型を定義する。
              string BswMBswRequestedMode: multiplicity set at link in variant link-time+post-build / pre-compile in variant pre-compile, set at link in variant link-time+post-build / pre-compile in variant pre-compile  # This parameter contains the symbolic name (as a string) of a certain mode/state that can be requested/indicated by the BSW modules. / このパラメータは、BSWモジュールによって示される特定のモード/要求することができる状態/の（文字列として）シンボリック名が含まれている。
              container BswMCompuScaleModeValue [0..1]  # This container contains parameters used to define a mode value. / このコンテナには、モード値を定義するためのパラメータが含まれている。
                string BswMCompuConstText: post-build-variant-value=true, set at link in variant link-time / post-build in variant post-build / pre-compile in variant pre-compile  # The value of this parameter shall match the VT member of a CompuConst defined within the referenced CompuMethod (BswMCompuMethodRef). The interval value of the corresponding CompuScale shall be used as the mode request value. / このパラメータの値は、参照されるCompuMethod（BswMCompuMethodRef）内で定義されたCompuConstのVTメンバと一致しなければならない。 対応するCompuScaleの間隔値は、モード要求値として使用されるものとする。
                foreign reference BswMCompuMethodRef: post-build-variant-value=true, set at link in variant link-time / post-build in variant post-build / pre-compile in variant pre-compile, destination-type=COMPU-METHOD  # This is a foreign reference to the CompuMethod used for mode requests. The CompuMethod category shall be TEXTTABLE. / これは、モード要求に使用されるCompuMethodへの外部リファレンスである。CompuMethodカテゴリはTEXTTABLEとする。
            container BswMModeDeclaration [0..1]  # When the mode corresponds to a mode request or mode indication interface the mode is defined by a mode declaration. The mode declarations are defined in the SW-C Template and hence a foreign reference to the corresponding Mode Declaration is used. / モードは、モード要求またはモード表示インターフェースに対応する場合のモードは、モード宣言によって定義されている。モード宣言は、SW-Cテンプレートで定義されているので、対応するモード宣言への外部参照が使用される。
              foreign reference BswMModeValueRef: set at link in variant link-time+post-build / pre-compile in variant pre-compile, destination-type=MODE-DECLARATION  # This is a foreign reference to the Mode Declaration used for the mode requests corresponding to this condition. / これは、この条件に対応するモード要求のために使用されるモード宣言への外部参照である。
        container BswMModeRequestPort [1..*]: multiplicity set at pre-compile  # Each instance of this container defines a mode request interface that is used to requests or indicate modes from/to the BswM. These interfaces are implemented as ports or as ordinary C-functions based upon if the request is made by an SW-C or a BSW module. / このコンテナの各インスタンスは、要求に使用されるか、BswMから/へのモードを示すために使用されるモード要求インターフェースを定義する。これらのインターフェースは、ポートまたは要求がSW-CやBSWモジュールによって行われた場合に基づいとして通常のC関数として実装されている。 | There are different types of mode requests: 1. Mode requests from the SW-C:s 2. Mode Requests from other BSW modules such as the DCM. 3. State/mode indications from the RTE or other BSW modules such as the bus specific State Managers. Note that the BswM treats all request and indications in the exact same way.
          enumeration BswMRequestProcessing: {BSWM_DEFERRED, BSWM_IMMEDIATE}, set at link in variant link-time+post-build / pre-compile in variant pre-compile  # This parameter defines if the processing of the mode arbitration shall be done immediately when a mode request is received or if it shall be deferred to the processing of the main function of BswM. / このパラメータはモード要求を受信したか、BswMの主な機能の処理を延期しなければならないとき、モード調停の処理が直ちに行わなければならない場合に定義される。
          container BswMModeInitValue [0..1]  # This container defines the initial mode value that is used by BswM for the corresponding mode request after initialization. The initial mode value is defined by configuring either BswMBswModeInitValue or BswMCompuScaleModeValue. This container is optional. / このコンテナは、BswMが初期化後に対応するモード要求に使用する初期モード値を定義する。 This container is optional and shall only be used for Mode Requests that do not already have an initial value. このコンテナはオプションであり、初期値を持たないモード要求に対してのみ使用するものとする。
            string BswMBswModeInitValue [0..1]: multiplicity set at link in variant link-time / post-build in variant post-build / pre-compile in variant pre-compile, post-build-variant-multiplicity=true, post-build-variant-value=true, set at link in variant link-time / post-build in variant post-build / pre-compile in variant pre-compile  # This parameter defines the initial mode value that is used by BswM for the corresponding mode request after initialization. / これは、要求がBSWモジュールによって行われた場合のモード要求の初期化に使用される初期モード値の選択である。
            container BswMCompuScaleModeValue [0..1]  # This container contains parameters used to define a mode value. / このコンテナには、モード値を定義するためのパラメータが含まれている。
              string BswMCompuConstText: post-build-variant-value=true, set at link in variant link-time / post-build in variant post-build / pre-compile in variant pre-compile  # The value of this parameter shall match the VT member of a CompuConst defined within the referenced CompuMethod (BswMCompuMethodRef). The interval value of the corresponding CompuScale shall be used as the mode request value. / このパラメータの値は、参照されるCompuMethod（BswMCompuMethodRef）内で定義されたCompuConstのVTメンバと一致しなければならない。 対応するCompuScaleの間隔値は、モード要求値として使用されるものとする。
              foreign reference BswMCompuMethodRef: post-build-variant-value=true, set at link in variant link-time / post-build in variant post-build / pre-compile in variant pre-compile, destination-type=COMPU-METHOD  # This is a foreign reference to the CompuMethod used for mode requests. The CompuMethod category shall be TEXTTABLE. / これは、モード要求に使用されるCompuMethodへの外部リファレンスである。CompuMethodカテゴリはTEXTTABLEとする。
          choice container BswMModeRequestSource  # This choice container specifies the source of the mode request or state/mode indication. The requester of a mode can be both SW-C:s and other BSW Modules, such as the bus specific State Managers. / この選択コンテナが示すモード要求または状態/モードのソースを指定する。モードのリクエスタはSW-Csと、バスの特定のステートマネージャなど、他のBSWモジュールの両方をすることができる。
            container BswMBswMModeRequest [0..0]  # The source of the mode request is a BswM on another partition. This container is only relevant for multi-partition systems. Tags: atp.Status=obsolete, atp.StatusRevisionBegin=4.2.2 / モード要求のソースは別のパーティション上のBswMである。このコンテナは、マルチパーティション・システムにのみ関連している。
              foreign reference BswMBswMModeDeclarationGroupRef: set at link in variant link-time+post-build / pre-compile in variant pre-compile, destination-type=MODE-DECLARATION-GROUP  # This is a foreign reference to the Mode Declaration Group Prototype. Tags: atp.Status=obsolete, atp.StatusRevisionBegin=4.2.2 / これは、モード宣言グループプロトタイプへの外部参照である。
            container BswMBswMModeSwitchNotification [0..0]  # This indicates that another BswM has switched a mode. This container is only relevant for multi-partition systems. Tags: atp.Status=obsolete, atp.StatusRevisionBegin=4.2.2 / これは、別のBswMモードに切り替わったことを示している。このコンテナは、マルチパーティション・システムにのみ関連している。
              foreign reference BswMBswMModeDeclarationGroupRef: set at link in variant link-time+post-build / pre-compile in variant pre-compile, destination-type=MODE-DECLARATION-GROUP  # This is a foreign reference to the Mode Declaration Group Prototype. Tags: atp.Status=obsolete, atp.StatusRevisionBegin=4.2.2 / これは、モード宣言グループプロトタイプへの外部参照である。
            container BswMBswModeNotification [0..1]  # This is a mode request source emanating from another BSW Module. / これは、他のBSWモジュールから発するモード要求元である。
              foreign reference BswMBswModeDeclarationGroupPrototypeRef: set at link in variant link-time+post-build / pre-compile in variant pre-compile, destination-type=MODE-DECLARATION-GROUP-PROTOTYPE  # This is a foreign reference to the Mode Declaration Group Prototype. / これは、モード宣言グループプロトタイプへの外部参照である。
            container BswMCanSMIcomIndication [0..1]  # This is an indication from CanSM of the configuration Id of the Icom configuration / これはIcomコンフィグレーションのコンフィグレーションIDのCanSMからノ通知である
              boolean BswMCanSMIcomIndicationSwitchError: set at link in variant link-time+post-build / pre-compile in variant pre-compile, default-value=false  # When this parameter is set to true, then this mode request source corresponds to error indications from the CanSM. Otherwise, this mode request source corresponds to error-free indications from the CanSM. / このパラメータがtrueに設定されている場合、このモード要求ソースはCanSMからのエラー表示に対応する。 それ以外の場合、このモード要求ソースは、CanSMからのエラーのない表示に対応する。
              symbolic name reference BswMCanSMChannelRef: set at link in variant link-time+post-build / pre-compile in variant pre-compile, destination=ComMChannel  # This is a reference to the CAN channel handle that the mode request corresponds to. / これは、モード要求が対応するCANチャネルハンドルへの参照である。
            container BswMCanSMIndication [0..1]  # This is an indication of the current state of the CAN State Manager. / これがCANの状態マネージャの現在の状態の指標である。
              symbolic name reference BswMCanSMChannelRef: set at link in variant link-time+post-build / pre-compile in variant pre-compile, destination=ComMChannel  # This is a reference to the CAN channel handle that the mode request corresponds to. / これは、モード要求が対応するCANチャネルハンドルへの参照である。
            container BswMComMIndication [0..1]  # This is an indication of the current communication mode of a channel in the Communication Manager. / これはComMでのチャネルの現在の通信モードの指標である。
              symbolic name reference BswMComMChannelRef: set at link in variant link-time+post-build / pre-compile in variant pre-compile, destination=ComMChannel  # This is a reference to the Communication Manager channel handle that the indication corresponds to. / これは指示に対応するComMチャネルハンドルへの参照である。
            container BswMComMInitiateReset [0..1]  # This is an indication from the ComM to signal a shutdown. / これは、ComMからシャットダウンを知らせる指示である。
            container BswMComMPncRequest [0..1]  # This is a request of the current communication mode of a Partial Network Cluster in the Communication Manager. / これはComMの部分ネットワークのクラスタの現在の通信モードの要求である。
              symbolic name reference BswMComMPncRef: set at link in variant link-time+post-build / pre-compile in variant pre-compile, destination=ComMPnc  # This is a reference to the Communication Manager PNC handle of the Partial Network Cluster that the request corresponds to. / これはリクエストが対応する部分ネットワーククラスタの通信マネージャPNCハンドルへの参照である。
            container BswMDcmApplicationUpdatedIndication [0..0]  # This is a request to update application data from the DCM. This container does not contain any parameters since there are no further configuration needed for this type of request. / これは、DCMからアプリケーションデータを更新するための要求である。このタイプのリクエストのために必要な更なる構成はないので、このコンテナには、任意のパラメータが含まれていない。
            container BswMDcmComModeRequest [0..1]  # The source of the mode request is the Diagnostic Communication Manager. / 要求されたモードのソースはDcmである。
              symbolic name reference BswMDcmComMChannelRef: set at link in variant link-time+post-build / pre-compile in variant pre-compile, destination=ComMChannel  # This is a reference from DcmModeRequest to the ComM channel that the indication corresponds to. / これは、指示が対応するCOMMチャネルへDcmModeRequestからの参照である。
            container BswMEcuMIndication [0..1]  # This is a notification of the current operation mode of the ECU State Manager. This container does not contain any parameters since there are no further configuration needed for this type of request. / これはEcuMの現在の動作モードの通知である。このタイプのリクエストのために必要な更なる構成はないので、このコンテナには、任意のパラメータが含まれていない。
            container BswMEcuMRUNRequestIndication [0..1]  # This is an indication of the current State of the RUN Request Protocol. / これは、ECU State Managerウェイクアップソースの現在の状態の通知である。
              enumeration BswMEcuMRUNRequestProtocolPort: {POST_RUN, RUN, SHUTDOWN}, set at link in variant link-time+post-build / pre-compile in variant pre-compile  # Identifies the EcuM State which is related to the mode request. / モード要求に関連するEcuM状態を識別する。
            container BswMEcuMWakeupSource [0..1]  # This is a notification of the current state of an ECU State Manager wakeup source. / これはEcuMのウェイクアップソースの現在の状態の通知である。
              symbolic name reference BswMEcuMWakeupSrcRef: set at link in variant link-time+post-build / pre-compile in variant pre-compile, destination=EcuMWakeupSource  # This is a reference to the ECU State Manager Wakeup Source that the indication corresponds to. / これは対応する対象のEcuMウェイクアップソースへの参照である。
            container BswMEthSMIndication [0..1]  # This is an indication of the current state of the Ethernet State Manager. / これは、Ethernet State Managerの現在の状態を示す。
              symbolic name reference BswMEthSMChannelRef: set at link in variant link-time+post-build / pre-compile in variant pre-compile, destination=ComMChannel  # This is a reference to the Ethernet channel handle that the mode request corresponds to. / これは、モード要求が対応するイーサネットチャネルハンドルへの参照である。
            container BswMFrSMIndication [0..1]  # This is an indication of the current state of the FlexRay State Manager. / これは、FlexRay State Managerの現在の状態を示している。
              symbolic name reference BswMFrSMChannelRef: set at link in variant link-time+post-build / pre-compile in variant pre-compile, destination=ComMChannel  # This is a reference to the FlexRay Cluster handle that the mode request corresponds to. / これは、モード要求が対応するFlexRayクラスタハンドルへの参照である。
            container BswMGenericRequest [0..1]  # This mode request originates from a requester that is not among the list of standardized mode requesters (i.e. the different resource managers). / このモード要求は、標準化されたモードリクエスタ（すなわち、異なるリソースマネージャ）のリストの中にないリクエスタから生じる。
              integer BswMModeRequesterId: 0..65535, set at link in variant link-time+post-build / pre-compile in variant pre-compile  # This parameters identifies the different users of the generic mode request interface. / このパラメータは、汎用モード要求インターフェースの異なるユーザを識別する。 | The allowable range of this parameter shall coincide with the range of BswM_UserType (which can be platform-dependent).
              integer BswMRequestedModeMax: 0..65535, set at link in variant link-time+post-build / pre-compile in variant pre-compile  # This parameter defines the upper limit for the modes requested by this mode requester. / このパラメータは、このモードでは、要求者から要求されたモードの上限を定義する。 | The allowable range of this parameter shall coincide with the range of BswM_ModeType (which can be platform-dependent).
            container BswMJ1939DcmBroadcastStatus [0..1]  # This is a notification of the desired broadcast status per network, triggered via DM13. / これは、DM13を介して起動ネットワークごとに所望の通信状態の通知である。
              symbolic name reference BswMJ1939DcmChannelRef: set at link in variant link-time+post-build / pre-compile in variant pre-compile, destination=ComMChannel  # Reference to the channel represented by the nth bit in the networkMask parameter to J1939DcmBroadcastStatus. / J1939 DcmBroadcastStatusへのネットワークマスクパラメータのn番目のビットによって表されるチャネルへの参照。
            container BswMJ1939NmIndication [0..1]  # This is an indication of the current state of the J1939 network management module. / これは、J1939ネットワーク管理モジュールの現在の状態の指標である。
              symbolic name reference BswMJ1939NmChannelRef: set at link in variant link-time+post-build / pre-compile in variant pre-compile, destination=ComMChannel  # This is a reference to the J1939Nm channel handle that the mode request corresponds to. / これは、モード要求が対応することJ1939Nmチャネルハンドルへの参照である。
              symbolic name reference BswMJ1939NmNodeRef: set at link in variant link-time+post-build / pre-compile in variant pre-compile, destination=J1939NmNode  # This is a reference to the node that the mode request corresponds to. / これは、モード要求が対応するノードへの参照である。
            container BswMLinSMIndication [0..1]  # This is an indication of the current state of the LIN State Manager. / これは、LIN State Managerの現在の状態を示す。
              symbolic name reference BswMLinSMChannelRef: set at link in variant link-time+post-build / pre-compile in variant pre-compile, destination=ComMChannel  # This is a reference to the LIN channel handle that the mode request corresponds to. / これは、モード要求が対応するLINチャネルハンドルへの参照である。
            container BswMLinScheduleIndication [0..1]  # This is an indication of the currently active LIN Schedule Table for a specific LIN Interface. / これは、特定のLINインターフェースの現在アクティブなLINスケジュールテーブルの表示である。
              symbolic name reference BswMLinSMChannelRef: post-build-variant-value=true, set at link in variant link-time / post-build in variant post-build / pre-compile in variant pre-compile, destination=ComMChannel  # This is a reference to the LIN channel handle that the mode request corresponds to. / これは、モード要求が対応するLINチャネルハンドルへの参照である。
              symbolic name reference BswMLinScheduleRef: post-build-variant-value=true, set at link in variant link-time / post-build in variant post-build / pre-compile in variant pre-compile, destination=LinSMSchedule  # This is a reference to the LIN Schedule Table handle that the mode request corresponds to. / これは、モード要求が対応するLINスケジュールテーブルハンドルへの参照である。
            container BswMLinTpModeRequest [0..1]  # This is a LinTp mode request from the LinIf. This port corresponds to a call of the BswM_LinTp_RequestMode API. / これはLinIfからLinTpモード要求である。このポートはBswM_LinTp_RequestModeのAPIの呼び出しに対応している。
              symbolic name reference BswMLinTpChannelRef: set at link in variant link-time+post-build / pre-compile in variant pre-compile, destination=ComMChannel  # This is a reference to the LIN Interface Channel that the mode / これはモード要求が対応するLINインターフェースチャネルへの参照である。 | request corresponds to.
            container BswMModeSwitchErrorEvent [0..1]  # This is a notification that an error occurred because the partition containing the mode users of the Mode Declaration Group Prototype was restarted by the RTE. Because the Mode Machine Instance holding the current mode can reside on that terminated partition, the Mode Manager has to be informed about / これは、モード宣言グループプロトタイプのモードユーザーを含むパーティションは、RTEによって再起動されたため、エラーが発生した通知である。モードマシンインスタンスは、その終了パーティション上に置くことができ、現在のモードを保持しているので、モードマネージャは、このパーティションの損失について通知しなければならない。 | the loss of this partition.
              reference BswMRteSwitchPortRef: post-build-variant-value=true, set at link in variant link-time / post-build in variant post-build / pre-compile in variant pre-compile, destination=BswMSwitchPort  # This is a reference to the BswMSwitchPort. / これはBswMSwitchPortへの参照である。
            container BswMNmIfCarWakeUpIndication [0..1]  # This is an indication of a CarWakeup from the NmIf. / これはNmIfからのCarWakeupの表示である。
              symbolic name reference BswMNmChannelRef: set at link in variant link-time+post-build / pre-compile in variant pre-compile, destination=ComMChannel  # This is a reference to the channel handle that the indication corresponds to. / これは、表示が対応するチャネルハンドルへの参照である。
            container BswMNvMJobModeIndication [0..1]  # Indicates the current status of the multiblock job. The job is identified via BswMNvmService, e.g. 0x0c for NvmReadAll, 0x0d for NvmWriteAll. Possible Values are: / マルチブロックジョブの現在の状態を示す。 ジョブはBswMNvmServiceによって識別される。 NvmReadAllの場合は0x0c、NvmWriteAllの場合は0x0d。 可能な値は次のとおりである。 | NvM_RequestResultType NVM_REQ_OK NVM_REQ_NOT_OK NVM_REQ_PENDING NVM_REQ_INTEGRITY_FAILED NVM_REQ_BLOCK_SKIPPED NVM_REQ_NV_INVALIDATED NVM_REQ_CANCELED NVM_REQ_REDUNDANCY_FAILED NVM_REQ_RESTORED_FROM_ROM
              enumeration BswMNvmService: {NvmReadAll, NvmWriteAll}, set at link in variant link-time+post-build / pre-compile in variant pre-compile  # Identifies the Nvm job which is related to the mode request. / モード要求に関連するNvmジョブを識別する。
            container BswMNvMRequest [0..1]  # Via this Mode Request Source the NvM indicates the current status of the specified block. Possible Values are: / このMode Request Sourceを介して、NvMは指定されたブロックの現在の状態を示す。 | NvM_RequestResultType NVM_REQ_OK NVM_REQ_NOT_OK NVM_REQ_PENDING NVM_REQ_INTEGRITY_FAILED NVM_REQ_BLOCK_SKIPPED NVM_REQ_NV_INVALIDATED NVM_REQ_CANCELED NVM_REQ_REDUNDANCY_FAILED NVM_REQ_RESTORED_FROM_ROM
              symbolic name reference BswMNvMBlockRef: set at link in variant link-time+post-build / pre-compile in variant pre-compile, destination=NvMBlockDescriptor  # This is a reference to the NvM Block Descriptor that the request corresponds to. / これは、要求が対応するNvMブロック記述子への参照である。
            container BswMPartitionRestarted [0..1]  # This is a notification that an error occured because the partition containing the BswM was restarted by the RTE. The Mode Users may lie in another (still running) partition. So the BswM has to be informed that the start of its partition is no normal startup but a restart of a single partition. This information can be used inside the Rules. This ModeIndication has to be used by the Restart Task of the particular partition. / これは、BDSMを含むパーティションがRTEによって再起動されたためにエラーが発生したという通知である。 モードユーザーは別の（まだ実行中の）パーティションに存在する可能性がある。 したがって、BswMには、パーティションの開始が通常の起動ではなく、単一のパーティションの再起動であることが通知されなければならない。 この情報は、ルール内で使用できる。 このModeIndicationは、特定のパーティションのRestart Taskで使用する必要がある。
            container BswMSdClientServiceCurrentState [0..1]  # Used by Service Discovery module to indicate current state of the Client Service (available/down). / Service Discoveryモジュールがクライアントサービスの現在の状態（使用可能/使用不可）を示すために使用する。
              symbolic name reference BswMSdClientMethodsRef: set at link in variant link-time+post-build / pre-compile in variant pre-compile, destination=SdClientService  # This is a reference to a client service in the Sd module. / これは、Sdモジュールのクライアントサービスへの参照である。
            container BswMSdConsumedEventGroupCurrentState [0..1]  # Used by Service Discovery to indicate current status of the EventHandler (requested/released). / EventHandler（要求/解放）の現在のステータスを示すためにService Discoveryによって使用される。
              symbolic name reference BswMSdConsumedEventGroupRef: set at link in variant link-time+post-build / pre-compile in variant pre-compile, destination=SdConsumedEventGroup  # This is a reference to an eventGroup that is defined within a client service in the Sd module. / これは、Sdモジュール内のクライアントサービス内で定義されたeventGroupへの参照である。
            container BswMSdEventHandlerCurrentState [0..1]  # Used by Service Discovery to indicate current status of the EventHandler (requested/released). / EventHandlerの現在のステータス（要求/解放）を示すためにService Discoveryによって使用される。
              symbolic name reference BswMSdEventHandlerRef: set at link in variant link-time+post-build / pre-compile in variant pre-compile, destination=SdEventHandler  # This is a reference to an event handler that is defined within a server service in the Sd module. / これは、Sdモジュールのサーバーサービス内で定義されるイベントハンドラへの参照である。
            container BswMSwcModeNotification [0..1]  # This is a mode switch notification associated with a RTE switch interface. / これは、RTEスイッチインターフェイスに関連付けられたモード切り替え通知である。
              foreign reference BswMSwcModeNotificationModeDeclarationGroupPrototypeRef: set at link in variant link-time+post-build / pre-compile in variant pre-compile, destination-type=MODE-DECLARATION-GROUP-PROTOTYPE  # This is a foreign reference to the ModeDeclarationGroupPrototype. / これは、ModeDeclarationGroupPrototypeへの外部参照である。
            container BswMSwcModeRequest [0..1]  # The source of the mode request is a SW Component. / モード要求のソースはSWコンポーネントである。
              foreign reference BswMSwcModeRequestVariableDataPrototypeRef: post-build-variant-value=true, set at link in variant link-time / post-build in variant post-build / pre-compile in variant pre-compile, destination-type=VARIABLE-DATA-PROTOTYPE  # This is a reference to the VariableDataPrototype. / これはVariableDataPrototypeへの参照である。
            container BswMWdgMRequestPartitionReset [0..1]  # This is a Partition Reset request from from the WdgM. This port / これは、WdgMからのパーティションリセット要求である。 | corresponds to a call of the BswM_WdgM_RequestPartitionReset API.
              reference BswMWdgMRequestPartitionResetRef: set at link in variant link-time+post-build / pre-compile in variant pre-compile, destination=EcucPartition  # This is a reference to the partition that shall be reset. / これは、リセットされるパーティションへの参照である。
        container BswMRule [1..*]: multiplicity set at link in variant link-time / post-build in variant post-build / pre-compile in variant pre-compile, post-build-variant-multiplicity=true  # Each instance of this container describes a BswM arbitration rule. The rule either consists of a simple mode condition or a more complex logical expression. This container also references the action lists that shall be invoked when the rule is evaluated to True or False. / このコンテナの各インスタンスはBswMアービトレーションルールを記述する。 ルールは単純モード条件かより複雑な論理式のいずれかで構成される。 このコンテナは、ルールがTrueまたはFalseに評価されたときに呼び出されるアクションリストも参照する。
          boolean BswMNestedExecutionOnly: set at link in variant link-time+post-build / pre-compile in variant pre-compile, default-value=false  # This parameter defines for its related Rule if the Rule is an Independent rule or a Subordinate rule; / このパラメータは、ルールが独立ルールまたは従属ルールである場合に、関連ルールを定義する。 | false: an Independent rule, i.e. to be evaluated each time applicable (both as standalone Rule driven by its own BswMModeRequestSource and when referenced by another Rule). true: a Subordinated rule, to be evaluated ONLY as a result of being referenced in one or more Action Lists.
          enumeration BswMRuleInitState: {BSWM_FALSE, BSWM_TRUE, BSWM_UNDEFINED}, set at link in variant link-time+post-build / pre-compile in variant pre-compile, default-value=BSWM_FALSE  # This parameter is a part of the reset/initialization behavior of BswM. / このパラメータは、BswMのリセット/初期化動作の一部である。 | Action lists are executed when the result of a rule evaluation have changed since the last evaluation. This parameter defines the "previous evaluation result" of a rule to be used after initialization of the BswM. If this parameter is set to BSWM_UNDEFINED, the evaluation result is always treated as changed at the first evaluation of the rule after initialization. If this parameter is set to BSWM_TRUE, the evaluation result is treated as changed if the rule is evaluated to false. If this parameter is set to BSWM_FALSE, the evaluation result is treated as changed if the rule is evaluated to true.
          reference BswMRuleExpressionRef: set at link in variant link-time+post-build / pre-compile in variant pre-compile, destination=BswMLogicalExpression  # This is a reference to the logical expression that is evaluated for each rule. / この選択基準は、各ルールに対して評価されるモード条件または論理式を参照する。
          reference BswMRuleFalseActionList [0..1]: multiplicity set at link in variant link-time / post-build in variant post-build / pre-compile in variant pre-compile, post-build-variant-multiplicity=true, post-build-variant-value=true, set at link in variant link-time / post-build in variant post-build / pre-compile in variant pre-compile, destination=BswMActionList  # This is a reference to the action list that shall be executed when the rule is evaluated to False / これは、ルールがFalseに評価されたときに実行されるアクションリストへの参照である。
          reference BswMRuleTrueActionList [0..1]: multiplicity set at link in variant link-time / post-build in variant post-build / pre-compile in variant pre-compile, post-build-variant-multiplicity=true, post-build-variant-value=true, set at link in variant link-time / post-build in variant post-build / pre-compile in variant pre-compile, destination=BswMActionList  # This is a reference to the action list that shall be executed when the rule is evaluated to True / これは、ルールがTrueに評価されたときに実行されるアクションリストへの参照である。
      container BswMDataTypeMappingSets [0..1]  # Collection of references to DataTypeMappingSet. / DataTypeMappingSetへの参照のコレクション。
        foreign reference BswMDataTypeMappingSetRef [1..*]: multiplicity set at link in variant link-time+post-build / pre-compile in variant pre-compile, set at link in variant link-time+post-build / pre-compile in variant pre-compile, destination-type=DATA-TYPE-MAPPING-SET  # Reference to DataTypeMappingSet. / DataTypeMappingSetへの参照。
      container BswMModeControl  # This container includes all configuration sub-containers and parameters related to the mode control functionality of the BswM. / このコンテナには、BswMのモード制御機能に関連するすべての構成サブコンテナおよびパラメータが含まれる。
        container BswMAction [1..*]: multiplicity set at pre-compile  # Each container of this type defines an action. These actions can be part of one or several action lists. / このタイプの各コンテナはアクションを定義する。 これらのアクションは、1つまたは複数のアクションリストに含めることができる。
          choice container BswMAvailableActions  # Choice container including the available actions to be used in the action lists. / アクションリストで使用可能なアクションを含む選択コンテ​​ナ。
            container BswMComMAllowCom [0..1]  # This container includes all parameters for the action to allow or to block communication for a ComM Channel. ComM_CommunicationAllowed is called when this action is configured. / このコンテナには、ComMチャネルの通信を許可または拒否するアクションのすべてのパラメータが含まれている。 ComM_CommunicationAllowedは、このアクションが構成されているときに呼び出される。
              boolean BswMComAllowed: set at link in variant link-time+post-build / pre-compile in variant pre-compile  # The parameter BswMComMAllowChannelRef refers to a channel which will allow or block communication using the function ComM_CommunicationAllowed(). / パラメータBswMComMAllowChannelRefは、ComM_CommunicationAllowed（）関数を使用して通信を許可またはブロックするチャネルを参照する。 | This parameter corresponds to the parameter "Allowed" of the function ComM_CommunicationAllowed().
              symbolic name reference BswMComMAllowChannelRef: set at link in variant link-time+post-build / pre-compile in variant pre-compile, destination=ComMChannel  # This is a reference to the ComM Channel for which communication shall be allowed or blocked. / これは、通信が許可またはブロックされるComMチャネルへの参照である。 | This reference corresponds to the parameter "Channel" of the function ComM_CommunicationAllowed().
            container BswMComMModeLimitation [0..0]  # This container includes all parameters related to a limitation of communication mode for a ComM Channel. ComM_LimitChannelToNoComMode is called when this action is configured. / このコンテナには、ComMチャネルの通信モードの制限に関連するすべてのパラメータが含まれる。ComM_LimitChannelToNoComModeは、このアクションが構成されているときに呼び出される。
              boolean BswMComMLimitMode: set at link in variant link-time+post-build / pre-compile in variant pre-compile  # The function ComM_LimitChannelToNoComMode() takes in this boolean parameter to limit the channel's com mode to no-com mode. / ComM_LimitChannelToNoComMode（）関数は、チャネルのcomモードをno-comモードに制限するために、このbooleanパラメータを取る。 | This parameter corresponds to the parameter "Status" of the function ComM_LimitChannelToNoComMode.
              symbolic name reference BswMComMLimitChannelRef: set at link in variant link-time+post-build / pre-compile in variant pre-compile, destination=ComMChannel  # This is a reference to the ComM channel for which the communication mode should be limited. / これは通信モードが制限されるComMチャネルへの参照である。 | This reference corresponds to the parameter "Channel" of the function ComM_LimitChannelToNoComMode.
            container BswMComMModeSwitch [0..1]  # This container includes all parameters related to a switch of communication mode for a ComM User. ComM_RequestComMode is called when this action is configured. / このコンテナには、ComMユーザの通信モードの切り替えに関連するすべてのパラメータが含まれる。 ComM_RequestComModeは、このアクションが構成されているときに呼び出される。
              enumeration BswMComMRequestedMode: {BSWM_FULL_COM, BSWM_NO_COM}, set at link in variant link-time+post-build / pre-compile in variant pre-compile  # This parameter specifies if the requested communication mode. / このパラメータは、要求された通信モードかどうかを指定する。 | This parameter corresponds to the parameter "ComMode" of the function ComM_RequestComMode.
              symbolic name reference BswMComMUserRef: set at link in variant link-time+post-build / pre-compile in variant pre-compile, destination=ComMUser  # This is a reference to the ComM User that is associated to the Communication channel for which the communication mode should be requested. / これは、通信モードが要求される通信チャネルに関連付けられているComMユーザへの参照である。 | This reference corresponds to the parameter "User" of the function ComM_RequestComMode.
            container BswMCoreHaltMode [0..1]  # This container includes all parameters related to a switch of the activation state of core Halt. / このコンテナには、コア停止の起動状態の切り替えに関連するすべてのパラメータが含まれる。
              string BswMCoreHaltActivationState: set at pre-compile  # Different possibilities are offered depending on the OS implementation and the CPU HW. The HALT modes addressed by this parameter are defined as names (strings) in the OS implementation. Different implementation may implement different HALT modes and subsequently different names. / OSの実装とCPU HWによって異なる可能性がある。このパラメータで扱われるHALTモードは、OSの実装における名前（文字列）として定義される。異なる実装は、異なるHALTモードを実装し、その後異なる名前を実装することがある。
              symbolic name reference BswMTargetCoreRef: set at link in variant link-time+post-build / pre-compile in variant pre-compile, destination=EcucCoreDefinition  # This is a reference to the core on which the Core Halt process must be influenced. / これは、Core Haltプロセスに影響を与えなければならないコアへの参照である。
            container BswMDeadlineMonitoringControl [0..1]  # This container includes all parameters related to enabling and disabling of deadline monitoring for one or several PDUs in COM. / このコンテナには、COM内の1つまたは複数のPDUのデッドライン監視を有効または無効にするためのすべてのパラメータが含まれている。 | COM_ReceptionDMControl is called when this action is configured.
              symbolic name reference BswMDisabledDMPduGroupRef [0..*]: multiplicity set at link in variant link-time / post-build in variant post-build / pre-compile in variant pre-compile, post-build-variant-multiplicity=true, post-build-variant-value=true, set at link in variant link-time / post-build in variant post-build / pre-compile in variant pre-compile, destination=ComIPduGroup  # This is a reference to a PDU Group for which the Deadline Monitoring should be disabled. / これは、デッドラインモニタリングを無効にする必要があるPDUグループへの参照である。 | Together with the BswMEnabledDMPduGroupRef this reference corresponds to the parameter "ipduGroupVector" of the function COM_ReceptionDMControl.
              symbolic name reference BswMEnabledDMPduGroupRef [0..*]: multiplicity set at link in variant link-time / post-build in variant post-build / pre-compile in variant pre-compile, post-build-variant-multiplicity=true, post-build-variant-value=true, set at link in variant link-time / post-build in variant post-build / pre-compile in variant pre-compile, destination=ComIPduGroup  # This is a reference to a PDU Group for which the Deadline Monitoring should be enabled. / これは、デッドラインモニタリングを有効にする必要があるPDUグループへの参照である。 | Together with the BswMDisabledDMPduGroupRef this reference corresponds to the parameter "ipduGroupVector" of the function COM_ReceptionDMControl.
            container BswMEcuMGoDown [0..1]  # This container defines the UserId which shall be forwarded to the GoDown request. / このコンテナは、GoDown要求に転送されるUserIdを定義する。
              symbolic name reference BswMEcuMUserIdRef: set at link in variant link-time+post-build / pre-compile in variant pre-compile, destination=EcuMFlexUserConfig  # This is a reference to a EcuM UserId. / これは、EcuM UserIdへの参照である。
            container BswMEcuMGoHalt [0..1]  # This container defines the action to trigger the EcuM_GoHalt from BswM.
            container BswMEcuMGoPoll [0..1]  # This container defines the action to trigger the EcuM_GoPoll from BswM.
            container BswMEcuMSelectShutdownTarget [0..1]  # This container defines the shutdown target. / このコンテナはシャットダウンターゲットを定義する。
              enumeration BswMEcuMShutdownTarget: {ECUM_STATE_OFF, ECUM_STATE_RESET, ECUM_STATE_SLEEP}, set at link in variant link-time+post-build / pre-compile in variant pre-compile  # This parameter contains the shutdown target that the BswM selects at the EcuM. / このパラメータには、BswMがEcuMで選択するシャットダウンターゲットが含まれる。
              symbolic name reference BswMEcuMResetModeRef [0..1]: multiplicity set at link in variant link-time+post-build / pre-compile in variant pre-compile, set at link in variant link-time+post-build / pre-compile in variant pre-compile, destination=EcuMResetMode  # This is a reference to a reset mode. / これはリセットモードへの参照である。
              symbolic name reference BswMEcuMSleepModeRef [0..1]: multiplicity set at link in variant link-time+post-build / pre-compile in variant pre-compile, set at link in variant link-time+post-build / pre-compile in variant pre-compile, destination=EcuMSleepMode  # This is a reference to a sleep mode. / これはスリープモードへの参照である。
            container BswMEcuMStateSwitch [0..1]  # This container defines the action to switch a State of the ECU State Manager. / このコンテナは、ECU状態マネージャの状態を切り替えるアクションを定義する。
              enumeration BswMEcuMState: {POST_RUN, RUN, SHUTDOWN, SLEEP, STARTUP}, set at link in variant link-time+post-build / pre-compile in variant pre-compile  # This parameter corresponds to the parameter "State" of the function EcuM_ SetState (). / このパラメータは、関数EcuM_SetState（）のパラメータ "State"に対応する。
            container BswMFrSMAllSlots [0..0]  # This container includes all parameter(s) for the action to request an exit from Flexray KeySlotOnlyMode. FrSM_AllSlots is called when this action is executed. / このコンテナには、Flexray KeySlotOnlyModeの終了を要求するアクションのすべてのパラメータが含まれる。このアクションが実行されると、FrSM_AllSlotsが呼び出される。
              symbolic name reference BswMFrSMAllSlotsNetworkHandleRef: set at link in variant link-time+post-build / pre-compile in variant pre-compile, destination=ComMChannel  # This references the FlexRay cluster. The reference corresponds to the parameter "NetworkHandle" of the function FrSM_AllSlots. / これはFlexRayクラスタを参照する。 この参照は、関数FrSM_AllSlotsのパラメータ "NetworkHandle"に対応する。
            container BswMJ1939DcmStateSwitch [0..0]  # This container includes all parameters related to a switch of the J1939 Diagnostic Communication Managers network state for a J1939 node. J1939Dcm_SetState is called when this action is configured. / このコンテナには、J1939ノードのJ1939診断通信マネージャネットワーク状態の切り替えに関連するすべてのパラメータが含まれる。 このアクションが設定されると、J1939Dcm_SetStateが呼び出される。
              enumeration BswMJ1939DcmRequestedState: {J1939DCM_STATE_OFFLINE, J1939DCM_STATE_ONLINE}, set at link in variant link-time+post-build / pre-compile in variant pre-compile  # This parameter describes the communication state of the J1939 Diagnostic Communication Manager and corresponds to the parameter "newState" of the function J1939Dcm_SetState. / このパラメータは、J1939 Diagnostic Communication Managerの通信状態を記述し、J1939Dcm_SetState関数のパラメータ "newState"に対応する。
              symbolic name reference BswMJ1939DcmChannelRef: set at link in variant link-time+post-build / pre-compile in variant pre-compile, destination=ComMChannel  # This reference points to the unique channel defined by the ComMChannel and provides access to the unique channel index value in ComMChannelId. / この参照は、ComMChannelによって定義された一意のチャネルを指し示し、ComMChannelId内の一意のチャネルインデックス値へのアクセスを提供する。 この参照は、関数J1939Dcm_SetStateのパラメータ "channel"に対応している。 | This reference corresponds to the parameter "channel" of the function J1939Dcm_SetState.
              symbolic name reference BswMJ1939DcmNodeRef: set at link in variant link-time+post-build / pre-compile in variant pre-compile, destination=J1939NmNode  # This reference points to a J1939NmNode and provides access to the unique J1939NmNodeId.This reference corresponds to the parameter "node" of the function J1939Dcm_SetState. / この参照はJ1939NmNodeを指し、固有のJ1939NmNodeIdへのアクセスを提供する。この参照は、関数J1939Dcm_SetStateのパラメータ "node"に対応する。
            container BswMJ1939RmStateSwitch [0..0]  # This container includes all parameters related to a switch of the J1939 Request Managers network state for a J1939 node. J1939Rm_SetState is called when this action is configured. / このコンテナには、J1939ノードのJ1939要求マネージャネットワーク状態の切り替えに関連するすべてのパラメータが含まれる。このアクションが設定されると、J1939Rm_SetStateが呼び出される。
              enumeration BswMJ1939RmRequestedState: {J1939RM_STATE_OFFLINE, J1939RM_STATE_ONLINE}, set at link in variant link-time+post-build / pre-compile in variant pre-compile  # This parameter describes the communication state of the J1939 Request Manager and corresponds to the parameter "new state" of the function J1939Rm_SetState. / このパラメータは、J1939要求マネージャの通信状態を記述し、J1939Rm_SetState関数のパラメータ "new state"に対応する。
              symbolic name reference BswMJ1939RmChannelRef: set at link in variant link-time+post-build / pre-compile in variant pre-compile, destination=ComMChannel  # This reference points to the unique channel defined by the ComMChannel and provides access to the unique channel index value in ComMChannelId. / この参照は、ComMChannelによって定義された一意のチャネルを指し示し、ComMChannelId内の一意のチャネルインデックス値へのアクセスを提供する。 | This reference corresponds to the parameter "channel" of the function J1939Rm_SetState.
              symbolic name reference BswMJ1939RmNodeRef: set at link in variant link-time+post-build / pre-compile in variant pre-compile, destination=J1939NmNode  # This reference points to a J1939NmNode and provides access to the unique J1939NmNodeId. / この参照はJ1939NmNodeを指し、固有のJ1939NmNodeIdへのアクセスを提供する。 | This reference corresponds to the parameter "node" of the function J1939Rm_SetState.
            container BswMLinScheduleSwitch [0..1]  # This container includes all parameters related to a switch of LIN schedule table. LinSM_ScheduleRequest is called when this action is configured. / このコンテナには、LINスケジュールテーブルのスイッチに関連するすべてのパラメータが含まれている。このアクションが設定されると、LinSM_ScheduleRequestが呼び出される。 | The configuration for the "network" parameter can be accessed via the reference LinSMComMNetworkHandleRef contained in the parent container LinSMChannel of the container referenced by BswMLinScheduleRef.
              symbolic name reference BswMLinScheduleRef: post-build-variant-value=true, set at link in variant link-time / post-build in variant post-build / pre-compile in variant pre-compile, destination=LinSMSchedule  # This is a reference to the LIN schedule table that the LIN SM shall change to. / これは、LIN SMが変更するLINスケジュールテーブルへの参照である。 | This reference corresponds to the parameter "schedule" of the function LinSM_ScheduleRequest.
            container BswMNMControl [0..0]  # This container includes all parameters related to enabling and disabling of Network Management communication. Disabling of NM communication can be requested by DCM. / このコンテナには、ネットワーク管理通信の有効化と無効化に関するすべてのパラメータが含まれている。NM通信の無効化は、DCMによって要求できる。 | Nm_EnableCommunication or Nm_DisableCommunication is called when this action is configured.
              enumeration BswMNMAction: {BSWM_NM_DISABLE, BSWM_NM_ENABLE}, set at link in variant link-time+post-build / pre-compile in variant pre-compile  # This parameter specifies if the communication of the corresponding NM channel should be enabled or disabled. / このパラメータは、対応するNMチャネルの通信を有効にするか無効にするかを指定する。
              symbolic name reference BswMComMNetworkHandleRef: set at link in variant link-time+post-build / pre-compile in variant pre-compile, destination=ComMChannel  # This reference points to the unique channel defined by the ComMChannel and provides access to the unique channel index value in ComMChannelId. / この参照は、ComMChannelによって定義された一意のチャネルを指し示し、ComMChannelId内の一意のチャネルインデックス値へのアクセスを提供する。 | This reference corresponds to the parameter "NetworkHandle" of the function Nm_EnableCommunication and Nm_DisableCommunication.
            container BswMPduGroupSwitch [0..1]  # This container includes references to the PDU groups that shall be enabled and disabled. Com_IpduGroupControl is called when this action is configured. / このコンテナには、有効または無効にするPDUグループへの参照が含まれる。 Com_IpduGroupControlは、このアクションが構成されているときに呼び出される。
              boolean BswMPduGroupSwitchReinit: multiplicity set at link in variant link-time / post-build in variant post-build / pre-compile in variant pre-compile, post-build-variant-multiplicity=true, post-build-variant-value=true, set at link in variant link-time / post-build in variant post-build / pre-compile in variant pre-compile, default-value=false  # This parameter defines if the data of the I-PDU, the shadow buffers of included signal groups, etc. are reinitialized during a PDU Group Switch. / このパラメータは、定期的タイマー、最小遅延タイマーなどのパラメータの値がPDUグループスイッチ中に保持されているか再初期化されているかどうかを定義する。 | This parameter corresponds to the parameter "initialize" of the function Com_IpduGroupControl.
              symbolic name reference BswMDisabledPduGroupRef [0..*]: multiplicity set at link in variant link-time / post-build in variant post-build / pre-compile in variant pre-compile, post-build-variant-multiplicity=true, post-build-variant-value=true, set at link in variant link-time / post-build in variant post-build / pre-compile in variant pre-compile, destination=ComIPduGroup  # This is a reference to a PDU Group that should be disabled. / これは無効にする必要のあるPDUグループへの参照である。 | Together with the BswMEnabledIPduGroupRef this reference corresponds to the parameter "ipduGroupVector" of the function Com_IpduGroupControl.
              symbolic name reference BswMEnabledPduGroupRef [0..*]: multiplicity set at link in variant link-time / post-build in variant post-build / pre-compile in variant pre-compile, post-build-variant-multiplicity=true, post-build-variant-value=true, set at link in variant link-time / post-build in variant post-build / pre-compile in variant pre-compile, destination=ComIPduGroup  # This is a reference to a PDU Group that should be enabled. / これは、有効にする必要のあるPDUグループへの参照である。 | Together with the BswMDisabledIPduGroupRef this reference corresponds to the parameter "ipduGroupVector" of the function Com_IpduGroupControl.
            container BswMPduRouterControl [0..0]  # This container includes all parameters related to enabling and disabling of routing of Routing Path Groups in the PDU Router. PduR_EnableRouting or PduR_DisableRouting is called when this action is configured. / このコンテナには、PDUルータのルーティングパスグループのルーティングを有効または無効にするためのすべてのパラメータが含まれている。 このアクションが設定されると、PduR_EnableRoutingまたはPduR_DisableRoutingが呼び出される。
              enumeration BswMPduRouterAction: {BSWM_PDUR_DISABLE, BSWM_PDUR_ENABLE}, post-build-variant-value=true, set at link in variant link-time / post-build in variant post-build / pre-compile in variant pre-compile  # This parameter specifies if the routing of the corresponding PDU should be enabled or disabled. / このパラメータは、対応するPDUのルーティングを有効にするか無効にするかを指定する。
              boolean BswMPduRouterDisableInitBuffer [0..1]: multiplicity set at link in variant link-time / post-build in variant post-build / pre-compile in variant pre-compile, post-build-variant-multiplicity=true, post-build-variant-value=true, set at link in variant link-time / post-build in variant post-build / pre-compile in variant pre-compile  # When BswPduRouterAction is set to BSWM_PDUR_DISABLE and this parameter is set to true, then the call to PduR_DisableRouting will be invoked with parameter "initialize" set to true, otherwise false. / このパラメータは、この呼び出し中に選択される送信モードを定義する。
              symbolic name reference BswMPduRoutingPathGroupRef [1..*]: multiplicity set at link in variant link-time / post-build in variant post-build / pre-compile in variant pre-compile, post-build-variant-multiplicity=true, post-build-variant-value=true, set at link in variant link-time / post-build in variant post-build / pre-compile in variant pre-compile, destination=PduRRoutingPathGroup  # This is a reference to the PDU Routing Path Group for which the routing in the PDU Router should be enabled or disabled. / これは、PDUルーテイングパスグループへの参照で、PDUルータのルーティングを有効または無効にする必要がある。 | This reference corresponds to the parameter "id" of the function PduR_EnableRouting and PduR_DisableRouting.
            container BswMRequestRemoteMode [0..0]  # This container defines all information that are needed when a BswM wants to request a mode at another BswM which runs inside another partition. Tags: atp.Status=obsolete, atp.StatusRevisionBegin=4.2.2 / このコンテナは、BswMが別のパーティション内で実行される別のBswMでモードを要求したい場合に必要なすべての情報を定義する。
              foreign reference BswMModeDeclarationGroupPrototypeRef: set at link in variant link-time+post-build / pre-compile in variant pre-compile, destination-type=MODE-DECLARATION-GROUP-PROTOTYPE  # This is the reference to the ModeDeclarationGroup Prototype for that a mode shall be requested at another BswM. Tags: atp.Status=obsolete, atp.StatusRevisionBegin=4.2.2 / これはモードが別のBswMで要求されるというModeDeclarationGroupプロトタイプへの参照である。
              foreign reference BswMRequestedRemoteMode: set at link in variant link-time+post-build / pre-compile in variant pre-compile, destination-type=MODE-DECLARATION  # This parameter contains the integer value that corresponds to a certain mode in a Mode Declaration Group. Tags: atp.Status=obsolete, atp.StatusRevisionBegin=4.2.2 / このパラメータには、モード宣言グループの特定のモードに対応する整数値が含まれる。
              reference BswMEcuCPartitionRef: set at link in variant link-time+post-build / pre-compile in variant pre-compile, destination=EcucPartition  # This is a reference to the EcuCPartition the other BswM belongs to. Tags: atp.Status=obsolete, atp.StatusRevisionBegin=4.2.2 / これはBswMSwitchPortへの参照である。
            container BswMRteModeRequest [0..1]  # This container defines a mode request that the BswM may send to a SW-C which is acting as a mode-manager. RTE_Write is called when this action is configured. / このコンテナは、BswMがモードマネージャとして動作しているSW-Cに送信できるモード要求を定義する。 このアクションが設定されると、RTE_Writeが呼び出される。
              foreign reference BswMRequestedModeRef: set at link in variant link-time+post-build / pre-compile in variant pre-compile, destination-type=MODE-DECLARATION  # This is a foreign reference to the Mode Declaration used for the mode request / これは、モード要求に使用されるモード宣言への外部参照である。
              reference BswMRteModeRequestPortRef: set at link in variant link-time+post-build / pre-compile in variant pre-compile, destination=BswMRteModeRequestPort  # This is a reference to a BswMRteModeRequestPort. / これは、BswMRteModeRequestPortへの参照である。
            container BswMRteSwitch [0..1]  # This container defines a mode switch indication that the BswM provides to the SW-C that need to be notified about the mode switch. RTE_Switch is called when this action is configured. / このコンテナは、BswMがモードスイッチについて通知される必要があるSW-Cに提供するモードスイッチインジケーションを定義する。 このアクションが設定されると、RTE_Switchが呼び出される。
              foreign reference BswMSwitchedMode: set at link in variant link-time+post-build / pre-compile in variant pre-compile, destination-type=MODE-DECLARATION  # This parameter contains the integer value that corresponds to a certain mode in a Mode Declaration Group. / このパラメータには、モード宣言グループの特定のモードに対応する整数値が含まれる。
              reference BswMRteSwitchPortRef: set at link in variant link-time+post-build / pre-compile in variant pre-compile, destination=BswMSwitchPort  # This is a reference to the BswMSwitchPort. / これはBswMSwitchPortへの参照である。
            container BswMSchMSwitch [0..1]  # This container defines a mode switch indication that the BswM provides to the SW-C that need to be notified about the mode switch. SchM_Switch is called when this action is configured. / このコンテナは、BswMがモードスイッチについて通知される必要があるSW-Cに提供するモードスイッチインジケーションを定義する。 SchM_Switch is called when this action is configured. このアクションが設定されると、SchM_Switchが呼び出される。
              foreign reference BswMSchMModeDeclarationGroupRef [0..1]: set at link in variant link-time+post-build / pre-compile in variant pre-compile, destination-type=MODE-DECLARATION-GROUP  # This is the reference to a ModeDeclarationGroup to define a ModeDeclarationGroupPrototype in the role BswModuleDescription.providedModeGroup. / これは、BswModuleDescription.providedModeGroupロールでModeDeclarationGroupPrototypeを定義するためのModeDeclarationGroupへの参照である。
              foreign reference BswMSchMSwitchedMode: set at link in variant link-time+post-build / pre-compile in variant pre-compile, destination-type=MODE-DECLARATION  # This parameter contains the integer value that corresponds to a certain mode in a Mode Declaration Group. / このパラメータには、モード宣言グループ内の特定のモードに対応する整数値が含まれる。
            container BswMSdClientServiceModeRequest [0..0]  # This container includes all parameters related to the selection of an client service of Sd. Sd_ClientServiceSetState is called when this action is configured. / This container includes all parameters related to the selection of an client service of Sd. このコンテナには、Sdのクライアントサービスの選択に関連するすべてのパラメータが含まれる。
              enumeration BswMSdClientServiceState: {BSWM_SD_CLIENT_SERVICE_RELEASED, BSWM_SD_CLIENT_SERVICE_REQUESTED}, set at link in variant link-time+post-build / pre-compile in variant pre-compile  # This parameter specifies if the corresponding client service shall be released or requested. / このパラメータは、対応するクライアントサービスを解放または要求するかどうかを指定する。
              symbolic name reference BswMSdClientMethodsRef: set at link in variant link-time+post-build / pre-compile in variant pre-compile, destination=SdClientService  # This is a reference to a client service in the Sd module. / これは、Sdモジュールのクライアントサービスへの参照である。
            container BswMSdConsumedEventGroupModeRequest [0..0]  # This container includes all parameters related to the selection of a consumed EventGroup of Sd. Sd_ConsumedEventGroupSetState is called when this action is configured. / このコンテナには、Sdの消費されたEventGroupの選択に関連するすべてのパラメータが含まれる。
              enumeration BswMSdConsumedEventGroupState: {BSWM_SD_CONSUMED_EVENTGROUP_RELEASED, BSWM_SD_CONSUMED_EVENTGROUP_REQUESTED}, set at link in variant link-time+post-build / pre-compile in variant pre-compile  # This parameter specifies if the corresponding consumed event group shall be released or requested. / このパラメータは、対応する消費イベント・グループを解放または要求するかどうかを指定する。
              symbolic name reference BswMSdConsumedEventGroupRef: set at link in variant link-time+post-build / pre-compile in variant pre-compile, destination=SdConsumedEventGroup  # This is a reference to an eventGroup that is defined within a client service in the Sd module. / これは、Sdモジュール内のクライアントサービス内で定義されたeventGroupへの参照である。
            container BswMSdServerServiceModeRequest [0..0]  # This container includes all parameters related to the selection of a server service of Sd. Sd_ServerServiceSetState is called when this action is configured. / このコンテナには、Sdのサーバーサービスの選択に関連するすべてのパラメータが含まれる。
              enumeration BswMSdServerServiceState: {BSWM_SD_SERVER_SERVICE_AVAILABLE, BSWM_SD_SERVER_SERVICE_DOWN}, set at link in variant link-time+post-build / pre-compile in variant pre-compile  # This parameter specifies if the corresponding server service shall be down or available. / このパラメータは、対応するサーバーサービスを停止するか使用可能にするかを指定する。
              symbolic name reference BswMSdServerMethodsRef: set at link in variant link-time+post-build / pre-compile in variant pre-compile, destination=SdServerService  # This is a reference to a server service in the Sd module. / これは、Sdモジュール内のサーバーサービスへの参照である。
            container BswMSwitchIPduMode [0..0]  # This container includes all parameters related to the selection of the transmission mode an I-PDU to be sent by COM. Com_SwitchIpduTxMode is called when this action is configured. / このコンテナは、COMによって送信されるI-PDUの送信モードの選択に関連するすべてのパラメータを含む。Com_SwitchIpduTxModeは、このアクションが構成されているときに呼び出される。
              boolean BswMSwitchIPduModeValue: post-build-variant-value=true, set at link in variant link-time / post-build in variant post-build / pre-compile in variant pre-compile  # This parameter defines which transmission mode shall be selected during this call. / このパラメータは、この呼び出し中に選択される送信モードを定義する。 | This parameter corresponds to the parameter "Mode" of the function Com_SwitchIpduTxMode.
              symbolic name reference BswMSwitchIPduModeRef: post-build-variant-value=true, set at link in variant link-time / post-build in variant post-build / pre-compile in variant pre-compile, destination=ComIPdu  # This is a reference to an I-PDU for which the transmission mode shall be set. / これは、送信モードが設定されるI-PDUへの参照である。 | This reference corresponds to the parameter "PduId" of the function Com_SwitchIpduTxMode.
            container BswMTriggerIPduSend [0..0]  # This container includes all parameters related to the triggering of an I-PDU to be sent by COM. Com_TriggerIPDUSend is called when this action is configured. / このコンテナは、COMによって送信されるI-PDUのトリガに関連するすべてのパラメータを含む。Com_TriggerIPDUSendは、このアクションが構成されているときに呼び出される。
              symbolic name reference BswMTriggeredIPduRef [1..*]: multiplicity set at link in variant link-time / post-build in variant post-build / pre-compile in variant pre-compile, post-build-variant-multiplicity=true, post-build-variant-value=true, set at link in variant link-time / post-build in variant post-build / pre-compile in variant pre-compile, destination=ComIPdu  # This is a reference to an I-PDU that should be triggered for transmission. / これは、送信のためにトリガすべきI-PDUへの参照である。 | This reference corresponds to the parameter "PduId" of the function Com_TriggerIPDUSend.
            container BswMTriggerSlaveRTEStop [0..0]  # This container is deprecated and will be removed in future. Tags: atp.Status=obsolete / このコンテナには、スレーブコアでRTEを停止するために必要なすべてのパラメータが含まれる。この選択は、マルチコアを使用する場合にのみ選択される。 | Old description: This container includes all parameters needed to stop the RTE on a slave core. This choice shall only be chosen if multicore is used. This element is obsolete and will be removed in a future revision.
              symbolic name reference BswMCoreRef [0..1]: multiplicity set at link in variant link-time+post-build / pre-compile in variant pre-compile, set at link in variant link-time+post-build / pre-compile in variant pre-compile, destination=EcucCoreDefinition  # This reference points to the identifier of the slave core that is used as input parameter for the BswM_TriggerStartUpPhase2 and BswM_TriggerSlaveRTEStop functions. The value of this parameter shall be synchronized with the OsApplicationCoreAssignment parameter. Tags: atp.Status=obsolete / この参照は、BswM_TriggerStartUpPhase2およびBswM_TriggerSlaveRTEStop関数の入力パラメータとして使用されるスレーブコアの識別子を示す。このパラメータの値は、OsApplicationCoreAssignmentパラメータと同期させるものとする。
            container BswMTriggerStartUpPhase2 [0..0]  # This container is deprecated and will be removed in future. Tags: atp.Status=obsolete / このコンテナには、スレーブコアでフェーズ2を開始するために必要なすべてのパラメータが含まれている。この選択は、マルチコアを使用する場合にのみ選択される。 | Old description: This container includes all parameters needed to start phase two on a slave core. This choice shall only be chosen if multicore is used. This element is obsolete and will be removed in a future revision.
              symbolic name reference BswMCoreRef [0..1]: multiplicity set at link in variant link-time+post-build / pre-compile in variant pre-compile, set at link in variant link-time+post-build / pre-compile in variant pre-compile, destination=EcucCoreDefinition  # This reference points to the identifier of the slave core that is used as input parameter for the BswM_TriggerStartUpPhase2 and BswM_TriggerSlaveRTEStop functions. The value of this parameter shall be synchronized with the OsApplicationCoreAssignment parameter. Tags: atp.Status=obsolete / この参照は、BswM_TriggerStartUpPhase2およびBswM_TriggerSlaveRTEStop関数の入力パラメータとして使用されるスレーブコアの識別子を示す。このパラメータの値は、OsApplicationCoreAssignmentパラメータと同期させるものとする。
            container BswMUserCallout [0..1]  # This container includes all details needed for a user defined function call. / このコンテナには、ユーザー定義の関数呼び出しに必要なすべての詳細が含まれている。
              string BswMUserCalloutFunction [0..0]: set at link in variant link-time+post-build / pre-compile in variant pre-compile  # This parameter specifies the complete function call including all parameters. The parameters are specified during configuration time, and cannot be changed during run time. Any return values passed by the callout will be ignored. / このパラメータは、すべてのパラメータを含む完全な関数呼び出しを指定する。 パラメータは構成時に指定され、実行時に変更することはできない。コールアウトによって渡された戻り値はすべて無視される。 | Example usage can be: Actions to initialize other BSW modules Action to call Rte_Start() Action to call Rte_Stop() Action to call NvM_ReadAll() Action to call NvM_WriteAll()
              multiline string BswMUserCalloutFunctionMultipleInput: origin=QINeS, set at link in variant link-time+post-build / pre-compile in variant pre-compile  # Example usage can be: Actions to initialize other BSW modules Action to call Rte_Start() Action to call Rte_Stop() Action to call NvM_ReadAll() Action to call NvM_WriteAll() / Example usage can be: 使用例は次のとおりである。 他のBSWモジュールを初期化するアクション Rte_Start（）を呼び出すアクション Rte_Stop（）を呼び出すアクション NvM_ReadAll（）を呼び出すアクション NvM_WriteAll（）を呼び出すアクション
        container BswMActionList [1..*]: multiplicity set at link in variant link-time / post-build in variant post-build / pre-compile in variant pre-compile, post-build-variant-multiplicity=true  # Each instance of this container defines an action list that is invoked based on the BswM Rules. An action list contains a list of numbered action items to be processed. An action list can also include other action lists. / このコンテナの各インスタンスは、BswMルールに基づいて呼び出されるアクションリストを定義する。アクションリストには、処理される番号付きアクション項目のリストが含まれている。アクションリストには、他のアクションリストも含めることができる。
          enumeration BswMActionListExecution: {BSWM_CONDITION, BSWM_TRIGGER}, set at link in variant link-time+post-build / pre-compile in variant pre-compile  # This parameter controls if the corresponding action list shall be executed every time the rule is evaluated or only when the result of the evaluation changes. This parameter does not have an effect when this action list is executed within another action list. / このパラメータは、ルールが評価されるたびに、または評価の結果が変更されるときにのみ、対応するアクションリストが実行されるかどうかを制御する。
          container BswMActionListItem [1..*]: multiplicity set at link in variant link-time / post-build in variant post-build / pre-compile in variant pre-compile, post-build-variant-multiplicity=true  # This container defines an item in an action list. / このコンテナは、アクションリスト内の項目を定義する。
            boolean BswMAbortOnFail: post-build-variant-value=true, set at link in variant link-time / post-build in variant post-build / pre-compile in variant pre-compile, default-value=false  # This parameter defines if the execution of the action list shall be aborted if this specific action returns E_NOT_OK. Note that this is only applicable for actions that have E_NOT_OK as a possible return value. / このパラメータは、この特定のアクションがE_NOT_OKを返す場合、アクションリストの実行を中止するかどうかを定義する。これは、可能な戻り値としてE_NOT_OKを持つアクションに対してのみ適用可能であることに注意する。
            integer BswMActionListItemIndex: 0..255, post-build-variant-value=true, set at link in variant link-time / post-build in variant post-build / pre-compile in variant pre-compile  # This parameter defines the index of the action in the action list. It is used define in which order the actions shall be performed. / このパラメータは、アクションリスト内のアクションのインデックスを定義する。アクションが実行される順序を定義するために使用される。
            choice reference BswMActionListItemRef: post-build-variant-value=true, set at link in variant link-time / post-build in variant post-build / pre-compile in variant pre-compile, destination=[BswMAction, BswMActionList, BswMRule]  # The action item can either be an atomic action or a reference to another action list or rule. / アクションアイテムは、アトミックアクションでも、別のアクションリストまたはルールへの参照でも構わない。
            symbolic name reference BswMReportFailToDemRef [0..1]: multiplicity set at link in variant link-time / post-build in variant post-build / pre-compile in variant pre-compile, post-build-variant-multiplicity=true, post-build-variant-value=true, set at link in variant link-time / post-build in variant post-build / pre-compile in variant pre-compile, destination=DemEventParameter  # If the reference is given, the DEM event shall be reported failed if this specific action returns E_NOT_OK; it shall be reported passed if this specific action returns E_OK. / 参照が与えられている場合、この特定のアクションがE_NOT_OKを返した場合、DEMイベントは失敗と報告される。この特定のアクションがE_OKを返した場合、それは合格と報告される。
        container BswMRteModeRequestPort [0..*]: multiplicity set at pre-compile  # This container defines a mode request port which the BswM may utilize to send a mode request to a SW-C which is acting as a mode-manager. If this container is referenced by a BswMRteModeRequest, the BswM shall create a corresponding PPort in its service description. / このコンテナは、BswMがモード要求を、モードマネージャとして動作しているSW-Cに送信するために利用できるモード要求ポートを定義する。このコンテナがBswMRteModeRequestによって参照される場合、BswMはそのサービス記述に対応するPPortを作成するものとする。
          foreign reference BswMRteModeRequestPortInterfaceMappingRef [0..1]: multiplicity set at link in variant link-time+post-build / pre-compile in variant pre-compile, set at link in variant link-time+post-build / pre-compile in variant pre-compile, destination-type=VARIABLE-AND-PARAMETER-INTERFACE-MAPPING  # This is a foreign reference to the variable and parameter interface mapping used for the mode request. / これは、モード要求に使用される変数とパラメータのインターフェースマッピングに対する外部参照である。
          instance reference BswMRteModeRequestPortInterfaceRef: set at link in variant link-time+post-build / pre-compile in variant pre-compile, destination-context=SW-COMPONENT-PROTOTYPE* PORT-PROTOTYPE, destination-type=VARIABLE-DATA-PROTOTYPE  # This is an instance reference to the variable data prototype used for the mode request. / This is an instance reference to the variable data prototype used for the mode request. これは、モード要求に使用される可変データプロトタイプへのインスタンス参照である。
        container BswMSwitchPort [0..*]: multiplicity set at pre-compile  # This container includes a reference to mode switch interface which the BswM must instantiate for the creation of a PPortPrototype in its SWCD. / このコンテナは、BswMが各BSWMDのSWCDで作成しなければならないPPortsおよび/またはgivenModeDeclarationGroupsを指定する。
          foreign reference BswMModeSwitchInterfaceRef: set at link in variant link-time+post-build / pre-compile in variant pre-compile, destination-type=MODE-SWITCH-INTERFACE  # Reference to the ModeSwitchInterface of this BswMModeSwitchPort. / このBswMModeSwitchPortのModeSwitchInterfaceへの参照。
    container BswMGeneral  # General configuration parameters of the Basic SW Mode Manager. / BSWモードマネージャのジェネラルコンフィグレーション。
      boolean BswMCanSMEnabled: set at pre-compile, default-value=false  # enable/disable CanSM module related BswM API: / CanSMモジュールに関連するBswM APIを有効/無効にする： | true: Enabled false: Disabled
      boolean BswMCanSMIcomEnabled: set at pre-compile, default-value=false  # enable/disable CanSM Icom related BswM API: | true: Enabled false: Disabled
      boolean BswMComMEnabled: set at pre-compile, default-value=false  # enable/disable ComM module related BswM API: / ComMモジュールに関連するBswM APIを有効/無効にする： | true: Enabled false: Disabled
      boolean BswMDcmEnabled: set at pre-compile, default-value=false  # enable/disable Dcm module related BswM API: / Dcmモジュール関連のBswM APIを有効/無効にする： | true: Enabled false: Disabled
      boolean BswMDevErrorDetect: set at pre-compile, default-value=false  # Switches the Default Error Tracer (Det) detection and notification ON or OFF. / 開発エラーの検出と通知をオンまたはオフに切り替える。 | * true: enabled (ON). * false: disabled (OFF).
      boolean BswMEcuMEnabled: set at pre-compile, default-value=false  # enable/disable EcuM module related BswM API: / EcuMモジュールに関連するBswM APIを有効/無効にする： | true: Enabled false: Disabled
      boolean BswMEthSMEnabled: set at pre-compile, default-value=false  # enable/disable EthSM module related BswM API: / EthSMモジュールに関連するBswM APIを有効/無効にする： | true: Enabled false: Disabled
      boolean BswMFrSMEnabled: set at pre-compile, default-value=false  # enable/disable FrSM module related BswM API: / FrSMモジュールに関連するBswM APIを有効/無効にする： | true: Enabled false: Disabled
      boolean BswMGenericRequestEnabled: set at pre-compile, default-value=false  # enable/disable Generic Request related BswM API: / 汎用リクエスト関連のBswM APIを有効/無効にする： | true: Enabled false: Disabled
      boolean BswMJ1939DcmEnabled: multiplicity set at pre-compile, set at pre-compile, default-value=false  # Enable/disable J1939Dcm module related BswM API: | true: Enabled false: Disabled
      boolean BswMJ1939NmEnabled: set at pre-compile, default-value=false  # Enable/disable J1939Nm module related BswM API. | true: Enabled false: Disabled
      boolean BswMLinSMEnabled: set at pre-compile, default-value=false  # enable/disable LinSM module related BswM API: / LinSMモジュールに関連するBswM APIを有効/無効にする： | true: Enabled false: Disabled
      boolean BswMLinTPEnabled: set at pre-compile, default-value=false  # enable/disable LinTP module related BswM API: / LinTPモジュール関連のBswM APIを有効/無効にする： | true: Enabled false: Disabled
      float BswMMainFunctionPeriod: 0..Inf, multiplicity set at link in variant link-time+post-build / pre-compile in variant pre-compile, set at link in variant link-time+post-build / pre-compile in variant pre-compile  # The cycle time of the periodic main function of BswM. Defined in seconds . / BswMの周期的な主機能のサイクル時間。 Defined in seconds . 秒単位で定義される。
      boolean BswMNvMEnabled: set at pre-compile, default-value=false  # enable/disable NvM module related BswM API: / NvMモジュールに関連するBswM APIを有効/無効にする： | true: Enabled false: Disabled
      integer BswMQQueueSize: 1..256, set at pre-compile, origin=QINeS  # Sise of queue buffer.
      boolean BswMSchMEnabled: set at pre-compile, default-value=false  # enable/disable SchM module related BswM API: / SchMモジュール関連のBswM APIを有効/無効にする： | true: Enabled false: Disabled
      boolean BswMSdEnabled: set at pre-compile, default-value=false  # enable/disable Sd module related BswM API. | true: Enabled false: Disabled
      boolean BswMVersionInfoApi: set at pre-compile, default-value=true  # Switches the possibility to read the version information with the service BswM_GetVersionInfo(). / サービスBswM_GetVersionInfo（）を使用してバージョン情報を読み取る可能性を切り替える。 | true: Enabled false: Disabled
      boolean BswMWdgMEnabled: set at pre-compile, default-value=false  # enable/disable WdgM module related BswM API: / WdgMモジュールに関連するBswM APIを有効/無効にする： | true: Enabled false: Disabled
      container BswMUserIncludeFiles [0..1]  # Collection of header file names which shall be included by the BswM. / BswMに含まれるヘッダファイル名の集合。
        string BswMUserIncludeFile [1..*]: multiplicity set at pre-compile, set at pre-compile  # Header file name which shall be included by the BswM. / BswMに含まれるヘッダファイル名。 | The value of this parameter shall be used as h-char-sequence or q-char-sequence according to ISO C90 section 6.10.2 "source file inclusion". The parameter value MUST NOT represent a path, since ISO C90 does not specify how such a path is treated (i.e., this is implementation defined (and additionally depends on the operating system and the underlying file system)).

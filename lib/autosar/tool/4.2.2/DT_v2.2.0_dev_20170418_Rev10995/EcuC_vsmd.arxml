AUTOSAR XML (schema 4-2-2)
package /QINeS
  ecuc definition collection AUTOSARParameterDefinition: module=EcuC
  module definition EcuC [0..1]: refined-module-def=EcuC, post-build-variant-support=true, variants post-build/pre-compile  # Virtual module to collect ECU Configuration specific / global configuration information. / EcuCモジュールのコンフィグレーション。
    container EcucConfigSet [0..1]  # This container contains the configuration parameters and sub containers of the global PduCollection.
      container EcucPduCollection [0..1]  # Collection of all Pdu objects flowing through the Com-Stack. / COMスタックで使われる全PDUオブジェクトのコレクション。
        enumeration PduIdTypeEnum [0..0]: {UINT16, UINT8}  # The PduIdType is used within the entire AUTOSAR Com Stack except for bus drivers. The size of this global type depends on the maximum number of PDUs used within one software module. If no software module deals with more PDUs that 256, this type can be set to uint8. If at least one software module handles more than 256 PDUs, this type must be set to uint16. See AUTOSAR_SWS_CommunicationStackTypes for more details. / PduIdTypeは、バスドライバを除くAUTOSARの全COMスタック内で使用される。 この設定値は1つのソフトウェア・モジュール内で使用されるPDUの最大数に依存する。 256以上のPDUを処理するSWモジュールが一つもない場合、uint8を設定することができる。 256以上のPDUを処理するソフトウェアモジュールが一つでもある場合、uint16を設定する必要がある。 詳細についてはAUTOSAR_SWS_CommunicationStackTypesを参照。
        enumeration PduLengthTypeEnum [0..0]: {UINT16, UINT32, UINT8}  # The PduLengthType is used within the entire AUTOSAR Com Stack except for bus drivers. The size of this global type depends on the maximum length of PDUs to be sent by an ECU. If no segmentation is used the length depends on the maximum payload size of a frame of the underlying communication system (for FlexRay maximum size is 255 bytes, therefore uint8). If segmentation is used it depends on the maximum length of a segmented N-PDU (in general uint16 is used). See AUTOSAR_SWS_CommunicationStackTypes for more details. / PduLengthTypeは、バスドライバを除くAUTOSARの全COMスタック内で使用される。 この設定値はECUによって送信されるPDUの最大長に依存する。 セグメントがない場合、PDUの長さは、基礎となる通信システムのフレームの最大ペイロードサイズにより決定する。（したがって、uint8のFlexRayの最大サイズは255バイトである。） セグメントが使用されている場合、分割された N-PDUの最大長さに依存する。（一般的にuint16が使用されている。） 詳細についてはAUTOSAR_SWS_CommunicationStackTypesを参照。
        container Pdu [0..65535]: multiplicity set at post-build in variant post-build / pre-compile in variant pre-compile, post-build-variant-multiplicity=true  # One Pdu flowing through the COM-Stack. / COMスタックで使われる一つのPDU。 | This Pdu is used by all Com-Stack modules to agree on referencing the same Pdu.
          boolean J1939Requestable [0..0]: multiplicity set at post-build in variant post-build / pre-compile in variant pre-compile, post-build-variant-multiplicity=true, post-build-variant-value=true, set at post-build in variant post-build / pre-compile in variant pre-compile  # Pdu can be triggered by the J1939 request message.
          integer MetaDataLength [0..0]: 0..4, multiplicity set at post-build in variant post-build / pre-compile in variant pre-compile, post-build-variant-multiplicity=true, post-build-variant-value=true, set at post-build in variant post-build / pre-compile in variant pre-compile, default-value=0  # Number of additional bytes in PDU data that contain auxiliary information (MetaData) for the PDU, e.g. the CAN ID. These bytes are handled as part of the PDU data and increase the PDU data length accordingly.
          integer PduLength: 0..4095, post-build-variant-value=true, set at post-build in variant post-build / pre-compile in variant pre-compile  # Length of the Pdu in bytes. It should be noted that in former AUTOSAR releases (Rel 2.1, Rel 3.0, Rel 3.1, Rel 4.0 Rev. 1) this parameter was defined in bits. / バイト単位でのPDUの長さ。AUTOSARリリース（Rel 2.1, Rel 3.0, Rel 3.1, Rel 4.0 Rev. 1）ではこのパラメータはビットで定義されていたもの。
          foreign reference SysTPduToFrameTriggeringRef [0..0]: multiplicity set at post-build in variant post-build / pre-compile in variant pre-compile, post-build-variant-multiplicity=true, post-build-variant-value=true, set at post-build in variant post-build / pre-compile in variant pre-compile, destination-type=FRAME-TRIGGERING  # Reference to the FrameTriggering from the SystemTemplate which this Pdu belongs to. | SysTPduToFrameTriggeringRef shall be used for UserDefinedPdus, NmPdus and NPdus which are not going through the Pdu Router. This reference shall not be used if SysTPduToPduTriggeringRef exists.
          foreign reference SysTPduToPduTriggeringRef [0..0]: multiplicity set at post-build in variant post-build / pre-compile in variant pre-compile, post-build-variant-multiplicity=true, post-build-variant-value=true, set at post-build in variant post-build / pre-compile in variant pre-compile, destination-type=PDU-TRIGGERING  # Reference to the PduTriggering from the SystemTemplate which this Pdu represents. | SysTPduToPduTriggeringRef shall be used for all Pdus except UserDefinedPdus, NmPdus and NPdus which are not going through the Pdu Router. For these Pdus, SysTPduToFrameTriggeringRef shall be used.
    container EcucHardware  # Hardware definition of this Ecu. / ECUのハードウェア定義。
      container EcucCoreDefinition [1..65535]  # Definition of one Core on this Ecu. / ECUの1つのコアに関する定義。
        integer EcucCoreId: 0..65535, set at pre-compile, symbolic-name-value=true  # ID of the core. / コアID。
        foreign reference EcucCoreHwRef [0..0]: multiplicity set at pre-compile, set at pre-compile, destination-type=HW-ELEMENT  # Optional reference to the HwElement of HwCategory ProcessingUnit that represents this Core in the ECU Resource Template. / ECUリソーステンプレートで定義される、このコアを表すHwCategory ProcessingUnitのHwElementへの参照。
    container EcucPartitionCollection [0..1]  # Collection of Partitions defined for this ECU. / このECU用に定義されたパーティションのコレクション。
      container EcucPartition [0..65535]: multiplicity set at pre-compile  # Definition of one Partition on this ECU. / このECU上の1つのパーティションの定義。 | One Partition will be implemented using one Os-Application.
        boolean EcucPartitionBswModuleExecution: set at pre-compile  # Denotes that this partition will execute BSW Modules. BSW Modules can only be executed in such partitions. / このパーティションが実行するすべてのBSWモジュールを示す。 BSWモジュールは、ただ1つのパーティションで実行することができる。
        boolean EcucPartitionQmBswModuleExecution: scope=ECU, set at pre-compile, default-value=false  # Denotes that this partition will execute QM BSW. / QMのBSWが実行されていることを意味する。
        boolean PartitionCanBeRestarted: set at pre-compile, default-value=false  # Specifies the requirement whether the Partition can be restarted. If set to true all software executing in this partition shall be capable of handling a restart. / パーティションがリスタート可能かどうかを設定する。 trueに設定した場合、パーティションで実行されるすべてのソフトウェアについてリスタート処理を可能にする。
        foreign reference EcucPartitionBswModuleDistinguishedPartition [0..0]: multiplicity set at pre-compile, set at pre-compile, destination-type=BSW-DISTINGUISHED-PARTITION  # This maps the abstract partition of the Bsw Module to a concrete Partition existing in the ECU.
        instance reference EcucPartitionSoftwareComponentInstanceRef [0..*]: multiplicity set at pre-compile, set at pre-compile, destination-context=ROOT-SW-COMPOSITION-PROTOTYPE, destination-type=SW-COMPONENT-PROTOTYPE  # References the SW Component instances from the Ecu Extract that shall be executed in this partition. / このパーティションで実行される、ECUからSWコンポーネントインスタンスへの参照。
    container EcucPostBuildVariants [0..0]  # Collection of toplevel PostBuildSelectable variants. The PredefinedVariants linked inside this container will determine how many PostBuildSelectableVariants exist. If this container exist the name pattern for initialization of BSW modules will be <Mip>_Config_<PredefinedVariant.shortName>. If this container does not exist the name pattern for initialization of BSW modlues will be <Mip>_Config.
      foreign reference EcucPostBuildVariantRef [1..*]: multiplicity set at pre-compile, set at pre-compile, destination-type=PREDEFINED-VARIANT  # Reference to a PredefinedVariant that defines one toplevel postBuild configuration set (covering all post-build capable BSW modules). PredefinedVariants that are referenced here shall contain only PostBuildVariantCriterionValueSets.
    container EcucUnitGroupAssignment [0..0]  # Collection of UnitGroup references to support the generation of ASAM MCD file.
      foreign reference EcucUnitGroupRef [1..*]: multiplicity set at pre-compile, set at pre-compile, destination-type=UNIT-GROUP  # Optional reference to the UnitGroup to support the generation of ASAM MCD file. These UnitGroups are selecting a set of units for a specific country.
    container EcucVariationResolver [0..0]  # Collection of PredefinedVariant elements containing definition of values for SwSystemconst which shall be applied when resolving the variability during ECU Configuration. / ECUコンフィグレーション時のばらつきを解決するときに適用される、SwSystemconstの値の定義を含むPredefinedVariant要素のコレクション。
      foreign reference PredefinedVariantRef [1..*]: multiplicity set at pre-compile, set at pre-compile, destination-type=PREDEFINED-VARIANT

AUTOSAR XML (schema 4-2-2)
package /QINeS
  ecuc definition collection AUTOSARParameterDefinition: module=Eep
  module definition Eep [0..*]: refined-module-def=Eep, post-build-variant-support=true, variants post-build/pre-compile  # Configuration of the Eep (internal or external EEPROM driver) module. / Eepモジュールのコンフィグレーション。(MCAL ダミー) | Its multiplicity describes the number of EEPROM drivers present, so there will be one container for each EEPROM driver in the ECUC template. When no EEPROM driver is present then the multiplicity is 0.
    container EepGeneral  # Container for general configuration parameters of the EEPROM driver. These parameters are always pre-compile. / EEPROMドライバのジェネラルコンフィグレーション。
      boolean EepDevErrorDetect: set at pre-compile, default-value=true  # Switches the Default Error Tracer (Det) detection and notification ON or OFF. / 開発エラー検出スイッチ。 開発エラー検出をするか否か。 TRUE：実装する FALSE：実装しない | * true: enabled (ON). * false: disabled (OFF).
      integer EepDriverIndex: 0..254, scope=ECU, set at pre-compile, symbolic-name-value=true  # Index of the driver, used by EA. / EEPROMドライバID。 Eaが使用する。
      boolean EepUseInterrupts: set at pre-compile, default-value=false  # Switches to activate or deactivate interrupt controlled job processing. / 割り込み制御ジョブ処理スイッチ。 TRUE：割り込み制御ジョブ処理を有効 FALSE：割り込み制御ジョブ処理を無効 | true: Interrupt controlled job processing enabled. false: Interrupt controlled job processing disabled.
      boolean EepVersionInfoApi: set at pre-compile, default-value=false  # Pre-processor switch to enable / disable the API to read out the modules version information. / バージョン取得APIスイッチ。 Eep_GetVersionInfo()関数を実装するか否か。 TRUE：実装する FALSE：実装しない | true: Version info API enabled. false: Version info API disabled.
      boolean EepWriteCycleReduction: set at pre-compile, default-value=false  # Switches to activate or deactivate write cycle reduction (EEPROM value is read and compared before being overwritten). / ライトサイクル削減スイッチ。 ライトサイクル削減（EEPROMの内容を上書きする前にリード、コンペアを行う）をするか否か。 TRUE：有効 FALSE：無効 | true: Write cycle reduction enabled. false: Write cycle reduction disabled.
    container EepInitConfiguration  # Container for runtime configuration parameters of the EEPROM driver. / EEPROMドライバのランタイムパラメータ群。 ※「Eep_ConfigTypeとして実装」と記載されているが、Eep_InitConfigurationTypeとして定義する。 | Implementation Type: Eep_ConfigType.
      integer EepBaseAddress: 0..4294967295, post-build-variant-value=true, set at post-build in variant post-build / pre-compile in variant pre-compile  # This parameter is the EEPROM device base address. / EEPROMデバイスベースアドレス。 | Implementation Type: Eep_AddressType.
      enumeration EepDefaultMode: {MEMIF_MODE_FAST, MEMIF_MODE_SLOW}, post-build-variant-value=true, set at post-build in variant post-build / pre-compile in variant pre-compile, default-value=MEMIF_MODE_SLOW  # This parameter is the default EEPROM device mode after initialization. / デフォルトEEPROMデバイスモード。 初期化後にセットされる。 | Implementation Type: MemIf_ModeType.
      integer EepFastReadBlockSize: 0..4294967295, post-build-variant-value=true, set at post-build in variant post-build / pre-compile in variant pre-compile  # Number of bytes read within one job processing cycle in fast mode. If the hardware does not support burst mode this parameter shall be set to the same value as EepNormalReadBlockSize. / ファーストリードブロックサイズ。 ファーストモードにおける、ジョブの１処理サイクルにおけるリードのバイト数。ハードウェアがバーストモードをサポートしていない場合、このパラメータはEepNormalReadBlockSizeと同じ値でなければならない。Eep_LengthTypeで実装する。 | Implementation Type: Eep_LengthType.
      integer EepFastWriteBlockSize: 0..4294967295, post-build-variant-value=true, set at post-build in variant post-build / pre-compile in variant pre-compile  # Number of bytes written within one job processing cycle in fast mode. If the hardware does not support burst mode this parameter shall be set to the same value as EepNormalWriteBlockSize. / ファーストライトブロックサイズ。 ファーストモードにおける、ジョブの１処理サイクルにおけるライトのバイト数。ハードウェアがバーストモードをサポートしていない場合、このパラメータはEepNormalWriteBlockSizeと同じ値でなければならない。Eep_LengthTypeで実装する。 | Implementation Type: Eep_LengthType.
      float EepJobCallCycle [0..1]: 0..Inf, multiplicity set at post-build in variant post-build / pre-compile in variant pre-compile, post-build-variant-multiplicity=true, post-build-variant-value=true, set at post-build in variant post-build / pre-compile in variant pre-compile  # Call cycle time of the EEPROM driver's main function. Unit: [s] / ジョブコールサイクル。 EEPROMドライバのメイン関数が呼び出されるサイクル時間。(ミリ秒) ⇒単位を変える、SchM担当者と調整が必要。
      function name EepJobEndNotification [0..1]: multiplicity set at post-build in variant post-build / pre-compile in variant pre-compile, post-build-variant-multiplicity=true, post-build-variant-value=true, set at post-build in variant post-build / pre-compile in variant pre-compile  # This parameter is a reference to a callback function for positive job result (see EEP045). / ジョブ終了通知Callback関数。 ジョブ正常終了時のCallback関数。
      function name EepJobErrorNotification [0..1]: multiplicity set at post-build in variant post-build / pre-compile in variant pre-compile, post-build-variant-multiplicity=true, post-build-variant-value=true, set at post-build in variant post-build / pre-compile in variant pre-compile  # This parameter is a reference to a callback function for negative job result (see EEP046). / ジョブエラー通知Callback関数。 ジョブ異常終了時のCallback関数。
      integer EepNormalReadBlockSize: 0..4294967295, post-build-variant-value=true, set at post-build in variant post-build / pre-compile in variant pre-compile  # Number of bytes read within one job processing cycle in normal mode. / ノーマルリードブロックサイズ。 ノーマルモードにおける、ジョブの１処理サイクルにおけるリードのバイト数。Eep_LengthTypeで実装する。 | Implementation Type: Eep_LengthType.
      integer EepNormalWriteBlockSize: 0..4294967295, post-build-variant-value=true, set at post-build in variant post-build / pre-compile in variant pre-compile  # Number of bytes written within one job processing cycle in normal mode. / ノーマルライトブロックサイズ。 ノーマルモードにおける、ジョブの１処理サイクルにおけるライトのバイト数。Eep_LengthTypeで実装する。 | Implementation Type: Eep_LengthType.
      integer EepSize: 0..4294967295, post-build-variant-value=true, set at post-build in variant post-build / pre-compile in variant pre-compile  # This parameter is the used size of EEPROM device in bytes. / EEPROMサイズ。 EEPROMデバイスで使用されるサイズのバイト数。Eep_LengthTypeで実装する。 | Implementation Type: Eep_LengthType.
      container EepDemEventParameterRefs [0..1]  # Container for the references to DemEventParameter elements which shall be invoked using the API Dem_ReportErrorStatus API in case the corresponding error occurs. The EventId is taken from the referenced DemEventParameter's DemEventId value. The standardized errors are provided in the container and can be extended by vendor specific error references. / 対応するエラーが発生した場合にAPI Dem_ReportErrorStatus を使用して呼び出されなければならないDEMイベントパラメータ要素を参照するためのコンテナ。
        symbolic name reference EEP_E_COMPARE_FAILED [0..1]: multiplicity set at post-build in variant post-build / pre-compile in variant pre-compile, post-build-variant-multiplicity=true, post-build-variant-value=true, set at post-build in variant post-build / pre-compile in variant pre-compile, destination=DemEventParameter  # Reference to the DemEventParameter which shall be issued when the error "EEPROM compare failed (HW)" has occurred. / Demエラーコード。(EEPROMコンペア失敗)
        symbolic name reference EEP_E_ERASE_FAILED [0..1]: multiplicity set at post-build in variant post-build / pre-compile in variant pre-compile, post-build-variant-multiplicity=true, post-build-variant-value=true, set at post-build in variant post-build / pre-compile in variant pre-compile, destination=DemEventParameter  # Reference to the DemEventParameter which shall be issued when the error "EEPROM erase failed (HW)" has occurred. / Demエラーコード。(EEPROMイレース失敗)
        symbolic name reference EEP_E_READ_FAILED [0..1]: multiplicity set at post-build in variant post-build / pre-compile in variant pre-compile, post-build-variant-multiplicity=true, post-build-variant-value=true, set at post-build in variant post-build / pre-compile in variant pre-compile, destination=DemEventParameter  # Reference to the DemEventParameter which shall be issued when the error "EEPROM read failed (HW)" has occurred. / Demエラーコード。(EEPROMリード失敗)
        symbolic name reference EEP_E_WRITE_FAILED [0..1]: multiplicity set at post-build in variant post-build / pre-compile in variant pre-compile, post-build-variant-multiplicity=true, post-build-variant-value=true, set at post-build in variant post-build / pre-compile in variant pre-compile, destination=DemEventParameter  # Reference to the DemEventParameter which shall be issued when the error "EEPROM write failed (HW)" has occurred. / Demエラーコード。(EEPROMライト失敗)
      container EepExternalDriver [0..1]  # This container is present for external EEPROM drivers only. Internal EEPROM drivers do not use the parameter listed in this container, hence its multiplicity is 0 for internal drivers. / 外部ドライバ。 外部EEPROMドライバを提供する。内部EEPROMドライバはこのコンテナのパラメータを使用できない。そのため、内部ドライバのmultiplicityは0になる。
        symbolic name reference EepSpiReference [1..*]: multiplicity set at post-build in variant post-build / pre-compile in variant pre-compile, post-build-variant-multiplicity=true, post-build-variant-value=true, set at post-build in variant post-build / pre-compile in variant pre-compile, destination=SpiSequence  # Reference to SPI sequence (required for external EEPROM drivers). / (外部EEPROMドライバに要求される)SPIシーケンスへの参照。
    container EepPublishedInformation  # Additional published parameters not covered by CommonPublishedInformation container. / CommonPublishedInformationコンテナでカバーされていない追加の公開パラメータ。 これらのパラメータは公開情報であるため、コンフィグレーションクラス設定を持たない。 | Note that these parameters do not have any configuration class setting, since they are published information.
      integer EepAllowedWriteCycles: 0..4294967295, set at published-information  # Specified maximum number of write cycles under worst case conditions of specific EEPROM hardware (e.g. +90°C) / 許容ライトサイクル。 EEPROMハードウェアのワースト状態下（例えば＋90度）での最大ライトサイクル。
      float EepEraseTime: 0..Inf, set at published-information  # Maximum time for erasing one EEPROM data unit. / イレース時間。 1つのEEPROMデータユニットに対するイレースにかかる最大時間。
      integer EepEraseUnitSize: 0..4294967295, set at published-information  # Size of smallest erasable EEPROM data unit in bytes. / イレースユニットサイズ。 イレース可能なEEPROMデータユニットの最小サイズのバイト数。
      integer EepEraseValue: 0..255, set at published-information  # Value of an erased EEPROM cell. / イレース値。 イレースされたEEPROMセルの値。
      integer EepMinimumAddressType: 0..4294967295, set at published-information  # Minimum expected size of Eep_AddressType. / Eep_AddressType最小サイズ。 Eep_AddressTypeの最小許容サイズ。
      integer EepMinimumLengthType: 0..4294967295, set at published-information  # Minimum expected size of Eep_LengthType. / Eep_LengthType最小サイズ。 Eep_LengthTypeの最小許容サイズ。
      integer EepReadUnitSize: 0..4294967295, set at published-information  # Size of smallest readable EEPROM data unit in bytes. / リードユニットサイズ。 リード可能な最小EEPROMデータユニットサイズのバイト数。
      integer EepSpecifiedEraseCycles: 0..4294967295, set at published-information  # Number of erase cycles specified for the EEP device (usually given in the device data sheet). / イレースサイクル数。 EEPデバイス定義のイレースサイクル数（通常はデバイスデータシートから与えられる）。
      integer EepTotalSize: 0..4294967295, set at published-information  # Total size of EEPROM in bytes. / トータルサイズ。 EEPROMの全サイズのバイト数。Eep_LengthTypeで実装する。 | Implementation Type: Eep_LengthType.
      float EepWriteTime: 0..Inf, set at published-information  # Maximum time for writing one EEPROM data unit. / ライト時間。 1つのEEPROMデータユニットに対するライトにかかる最大時間。
      integer EepWriteUnitSize: 0..4294967295, set at published-information  # Size of smallest writeable EEPROM data unit in bytes. / ライトユニットサイズ。 ライト可能なEEPROMデータユニットの最小サイズのバイト数。

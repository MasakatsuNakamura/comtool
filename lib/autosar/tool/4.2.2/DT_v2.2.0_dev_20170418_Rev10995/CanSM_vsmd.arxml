AUTOSAR XML (schema 4-2-2)
package /QINeS
  ecuc definition collection AUTOSARParameterDefinition: module=CanSM
  module definition CanSM [0..1]: refined-module-def=CanSM, post-build-variant-support=true, variants link-time/post-build/pre-compile  # Configuration of the CanSM module / CanSMモジュールのコンフィグレーション。
    container CanSMConfiguration [1..*]  # This container contains the global parameters of the CanSM and sub containers, which are for the CAN network specific configuration. / このコンテナには、CANネットワーク固有の設定のためのCanSMとサブコンテナのグローバルパラメータが含まれる。
      integer CanSMModeRequestRepetitionMax: 0..255, post-build-variant-value=true, set at link in variant link-time / post-build in variant post-build / pre-compile in variant pre-compile  # Specifies the maximal amount of mode request repetitions without a respective mode indication from the CanIf module until the CanSM module reports a Default Error to the Det and tries to go back to no communication. / タイムアウト(要求前の状態に遷移)までの時間。 最大数を超えるとCanSMモジュールはDETに開発エラーを報告し無通信状態に遷移する。
      float CanSMModeRequestRepetitionTime: 0..65.535, post-build-variant-value=true, set at link in variant link-time / post-build in variant post-build / pre-compile in variant pre-compile  # Specifies in which time duration the CanSM module shall repeat mode change requests by using the API of the CanIf module. / CanSMモジュールがCanIfモジュールのAPIを使用してモード変更要求を繰り返す期限時間を指定する。[sec]単位（小数第三位まで入力可）。
      container CanSMManagerNetwork [0..256]  # This container contains the CAN network specific parameters of each CAN network / CANネットワークの情報を設定するコンフィグレーション。
        integer CanSMBorCounterL1ToL2: 0..255, post-build-variant-value=true, set at link in variant link-time / post-build in variant post-build / pre-compile in variant pre-compile  # This threshold defines the count of bus-offs until the bus-off recovery switches from level 1 (short recovery time) to level 2 (long recovery time). / この閾値は、レベル1(短期リカバリ時間)からレベル2(長期リカバリ時間)へのバスオフリカバリ切り替えまでのバスオフ回数を定義する。
        float CanSMBorTimeL1: 0..65.535, post-build-variant-value=true, set at link in variant link-time / post-build in variant post-build / pre-compile in variant pre-compile  # This time parameter defines in seconds the duration of the bus-off recovery time in level 1 (short recovery time). / この時間パラメータは、レベル1(短期リカバリ時間)のバスオフリカバリ継続時間を定義する。[sec]単位（小数第三位まで入力可）。
        float CanSMBorTimeL2: 0..65.535, post-build-variant-value=true, set at link in variant link-time / post-build in variant post-build / pre-compile in variant pre-compile  # This time parameter defines in seconds the duration of the bus-off recovery time in level 2 (long recovery time). / この時間パラメータは、レベル2(長期リカバリ時間)のバスオフリカバリ継続時間を定義する。[sec]単位（小数第三位まで入力可）。
        float CanSMBorTimeTxEnsured: 0..65.535, post-build-variant-value=true, set at link in variant link-time / post-build in variant post-build / pre-compile in variant pre-compile  # This parameter defines in seconds the duration of the bus-off event check. This check assesses, if the recovery has been successful after the recovery reenables the transmit path. If a new bus-off occurs during this time period, the CanSM assesses this bus-off as sequential bus-off without successful recovery. Because a bus-off only can be detected, when PDUs are transmitted, the time has to be great enough to ensure that PDUs are transmitted again (e. g. time period of the fastest cyclic transmitted PDU of the COM module / ComTxModeTimePeriodFactor). / バスオフチェック状態からバスオフ無し状態に遷移するまでのタイマー。 バスオフイベントチェックの有効期間を定義する。[sec]単位（小数第三位まで入力可）。 バスオフイベントチェックは、送信パスの再有効リカバリ後、リカバリが成功したかどうかを評価する。 新しいバスオフがこの期間中に発生した場合、 CanSMはこのバスオフを、リカバリの成功を伴わないシーケンシャルバスオフとして評価する。 PDU送信時のバスオフを検出するため、この時間は、 PDUが再送信されることを保証するために十分な大きさでなければならない。 例： COMモジュール/ComTxModeTimePeriodFactorの最短のPDU送信周期時間。
        boolean CanSMBorTxConfirmationPolling: set at pre-compile  # This parameter shall configure, if the CanSM polls the CanIf_GetTxConfirmationState API to decide the bus-off state to be recovered instead of using the CanSMBorTimeTxEnsured parameter for this decision. / バスオフ無し状態への遷移にCanIfのCANコントローラ。 送信確認状態取得APIを用いるかの有無。 CanSMがCanIf_GetTxConfirmationState APIのポーリングによるバス・オフ状態の回復判定に代わって、CanSMBorTimeTxEnsuredパラメータを使用するかを設定する。
        boolean CanSMEnableBusOffDelay [0..0]: multiplicity set at pre-compile, set at pre-compile, default-value=false  # This parameter defines if the <User_GetBusOffDelay> shall be called for this network.
        symbolic name reference CanSMComMNetworkHandleRef: post-build-variant-value=true, set at link in variant link-time / post-build in variant post-build / pre-compile in variant pre-compile, destination=ComMChannel  # Unique handle to identify one certain CAN network. Reference to one of the network handles configured for the ComM. / 1つのCANネットワークに対するユニークな識別ハンドル。ComMの設定ための１つのネットワークハンドルを参照する。
        symbolic name reference CanSMTransceiverId [0..1]: multiplicity set at link in variant link-time / post-build in variant post-build / pre-compile in variant pre-compile, post-build-variant-multiplicity=true, post-build-variant-value=true, set at link in variant link-time / post-build in variant post-build / pre-compile in variant pre-compile, destination=CanIfTrcvCfg  # ID of the CAN transceiver assigned to the configured network handle. Reference to one of the transceivers managed by the CanIf module. / CANトランシーバを参照するためのID。 CanIfモジュールによって管理される1つのトランシーバを参照する。
        container CanSMController [1..256]  # This container contains the controller IDs assigned to a CAN network. / 同CANネットワークに属するCANコントローラの総数。 このコンテナには、 CANネットワークに割り当てられたコントローラIDが含まれる。
          symbolic name reference CanSMControllerId: post-build-variant-value=true, set at link in variant link-time / post-build in variant post-build / pre-compile in variant pre-compile, destination=CanIfCtrlCfg  # Unique handle to identify one certain CAN controller. Reference to one of the CAN controllers managed by the CanIf module. / CANコントローラを参照するためのID。 CanIfモジュールによって管理される1つのCANコントローラを参照する。
        container CanSMDemEventParameterRefs [0..1]  # Container for the references to DemEventParameter elements which shall be invoked using the API Dem_ReportErrorStatus API in case the corresponding error occurs. The EventId is taken from the referenced DemEventParameter's DemEventId value. The standardized errors are provided in the container and can be extended by vendor specific error references. / 対応するエラーが発生した場合、API Dem_ReportErrorStatus APIを使用して呼び出されるDemEventParameter要素への参照のためのコンテナ。 EventIdは、参照DemEventParameterのDemEventId値から取得される。 標準化されたエラーは、コンテナ内に提供され、ベンダー固有のエラー符号を拡張することができる。
          symbolic name reference CANSM_E_BUS_OFF [0..1]: multiplicity set at link in variant link-time / post-build in variant post-build / pre-compile in variant pre-compile, post-build-variant-multiplicity=true, post-build-variant-value=true, set at link in variant link-time / post-build in variant post-build / pre-compile in variant pre-compile, destination=DemEventParameter  # Reference to configured DEM event to report bus off errors for this CAN network. / CANネットワークのバスオフエラーをDEMへ通知する処理ID。
    container CanSMGeneral  # Container for general pre-compile parameters of the CanSM module / CanSMモジュールのジェネラルプリコンパイルパラメータのコンテナ。
      boolean CanSMDevErrorDetect: set at pre-compile  # Switches the Default Error Tracer (Det) detection and notification ON or OFF. / 開発エラーの検出および通知のメカニズムを有効/無効にする。 | * true: enabled (ON). * false: disabled (OFF).
      function name CanSMGetBusOffDelayFunction [0..0]: multiplicity set at pre-compile, set at pre-compile  # This parameter configures the name of the <User_GetBusOffDelay> callout function, which is used by CanSM to acquire an additional L1/L2 delay time. This function is only called for channels where CanSMEnableBusOffDelay is enabled.
      string CanSMGetBusOffDelayHeader [0..0]: multiplicity set at pre-compile, set at pre-compile  # This parameter configures the header file containing the prototype of the <User_GetBusOffDelay> callout function.
      boolean CanSMIcomSupport [0..0]: scope=ECU, set at pre-compile, default-value=false  # Selects support of Pretended Network features in CanSM. | True: Enabled False: Disabled
      float CanSMMainFunctionTimePeriod: 0.001..65.535, set at pre-compile  # This parameter defines the cycle time of the function CanSM_MainFunction in seconds / CanSM_MainFunction関数のサイクルタイムを定義する。[sec]単位（小数第三位まで入力可）。
      boolean CanSMPncSupport [0..0]: multiplicity set at pre-compile, set at pre-compile, default-value=false  # Enables or disables support of partial networking. | False: Partial Networking is disabled True: Partial Networking is enabled
      integer CANSM_Q_EVENTQUEUE_SIZE: 1..255, set at pre-compile, origin=QINeS, default-value=10  # -
      boolean CanSMSetBaudrateApi [0..0]: scope=ECU, multiplicity set at pre-compile, set at pre-compile, default-value=false  # The support of the Can_SetBaudrate API is optional. If this parameter is set to true the Can_SetBaudrate API shall be supported. Otherwise the API is not supported.
      boolean CanSMTxOfflineActiveSupport [0..0]: multiplicity set at pre-compile, set at pre-compile  # Determines whether the ECU passive feature is supported by CanSM. | True: Enabled False: Disabled
      boolean CanSMVersionInfoApi: set at pre-compile  # Activate/Deactivate the version information API (CanSM_GetVersionInfo). / バージョン情報API(CanSM_GetVersionInfo)の有効/無効を設定する。 | true: version information API activated false: version information API deactivated

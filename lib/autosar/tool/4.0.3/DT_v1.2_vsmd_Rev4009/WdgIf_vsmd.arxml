AUTOSAR XML (schema 4-0-3)
package /QINeS
  ecuc definition collection AUTOSARParameterDefinition: module=WdgIf
  module definition WdgIf [0..1]: refined-module-def=WdgIf, variants pre-compile  # Configuration of the WdgIf (Watchdog Interface) module. / WdgIfモジュールのコンフィグレーション。
    container WdgIfDevice [1..65535]  # It contains the information for the selection of a particular Watchdog device in case multiple Watchdog drivers are connected. / 複数のウォッチドッグ・ドライバが接続されている場合に、特定のウォッチドッグ・デバイスを選択するための情報が含まれる。
      integer WdgIfDeviceIndex: 0..255, scope=ECU, set at pre-compile, symbolic-name-value=true, default-value=0  # Represents the watchdog interface ID so that it can be referenced by the watchdog manager. / ウォッチドッグデバイスのID。
      function name WdgSetMode: scope=ECU, set at pre-compile, origin=QINeS  # Address of the watchdog mode change function of watchdog driver / 対応するウォッチドッグドライバの提供するモード切替関数へのポインタ。 | Address of the watchdog mode change function of watchdog driver
      function name WdgSetTriggerCondition: scope=ECU, set at pre-compile, origin=QINeS  # Address of the trigger condition update function of watchdog driver / 対応するウォッチドッグドライバの提供するトリガコンディション更新関数へのポインタ。 | Address of the trigger condition update function of watchdog driver
      symbolic name reference WdgIfDriverRef: set at pre-compile, destination=WdgGeneral  # Reference to the watchdog drivers that are controlled by the watchdog interface. / ウォッチドッグドライバのID。
      symbolic name reference WdgIfQWatchdogCore: set at pre-compile, origin=QINeS, destination=EcucCoreDefinition  # - / 対象のコアID。
    container WdgIfGeneral  # This container collects all generic watchdog interface parameters. / WdfIfモジュールのジェネラルコンフィグレーション。 全てのウォッチドッグインターフェースのパラメータを集めたコンテナ。
      integer WDGIF_Q_NUM_OF_WDGIFDEVICE: 0..65535, set at pre-compile, origin=QINeS, default-value=0  # - / ウォッチドッグデバイスの個数。 WdgIf_NumOfWdgIfDeviceと同じ値を定義すること。 ウォッチドッグ機能を使用しない場合は0を定義すること。
      boolean WdgIfDevErrorDetect: set at pre-compile, default-value=true  # Pre-processor switch for enabling the development error detection and reporting. / 開発時エラー検出のスイッチ。 TRUE：エラー検出有効 FALSE：エラー検出無効 | true: Development error detection enabled false: Development error detection disabled
      boolean WdgIfVersionInfoApi: set at pre-compile, default-value=true  # Pre-processor switch to enable / disable the service returning the version information. / WdgIf_GetVersionInfo関数の有効/無効スイッチ。 TRUE：有効 FALSE：無効 | true: Version information service enabled false: Version information service disabled
      string WdgIncludeFiles [1..*]: set at pre-compile, origin=QINeS  # include file lists. / インクルード対象のヘッダファイルリスト。

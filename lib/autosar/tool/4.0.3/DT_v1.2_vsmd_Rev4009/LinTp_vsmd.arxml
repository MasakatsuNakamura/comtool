AUTOSAR XML (schema 4-0-3)
package /QINeS
  ecuc definition collection AUTOSARParameterDefinition: module=LinTp
  module definition LinTp [0..1]: refined-module-def=LinTp, variants link-time/post-build/pre-compile  # Singleton descriptor for the LIN Transport Protocol. / LIN TPのコンフィグレーション。
    container LinTpGeneral  # Container that holds all LIN transport protocol general parameters. / LIN TPのジェネラルパラメータ。
      boolean LinTpVersionInfoApi: set at pre-compile  # Switches the LinTp_GetVersionInfo function ON or OFF. / TRUE：LinTp_GetVersionInfoを有効にする FALSE：LinTp_GetVersionInfoを無効にする
    container LinTpGlobalConfig: multiple-configuration-container=true  # This container contains the global configuration parameter of the LinTp. / LIN TPのグローバルコンフィグレーション。 | It is a MultipleConfigurationContainer, i.e. this container and its sub-containers exit once per configuration set.
      integer LinTpMaxNumberOfRespPendingFrames: 0..65535, set at link in variant link-time / post-build in variant post-build / pre-compile in variant pre-compile  # Configures the maximum number of allowed response pending frames. / 保留可能なフレームの最大数。
      integer LinTpNumberOfRxNSdu [0..0]: 0..65535, set at link in variant link-time / post-build in variant post-build / pre-compile in variant pre-compile  # Number of transport protocol messages that can be received for all channels this node is connected to. / ノードがつながっている任意のチャネルが受信するN-SDUの数。
      integer LinTpNumberOfTxNSdu [0..0]: 0..65535, set at link in variant link-time / post-build in variant post-build / pre-compile in variant pre-compile  # Number of transport protocol messages that can be transmitted for all channels this node is connected to. / ノードがつながっている任意のチャネルが送信するN-SDUの数。
      integer LinTpP2Max: 0..5000, set at link in variant link-time / post-build in variant post-build / pre-compile in variant pre-compile  # P2 Timeout when a response pending frame is expected in seconds. / 保留フレームに対するP2タイマのタイムアウト値。
      integer LinTpP2Timing: 0..5000, set at link in variant link-time / post-build in variant post-build / pre-compile in variant pre-compile  # Definition of the P2 timeout observation parameter in seconds. / P2タイマのタイムアウト値。
      container LinTpChannelConfig [0..*]  # This container contains the channel specific configuration parameter of LinTp. / LIN TPで使用するチャネルの設定。
        boolean LinTpDropNotRequestedNad: set at link in variant link-time / post-build in variant post-build / pre-compile in variant pre-compile, default-value=false  # Configures if TP Frames of not requested LIN-Slaves are dropped or not. / リクエストしたスレーブ以外のNADからのTPフレームを受信するかどうかを決定するフラグ。 TRUE：リクエストしていないスレーブからのフレームをドロップする FALSE：リクエストしていないスレーブからのフレームをドロップしない | false: Do drop TP Frames of Not requested LIN-Slaves true: Drop not TP Frames of Not requested LIN-Slaves
        boolean LinTpScheduleChangeDiag: set at link in variant link-time / post-build in variant post-build / pre-compile in variant pre-compile, default-value=true  # Enables or disables the call of BswM_LinTp_RequestMode() to diagnostic request/response schedule. / TPフレームの送受信完了時にBswMのサービスBswM_LinTp_RequestModeをコールして故障診断スケジュールの切替を行うかどうかを決定するフラグ。 TRUE：スケジュール切替を依頼する FALSE：スケジュール切替を依頼しない | false: BswM is not called true: BswM is called
      container LinTpRxNSdu [0..*]  # For each received N-SDU on any channel the node is connected to. / ノードがつながっている任意のチャネルが受信するN-SDUの情報。
        integer LinTpDl: 1..4095, set at link in variant link-time / post-build in variant post-build / pre-compile in variant pre-compile  # Data Length Code of this RxNsdu. In case of variable length message, this value indicates the minimum data length. / RxNSduのデータ長。 可変長のメッセージの場合、最小のデータサイズを設定してください。 | Range of minimum length is 1 to 4095. Note that this is not relevant for Tx. The reason for this is to have identical structures for Tx and Rx.
        integer LinTpNcr [0..1]: 0..1000, set at post-build in variant post-build / pre-compile in variant pre-compile  # Value in seconds of the N_Cr timeout. N_Cr is the time until reception of the next Consecutive Frame N_PDU. / N_Crタイマのタイムアウト値。
        integer LinTpRxNSduId: 0..255, set at link in variant link-time / post-build in variant post-build / pre-compile in variant pre-compile, symbolic-name-value=true  # The identifier of the Transport Protocol message. This ID will be the one that is communicated with upper layers. / TPメッセージID。 このIDは上位モジュールがLinTpに処理を依頼するときに使用される。
        integer LinTpRxNSduNad: 0..255, set at link in variant link-time / post-build in variant post-build / pre-compile in variant pre-compile  # A N-SDU transported on LIN is identified using the NAD for the specific slave. / スレーブのNAD。
        symbolic name reference LinTpRxNSduChannelRef: set at link in variant link-time / post-build in variant post-build / pre-compile in variant pre-compile, destination=LinIfChannel  # Index of the channel this N-SDU belongs to. / N-SDUが属するチャネルのインデックス。
        reference LinTpRxNSduPduRef: set at link in variant link-time / post-build in variant post-build / pre-compile in variant pre-compile, destination=Pdu  # Reference to the global PDU / PDUへの参照。
      container LinTpTxNSdu [0..*]  # For each transmitted N-SDU on any channel the node is connected to. / ノードがつながっている任意のチャネルが送信するN-SDUの情報。
        float LinTpNas: 0..1000, set at post-build in variant post-build / pre-compile in variant pre-compile  # Value in second of the N_As timeout. N_As is the time for transmission of a LIN frame (any N_PDU) on the part of the sender. / N_Asタイマのタイムアウト値。
        float LinTpNcs [0..1]: 0..1000, set at post-build in variant post-build / pre-compile in variant pre-compile  # Value in seconds of the performance requirement of N_Cs. N_Cs is the time which elapses between the transmit request of a CF N-PDU until the transmit request of the next CF N-PDU. / N_Csタイマのタイムアウト値。
        integer LinTpTxNSduId: 0..255, set at link in variant link-time / post-build in variant post-build / pre-compile in variant pre-compile, symbolic-name-value=true  # The identifier of the Transport Protocol message. This ID will be the one that is communicated with upper layers. / TPメッセージID。 このIDは上位モジュールがLinTpに処理を依頼するときに使用される。
        integer LinTpTxNSduNad: 0..255, set at link in variant link-time / post-build in variant post-build / pre-compile in variant pre-compile  # A N-SDU transported on LIN is identified using the NAD for the specific slave. / スレーブのNAD。
        symbolic name reference LinTpTxNSduChannelRef: set at link in variant link-time / post-build in variant post-build / pre-compile in variant pre-compile, destination=LinIfChannel  # Index of the channel this N-SDU belongs to. / N-SDUが属するチャネルのインデックス。
        reference LinTpTxNSduPduRef: set at link in variant link-time / post-build in variant post-build / pre-compile in variant pre-compile, destination=Pdu  # Reference to the global PDU / PDUへの参照。

AUTOSAR XML (schema 4-0-3)
package /QINeS
  ecuc definition collection AUTOSARParameterDefinition: module=Pwm
  module definition Pwm [0..*]: refined-module-def=Pwm, variants post-build/pre-compile  # Configuration of Pwm (Pulse Width Modulation) module. / Pwmモジュールのコンフィグレーション。
    container PwmChannelConfigSet: multiple-configuration-container=true  # Multiple Configuration Set Container / 多数のコンフィグレーションセットのコンテナ。
      container PwmChannel [1..*]  # Configuration of an individual PWM channel. / 個々のPWMチャネルのコンフィグレーション。
        enumeration PwmChannelClass [0..1]: {PWM_FIXED_PERIOD, PWM_FIXED_PERIOD_SHIFTED, PWM_VARIABLE_PERIOD}, set at post-build in variant post-build / pre-compile in variant pre-compile  # Class of PWM Channel. / PWMチャネルのクラス。 実装型：Pwm_ChannelClassType | ImplementationType: Pwm_ChannelClassType
        integer PwmChannelId: 0..4294967295, set at pre-compile, symbolic-name-value=true  # Channel Id of the PWM channel. This value will be assigned to the symbolic name derived of the PwmChannel container short name. / PWMチャネルのチャネルID。 この値は、PwmChannelコンテナのショートネームに由来するシンボリック名に割り当てられる。
        integer PwmDutycycleDefault: 0..32768, set at post-build in variant post-build / pre-compile in variant pre-compile  # Value of duty cycle used for Initialization / 初期設定に用いられるデューティ・サイクルの値。0は0％、0x8000は100％を表す。 | 0, represents 0% 0x8000 represents 100%
        enumeration PwmIdleState: {PWM_HIGH, PWM_LOW}, set at post-build in variant post-build / pre-compile in variant pre-compile  # The parameter PWM_IDLE_STATE represents the output state of the PWM after the signal is stopped (e.g. call of Pwm_SetOutputToIdle). / パラメータPWM_IDLE_STATEは、信号を停止した後（例：Pwm_SetOutputToIdleの呼び出し）の、PWMの出力状態を表す。
        function name PwmNotification [0..1]: set at post-build in variant post-build / pre-compile in variant pre-compile, default-value="NULL"  # Definition of the Callback function. / Callback関数の定義。
        float PwmPeriodDefault: 0..Inf, set at post-build in variant post-build / pre-compile in variant pre-compile  # Value of period used for Initialization.(in seconds). / 初期設定に使用する周期の値（秒）。
        enumeration PwmPolarity: {PWM_HIGH, PWM_LOW}, set at post-build in variant post-build / pre-compile in variant pre-compile  # Defines the starting polarity of each PWM channel. / 個々のPWMチャネルの開始極性を定義する。
    container PwmConfigurationOfOptApiServices  # API関数の有効/無効スイッチのコンテナ。
      boolean PwmDeInitApi: set at pre-compile  # Adds / removes the service Pwm_DeInit() from the code. / Pwm_DeInit関数の有効/無効スイッチ。
      boolean PwmGetOutputState: set at pre-compile  # Pwm_GetOutputState関数の有効/無効スイッチ。
      boolean PwmSetDutyCycle: set at pre-compile  # Pwm_SetDutyCycle関数の有効/無効スイッチ。
      boolean PwmSetOutputToIdle: set at pre-compile  # Pwm_SetOutputToIdle関数の有効/無効スイッチ。
      boolean PwmSetPeriodAndDuty: set at pre-compile  # Pwm_SetPeriodAndDuty関数の有効/無効スイッチ。
      boolean PwmVersionInfoApi: set at pre-compile  # Switch to indicate that the Pwm_ GetVersionInfo is supported / Pwm_GetVersionInfo関数の有効/無効スイッチ。
    container PwmGeneral  # Pwmドライバのコンフィグレーション（パラメータ）を含むコンテナ。
      boolean PwmDevErorDetect: set at pre-compile  # Switch for enabling the development error detection. / 開発エラーを検出可能にするためのスイッチ。
      boolean PwmDutycycleUpdatedEndperiod: set at pre-compile  # Switch for enabling the update of the duty cycle parameter at the end of the current period. / 現在の周期の最後にデューティ・サイクル・パラメータの更新を有効に切り替える。 TRUE：デューティ・サイクルの更新は、現在生成された波形の周期の最後(電流波形が終了した時）に行われる FALSE：デューティ・サイクルの更新は、直ちに（サービスコールの直後、電流波形が切断された時）行われる | TRUE: update of duty cycle is done at the end of period of currently generated waveform (current waveform is finished). FALSE: update of duty cycle is done immediately (just after service call, current waveform is cut).
      integer PwmIndex: 0..4294967295, set at pre-compile  # Specifies the InstanceId of this module instance. If only one instance is present it shall have the Id 0. / このモジュールのインスタンスのInstanceIDを指定する。 インスタンスが１つしかない場合には、ID=0を持たなければならない。
      boolean PwmNotificationSupported: set at pre-compile  # Switch to indicate that the notifications are supported / 通知がサポートされていることを示すように切り替える。
      boolean PwmPeriodUpdatedEndperiod: set at pre-compile  # Switch for enabling the update of the period parameter at the end of the current period. / 現在の周期の終了時に、周期パラメータの更新を有効に切り替える。 TRUE：周期/デューティ・サイクルの更新は、現在生成された波形の周期の最後に行われる（電流波形が終了した時） FALSE：周期/デューティ・サイクルの更新が（サービスコールの直後、電流波形が切断された時）、直ちに行われる | TRUE: update of period/duty cycle is done at the end of period of currently generated waveform (current waveform is finished). FALSE: update of period/duty cycle is done immediately (just after service call, current waveform is cut).

AUTOSAR XML (schema 4-1-1)
package /QINeS
  ecuc definition collection AUTOSARParameterDefinition: module=Callout
  module definition Callout [0..1]: refined-module-def=EcuM, variants post-build  # Callout Configuration module / Calloutモジュールのコンフィグレーション。
    container EcuMCallout [0..1]: multiple-configuration-container=true  # EcuM Callout Configuration Container
      container EcuMCalloutStubs [0..1]  # EcuM_Callout_Stubs Configuration Container
        function name EcuMOnGoSleep [0..65535]: set at post-build, origin=QINeS  # This call allows the system designer to notify that the GO SLEEP state is about to be entered.
        function name EcuMOnGoOffOne [0..65535]: set at post-build, origin=QINeS  # This call allows the system designer to notify that the GO OFF I state is about to be entered.
        function name EcuMOnGoOffTwo [0..65535]: set at post-build, origin=QINeS  # This call allows the system designer to notify that the GO OFF II state is about to be entered.
      container EcuMCalloutStubsSys [0..1]  # EcuM_Callout_StubsSys Configuration Container
        function name EcuMALDriverInit0 [0..65535]: set at post-build, origin=QINeS  # This callout shall provide driver initialization and other hardware-related startup activities for loading the post-build configuration data. Beware: Here only pre-compile and link-time configurable modules may be used.
        function name EcuMALDriverInit1 [0..65535]: set at post-build, origin=QINeS  # This callout shall provide driver initialization and other hardware-related startup activities in case of a power on reset.
        function name EcuMALDriverInit2 [0..65535]: set at post-build, origin=QINeS  # This callout shall provide driver initialization of drivers which need OS and do not need to wait for the NvM_ReadAll job to finish.
        function name EcuMALDriverInit3 [0..65535]: set at post-build, origin=QINeS  # This callout shall provide driver initialization of drivers which need OS and need to wait for the NvM_ReadAll job to finish.
        function name EcuMALDriverRestart [0..65535]: set at post-build, origin=QINeS  # This callout shall provide driver initialization and other hardware-related startup activities in the wakeup case.
        string EcuMDeterminePbConfiguration [0..65535]: set at post-build, origin=QINeS  # Initialize EcuM_Config.pAdcConfig
        function name EcuMQDeInitForBsws [0..65535]: set at post-build, origin=QINeS  # carry out the stop of the BSW module which BswM should manage when do not use BswM.
      container EcuMGeneratedTypes [0..1]  # EcuM_Generated_Types Configuration Container
        string IncludeHeaders [0..65535]: set at post-build, origin=QINeS  # input a header file name.
        container EcuMConfigType [0..65535]  # EcuM_ConfigType Struct
          string BswModuleName: set at post-build, origin=QINeS  # input a BSW module name.
          string ConfigurationStructName: set at post-build, origin=QINeS  # input a configration struct name.

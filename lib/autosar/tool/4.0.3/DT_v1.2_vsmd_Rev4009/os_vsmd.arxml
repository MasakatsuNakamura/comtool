AUTOSAR XML (schema 4-1-1)
package /QINeS
  ecuc definition collection AUTOSARParameterDefinition: module=Os
  module definition Os [0..1]: refined-module-def=Os, variants pre-compile  # Configuration of the Os (Operating System) module. / Osモジュールのコンフィグレーション。
    container OsAlarm [0..*]  # An OsAlarm may be used to asynchronously inform or activate a specific task. It is possible to start alarms automatically at system start-up depending on the application mode. / アラーム起動するイベント、タスクの設定。アラーム自動起動に関するコンテナ。
      reference OsAlarmAccessingApplication [1..*]: set at pre-compile, destination=OsApplication  # Reference to applications which have an access to this object. / アラームにアクセス可能なOSアプリケーション。
      reference OsAlarmCounterRef: set at pre-compile, destination=OsCounter  # Reference to the assigned counter for that alarm / アラームに割り当てられたカウンタ。
      choice container OsAlarmAction  # This container defines which type of notification is used when the alarm expires. / アラーム満了時に実行させるアクション。
        container OsAlarmActivateTask [0..1]  # This container specifies the parameters to activate a task. / アラーム満了時にタスクを起動する設定。
          reference OsAlarmActivateTaskRef: set at pre-compile, destination=OsTask  # Reference to the task that will be activated by that alarm action / アラーム満了時に起動されるタスクを設定。
        container OsAlarmCallback [0..1]  # This container specifies the parameters to call a callback OS alarm action. / アラーム満了時にCallback関数を呼び出す設定。
          function name OsAlarmCallbackName: set at pre-compile  # Name of the function that is called when this alarm callback is triggered. / アラーム満了時にCallbackで呼び出される関数名。
        container OsAlarmIncrementCounter [0..1]  # This container specifies the parameters to increment a counter. / アラーム満了時にカウンタをインクリメントする設定。
          reference OsAlarmIncrementCounterRef: scope=ECU, set at pre-compile, destination=OsCounter  # Reference to the counter that will be incremented by that alarm action / アラーム満了時にインクリメントされるカウンタを設定。
        container OsAlarmSetEvent [0..1]  # This container specifies the parameters to set an event / アラーム満了時にイベントをセットする設定。
          reference OsAlarmSetEventRef: set at pre-compile, destination=OsEvent  # Reference to the event that will be set by that alarm action / アラーム満了時にセットされるイベントを設定。
          reference OsAlarmSetEventTaskRef: set at pre-compile, destination=OsTask  # Reference to the task that will be activated by that event / イベントにより起動するタスクを設定。
      container OsAlarmAutostart [0..1]  # If present this container defines if an alarm is started automatically at system start-up depending on the application mode. / アプリケーションモードによりシステム起動時にアラームが自動起動するかの定義。
        integer OsAlarmAlarmTime: 0..4294967295, set at pre-compile  # The relative or absolute tick value when the alarm expires for the first time. Note that for an alarm which is RELATIVE the value must be at bigger than 0. / アラーム自動起動時の初回満了時のティック値。OsAlarmAutostartTypeがRELATIVEの場合は0であってはならない。 MAX=4294967295 MIN=0
        enumeration OsAlarmAutostartType: {ABSOLUTE, RELATIVE}, set at pre-compile  # This specifies the type of autostart for the alarm.. / アラームの動作種別。 ABSOLUTE：絶対アラームとして自動起動する RELATIVE：相対アラームとして自動起動する
        integer OsAlarmCycleTime: 0..4294967295, set at pre-compile  # Cycle time of a cyclic alarm in ticks. If the value is 0 than the alarm is not cyclic. / アラーム自動起動時の繰り返し実行周期。0の場合は単発起動のみで周期起動しない。 MAX=4294967295 MIN=0
        reference OsAlarmAppModeRef [1..*]: set at pre-compile, destination=OsAppMode  # Reference to the application modes for which the AUTOSTART shall be performed / 自動起動するアプリケーションモード。
    container OsAppMode [1..*]  # OsAppMode is the object used to define OSEK OS properties for an OSEK OS application mode. / アプリケーションモードコンテナ。 | No standard attributes are defined for AppMode. In a CPU, at least one AppMode object has to be defined. [source: OSEK OIL Spec. 2.5] An OsAppMode called OSDEFAULTAPPMODE must always be there for OSEK compatilbility.
      integer OsAppModeId: 0..31, set at pre-compile, origin=QINeS, symbolic-name-value=true  # - / アプリケーションモードIDをビット指定で入力。 MAX=31 MIN=0
    container OsApplication [1..31]  # An AUTOSAR OS must be capable of supporting a collection of OS objects (tasks, interrupts, alarms, hooks etc.) that form a cohesive functional unit. This collection of objects is termed an OS-Application. / OSオブジェクト(タスク、割り込み、アラーム、フックなど)の集合であるOSアプリケーションに関するコンテナ。 | All objects which belong to the same OS-Application have access to each other. Access means to allow to use these objects within API services. Access by other applications can be granted separately.
      integer OsApplicationCoreAssignment [0..0]: 0..65534, set at pre-compile  # ID of the core onto which the OsApplication is bound. Tags: atp.Status=obsolete, atp.StatusComment=This parameter is replaced by the OsApplicationCoreRef., atp.StatusRevisionBegin=4.1.1 / OSアプリケーションを割付けるコアID。 MAX=65534 MIN=0 | Please note that this attribute is deprecated and replaced by the OsApplicationCoreRef. This element is obsolete and will be removed in a future revision.
      integer OsAppQRamStackSize [0..*]: 0..4294967295, set at pre-compile, origin=QINeS  # - / OSアプリケーション用RAM領域のサイズを指定する
      boolean OsTrusted: scope=ECU, set at pre-compile, default-value=false  # Parameter to specify if an OS-Application is trusted or not. / OSアプリケーションの信頼・非信頼設定。 TRUE：信頼OSアプリケーション FALSE：非信頼OSアプリケーション | true: OS-Application is trusted false: OS-Application is not trusted (default)
      reference OsAppAlarmRef [0..*]: scope=ECU, set at pre-compile, destination=OsAlarm  # Specifies the OsAlarms that belong to the OsApplication. / OSアプリケーションに所属するアラーム。
      reference OsAppCounterRef [0..*]: scope=ECU, set at pre-compile, destination=OsCounter  # References the OsCounters that belong to the OsApplication. / OSアプリケーションに所属するカウンタ。
      reference OsAppEcucPartitionRef [0..1]: set at pre-compile, destination=EcucPartition  # Denotes which "EcucPartition" is implemented by this "OSApplication". / OSアプリケーションに対応するEcucパーティション。
      reference OsAppIsrRef [0..*]: scope=ECU, set at pre-compile, destination=OsIsr  # references which OsIsrs belong to the OsApplication / OSアプリケーションに所属するISR。
      reference OsAppScheduleTableRef [0..*]: scope=ECU, set at pre-compile, destination=OsScheduleTable  # References the OsScheduleTables that belong to the OsApplication. / OSアプリケーションに所属するスケジュールテーブル。
      reference OsAppTaskRef [0..*]: scope=ECU, set at pre-compile, destination=OsTask  # references which OsTasks belong to the OsApplication / OSアプリケーションに所属するタスク。
      reference OsRestartTask [0..1]: scope=ECU, set at pre-compile, destination=OsTask  # Optionally one task of an OS-Application may be defined as Restart Task. / OSアプリケーション再起動時に起動するタスク。 参照先となる OsTask のtaskid ( OsTaskAttr[]のindex ) が設定される。 | Multiplicity = 1: Restart Task is activated by the Operating System if the protection hook requests it. Multiplicity = 0: No task is automatically started after a protection error happened.
      symbolic name reference OsApplicationCoreRef [0..1]: set at pre-compile, destination=EcucCoreDefinition  # Reference to the Core Definition in the Ecuc Module where the CoreId is defined. This reference is used to describe to which Core the OsApplication is bound. / コアIDが定義されているEcucモジュールでのコアの定義。
      container OsApplicationHooks  # Container to structure the OS-Application-specific hooks / OSアプリケーション固有のフック定義のコンテナ。
        boolean OsAppErrorHook: scope=ECU, set at pre-compile  # Select the OS-Application error hook. / OSアプリケーション固有のエラーフック呼出し有無。 TRUE：呼出し有 FALSE：呼出し無 | true: Hook is called false: Hook is not called
        boolean OsAppShutdownHook: scope=ECU, set at pre-compile  # Select the OS-Application specific shutdown hook for the OS-Application. / OSアプリケーション固有のシャットダウンフック呼出し有無。 TRUE：呼出し有 FALSE：呼出し無 | true: Hook is called false: Hook is not called
        boolean OsAppStartupHook: scope=ECU, set at pre-compile  # Select the OS-Application specific startup hook for the OS-Application. / OSアプリケーション固有のスタートアップフック呼出し有無。 TRUE：呼出し有 FALSE：呼出し無 | true: Hook is called false: Hook is not called
      container OsApplicationTrustedFunction [0..*]  # Container to structure the configration parameters of trusted functions / OSアプリケーション信頼関数定義に関するコンテナ。
        function name OsTrustedFunctionName: scope=ECU, set at pre-compile  # Trusted function (as part of a trusted OS-Application) available to other OS-Applications. This also supersedes the OSEK OIL attribute TRUSTED in APPLICATION because the optionality of this parameter is describing that already. / 他のOSアプリケーションが使用可能な信頼関数名。
      container OsAppQRamStackTable [0..1]  # -
        container OsAppQRamStack [0..4]  # -
          integer OsAppQRamStackStart [0..1]: 0..4294967295, set at pre-compile, origin=QINeS
          integer OsAppQRamStackStop [0..1]: 0..4294967295, set at pre-compile, origin=QINeS
      container OsAppQRomStackTable [0..1]  # -
        container OsAppQRomStack [0..1]  # -
          integer OsAppQRomStackStart [0..1]: 0..4294967295, set at pre-compile, origin=QINeS
          integer OsAppQRomStackStop [0..1]: 0..4294967295, set at pre-compile, origin=QINeS
    container OsCounter [1..*]  # Configuration information for the counters that belong to the OsApplication. / OSアプリケーションに所属するカウンタに関するコンテナ。
      integer OsCounterMaxAllowedValue: 1..4294967295, set at pre-compile  # Maximum possible allowed value of the system counter in ticks. / カウンタのティック最大可能許容値。 MAX=4294967295 MIN=1
      integer OsCounterMinCycle: 1..4294967295, set at pre-compile  # The MINCYCLE attribute specifies the minimum allowed number of counter ticks for a cyclic alarm linked to the counter. / 接続されたアラームがカウンタに指定できる最小周期値。 MAX=4294967295 MIN=1
      boolean OsCounterQinesSystemCounter: scope=ECU, set at pre-compile, origin=QINeS, default-value=false  # システムカウンタフラグ。TRUEの場合、このOsCounterがシステムカウンタとなる。
      integer OsCounterTicksPerBase: 1..4294967295, set at pre-compile  # The TICKSPERBASE attribute specifies the number of ticks required to reach a counterspecific unit. The interpretation is implementation-specific. / カウンタを1進めるのに必要なティック数(TICKSPERBASE)。 MAX=4294967295 MIN=1
      enumeration OsCounterType: {HARDWARE, SOFTWARE}, scope=ECU, set at pre-compile  # This parameter contains the natural type or unit of the counter. / カウンタのタイプ。 HARDWARE：ハードウェアカウンタ SOFTWARE：ソフトウェアカウンタ
      float OsSecondsPerTick [0..1]: 0..Inf, scope=ECU, set at pre-compile  # Time of one counter tick in seconds. / 1ティック当たりの実時間。 MAX=Inf MIN=0
      reference OsCounterAccessingApplication [0..*]: set at pre-compile, destination=OsApplication  # Reference to applications which have an access to this object. / カウンタにアクセス可能なOSアプリケーション。
      reference OsCounterQinesCcTimerId: set at pre-compile, origin=QINeS, destination=OsIsr  # ISR ID / ISR ID。 MAX=65535 MIN=0
      container OsDriver [0..1]  # This Container contains the information who will drive the counter. / GPTに関するコンテナ。OsCounterTypeがハードウェアカウンタの場合に使用できる。コンテナを使用する場合はOSのタイマを管理するGPTインタフェースを使用することができる。 | This configuration is only valid if the counter has OsCounterType set to HARDWARE. If the container does not exist (multiplicity=0) the timer is managed by the OS internally (OSINTERNAL). If the container exists the OS can use the GPT interface to manage the timer. The user have to supply the GPT channel. If the counter is driven by some other (external to the OS) source (like a TPU for example) this must be described as a vendor specific extension.
        reference OsGptChannelRef [0..1]: scope=ECU, set at pre-compile, destination=GptChannelConfiguration  # Reference to the GPT channel. / GPTチャネルへの参照。
      container OsTimeConstant [0..*]  # Allows the user to define constants which can be e.g. used to compare time values with timer tick values. / 時間とティックの比較に関するコンテナ。 | A time value will be converted to a timer tick value during generation and can later on accessed via the OsConstName. The conversation is done by rounding time values to the nearest fitting tick value.
        float OsTimeValue: 0..Inf, scope=ECU, set at pre-compile  # This parameter contains the value of the constant in seconds. / 1秒あたりのティック値。 MAX=Inf MIN=0
    container OsEvent [0..*]  # Representation of OS events in the configuration context. Adopted from the OSEK OIL specification. / イベント関連のコンテナ。
      integer OsEventMask [0..1]: 0..31, set at pre-compile  # If event mask would be set to AUTO in OIL, this parameter should be omitted here. / イベントマスクをビット指定で入力。 MAX=31 MIN=0
    container OsIoc [0..1]  # Configuration of the IOC (Inter OS Application Communicator). / IOC関連のコンテナ。
      container OsIocCommunication [0..*]  # Representation of a 1:1 or N:1 or N:M (unqueued only) communication between software parts located in different OS-Applications that are bound to the same or to different cores. / 同じまたは異なるコアに配置されたOSアプリケーション間の通信の設定。 | The name shall begin with the name of the sending software service and be followed by a unique identifier delivered by the sending software service. In the case of RTE as user attention shall be paid on the fact that uniqueness for identifier names has to be reached over ports, data elements, object instances and maybe additional identification properties (E.g. Case 1:N mapping to 1:1). Example: - <NameSpace>_UniqueID
        integer OsIocBufferLength: 0..4294967295, set at pre-compile  # This attribute defines the size of the IOC internal queue to be allocated for a queued communication. / IOCのキューサイズ。 MAX=4294967295 MIN=0 | This configuration information shall allow the optimization of the needed memory for communications requiring buffers within the RTE and within the IOC.
        container OsIocDataProperties  # Data properties of the data to be transferred on the IOC communication channel. / IOCの通信チャネル上で転送するための定義。
          integer OsIocDataPropertyIndex [0..1]: 0..255, set at pre-compile  # This parameter is used to define in which order the data is send, e.g. whether IocSendGroup(A,B) or IocSendGroup(B,A) shall be used. / IOC用システムサービスの引数の順序。 MAX=255 MIN=0
          string OsIocInitValue [0..1]: set at pre-compile  # Initial Value for the data to be transferred on the IOC communication channel. / IOCの通信チャネルで転送されるデータの初期値。
          foreign reference OsIocDataTypeRef: set at pre-compile, destination-type=IMPLEMENTATION-DATA-TYPE  # This is the type of the data to be transferred on the IOC communication channel. This attribute is necessary to generate the parameter type of the Ioc functions. Additionally this information should be used to compute the data size for necessary data copy operations within the Ioc module. / IOCの通信チャネルで転送されるデータの型。 | If more than one attribute is defined, the IOC generator should generate an IocXxxGroup function (Xxx= CHOICE [Send, Receive, Write, Read]). N:1 or N:M communication (Multiplicity of OsIocSenderProperties > 1) is only allowed for multiplicity of OsIocDataTypeRef = 1
        container OsIocReceiverProperties  # Representation of receiver properties for one communication. For each OsIocCommunication one (1:1) or many receivers (N:M) have to be defined. This container should be instanciated within an OsIocCommunication. / OSアプリケーション間の通信の受信設定。本コンテナが1つ定義された場合は1:1、2つ以上定義された場合N:M通信となる。
          enumeration OsIocFunctionImplementationKind [0..1]: {DO_NOT_CARE, FUNCTION, MACRO}, set at pre-compile, default-value=DO_NOT_CARE  # This parameter is used to select whether this communication is implemented as a macro or as a function. / IOC用システムサービスの実装方法。 FUNCTION：関数 MACRO：マクロ DO_NOT_CARE：指定しない
          function name OsIocReceiverPullCB [0..1]: set at pre-compile  # This attribute defines the name of a callback function that the IOC shall call on the receiving core for each data reception. / IOCの受信をCallback関数で実現する場合の関数名。 | In case of non existence of this attribute no ReceiverPullCB notification shall be applied by the IOC. The name of the function shall begin with the name of the receiving module, followed with a callback name and followed by the IocId. Example: void RTE_ReceiverPullCB_RTE25 (void). If this attribute does not exist, it means that no ReceiverPullCB shall be called (No notification from IOC is required). If this attribute exists the IOC shall call the callback function on the receiving core.
          reference OsIocReceivingOsApplicationRef: set at pre-compile, destination=OsApplication  # This attribute is a reference to the receiving OsApplication instance defined in the configuration file of the OS. / IOCの受信を行うOSアプリケーション。 | This information allows for the generator to get additional information necessary for the code generation like: * The protection properties of the communicating OsApplications to find out which protections have to be crossed * The core identifiers to find out if an intra or an inter core communication has to be realized * Interrupt details in case of cross core notification to realize over IRQs
        container OsIocSenderProperties [1..31]  # Representation of sender properties for one communication. For each OsIocCommunication one (1:1) or many senders (N:1 or N:M) have to be defined. Multiplicity > 1 (N:1 or N:M communication) is only allowed for Multiplicity of OsIocDataTypeRef = 1. / OSアプリケーション間の通信の送信設定。本コンテナが1つ定義された場合は1:1、2つ以上定義された場合N:1またはN:M通信となる。 | This container should be instanciated within an OsIocCommunication.
          enumeration OsIocFunctionImplementationKind [0..1]: {DO_NOT_CARE, FUNCTION, MACRO}, set at pre-compile, default-value=DO_NOT_CARE  # This parameter is used to select whether this communication is implemented as a macro or as a function. / IOC用システムサービスの実装方法。 FUNCTION：関数 MACRO：マクロ DO_NOT_CARE：指定しない
          integer OsIocSenderId [0..1]: 0..255, scope=ECU, set at pre-compile  # Representation of a sender in a N:1 or N:M communication to distinguish between senders. / N:1またはN:M通信で区別するためのセンダID。 MAX=255 MIN=0 | This parameter does not exist in 1:1 communication.
          reference OsIocSendingOsApplicationRef: set at pre-compile, destination=OsApplication  # This attribute is a reference to the sending OS-Application instance defined in the configuration file of the OS. / IOCの送信を行うOSアプリケーション。 | This information shall allows the generator to get additional information necessary for the code generation like: * The protection properties of the communicating OS-Applications to find out which protection boundaries have to be crossed. * The core identifiers to find out if an intra or an inter core communication has to be realized * Interrupt details in case of cross core notification to realize over IRQs
    container OsIsr [1..*]  # The OsIsr container represents an OSEK interrupt service routine. / 割り込みサービスルーチンに関するコンテナ。
      enumeration OsIsrCategory: {CATEGORY_2, TIMER}, set at pre-compile  # This attribute specifies the category of this ISR. / ISRのカテゴリ。 CATEGORY_1：C1ISR CATEGORY_2：C2ISR (非信頼OSアプリケーションに属するISR) TIMER：タイマ割り込み（ハードウェアカウンタを駆動する周期割り込み）
      function name OsIsrQinesHandlerFunction [0..1]: set at pre-compile, origin=QINeS, max-length=32, min-length=1  # 割り込み関数名。 OsIsrCategoryがTIMER以外の時に使用。 Osのコンテナ名と同名にしないこと。
      function name OsIsrQinesIcAckFunction [0..1]: set at pre-compile, origin=QINeS  # ack関数。 ユーザモードで動作するISRが起動されたときに特権モードで呼び出される関数を登録することができる。割り込み要求元へのack処理を記述できる。
      enumeration OsIsrQinesInterruptFactor: {INTSSCIR0_CLR3, INTSSCIR0_CLR4, INTSSCIR0_CLR5, INTSSCIR0_CLR6, INTSSCIR0_CLR7, INTSSCIR0_CLR8, INTSSCIR0_CLR9, INTSSCIR0_CLR10, INTSSCIR0_CLR11, INTSSCIR0_CLR12, INTSSCIR0_CLR13, INTSSCIR0_CLR14, INTSSCIR0_CLR15, INTSSCIR0_CLR16, INTSSCIR0_CLR17, INTSSCIR0_CLR18, INTSSCIR0_CLR19, INTSSCIR0_CLR20, INTSSCIR0_CLR21, INTSSCIR0_CLR22, INTSSCIR0_CLR23, INTSWT_0_IR_TIF, INTSWT_1_IR_TIF, INTSWT_2_IR_TIF, INTSTM_0_CIR0_CIF, INTSTM_0_CIR1_CIF, INTSTM_0_CIR2_CIF, INTSTM_0_CIR3_CIF, INTSTM_1_CIR0_CIF, INTSTM_1_CIR1_CIF, INTSTM_1_CIR2_CIF, INTSTM_1_CIR3_CIF, INTSTM_2_CIR0_CIF, INTSTM_2_CIR1_CIF, INTSTM_2_CIR2_CIF, INTSTM_2_CIR3_CIF, INTeDMA_Channel_Error_Flags_63_0, INTDMA_INTL_INT0, INTDMA_INTL_INT1, INTDMA_INTL_INT2, INTDMA_INTL_INT3, INTDMA_INTL_INT4, INTDMA_INTL_INT5, INTDMA_INTL_INT6, INTDMA_INTL_INT7, INTDMA_INTL_INT8, INTDMA_INTL_INT9, INTDMA_INTL_INT10, INTDMA_INTL_INT11, INTDMA_INTL_INT12, INTDMA_INTL_INT13, INTDMA_INTL_INT14, INTDMA_INTL_INT15, INTDMA_INTL_INT16, INTDMA_INTL_INT17, INTDMA_INTL_INT18, INTDMA_INTL_INT19, INTDMA_INTL_INT20, INTDMA_INTL_INT21, INTDMA_INTL_INT22, INTDMA_INTL_INT23, INTDMA_INTL_INT24, INTDMA_INTL_INT25, INTDMA_INTL_INT26, INTDMA_INTL_INT27, INTDMA_INTL_INT28, INTDMA_INTL_INT29, INTDMA_INTL_INT30, INTDMA_INTL_INT31, INTIRQ_0_MCR_DONE, INTESW_0, INTESW_1, INTESW_2, INTESW_3, INTENET_0, INTENET_1, INTENET_2, INTENET_3, INTENET_4, INTENET_5, INTENET_6, INTENET_7, INTENET_8, INTENET_0, INTENET_1, INTENET_2, INTENET_3, INTENET_4, INTENET_5, INTENET_6, INTENET_7, INTENET_8, INTRTC, INTAPI, INTPIT_1_TFLG0_TIF, INTPIT_1_TFLG1_TIF, INTPIT_1_TFLG2_TIF, INTPIT_1_TFLG3_TIF, INTPIT_1_TFLG4_TIF, INTPIT_1_TFLG5_TIF, INTPIT_1_TFLG6_TIF, INTPIT_1_TFLG7_TIF, INTPIT_1_TFLG8_TIF, INTPIT_1_TFLG9_TIF, INTPIT_1_TFLG10_TIF, INTPIT_1_TFLG11_TIF, INTPIT_1_TFLG12_TIF, INTPIT_1_TFLG13_TIF, INTPIT_1_TFLG14_TIF, INTPIT_1_TFLG15_TIF, INTPIT_RTI, INTEIRQ_0_7_SIUL_Combined_External_Interrupt, INTEIRQ_8_15_SIUL_Combined_External_Interrupt, INTEIRQ_16_23_SIUL_Combined_External_Interrupt, INTEIRQ_24_31_SIUL_Combined_External_Interrupt, INTo_interrupt, INTME_IS_I_SAFE, INTME_IS_I_MTC, INTME_IS_I_IMODE, INTME_IS_I_ICONF, INTMC_RGM_Functional_and_destructive_reset_alternate_event_interrupt, INTFXOSC_Counter, INTSXOSC_Counter, INTDSPI_0_SR_TFUF_DSPI_0_SR_RFOF_DSPI_0_SR_TFIWF, INTDSPI_0_SR_EOQF, INTDSPI_0_SR_TFFF, INTDSPI_0_SR_TCF, INTDSPI_0_SR_RFDF, INTDSPI_0_SR_SPITCF_DSPI_0_SR_CMD_TCF, INTDSPI_0_SR_DSITCF_DSPI_0_SR_CMDFFF, INTDSPI_0_SR_SPEF_DSPI_0_SR_DPEF, INTDSPI_0_SR_DDIF, INTDSPI_1_SR_TFUF_DSPI_1_SR_RFOF_DSPI_1_SR_TFIWF, INTDSPI_1_SR_EOQF, INTDSPI_1_SR_TFFF, INTDSPI_1_SR_TCF, INTDSPI_1_SR_RFDF, INTDSPI_1_SR_SPITCF_DSPI_1_SR_CMD_TCF, INTDSPI_1_SR_DSITCF_DSPI_1_SR_CMDFFF, INTDSPI_1_SR_SPEF_DSPI_1_SR_DPEF, INTDSPI_1_SR_DDIF, INTDSPI_2_SR_TFUF_DSPI_2_SR_RFOF_DSPI_2_SR_TFIWF, INTDSPI_2_SR_EOQF, INTDSPI_2_SR_TFFF, INTDSPI_2_SR_TCF, INTDSPI_2_SR_RFDF, INTDSPI_2_SR_SPITCF_DSPI_2_SR_CMD_TCF, INTDSPI_2_SR_DSITCF_DSPI_2_SR_CMDFFF, INTDSPI_2_SR_SPEF_DSPI_2_SR_DPEF, INTDSPI_2_SR_DDIF, INTDSPI_3_SR_TFUF_DSPI_3_SR_RFOF_DSPI_3_SR_TFIWF, INTDSPI_3_SR_EOQF, INTDSPI_3_SR_TFFF, INTDSPI_3_SR_TCF, INTDSPI_3_SR_RFDF, INTDSPI_3_SR_SPITCF_DSPI_3_SR_CMD_TCF, INTDSPI_3_SR_DSITCF_DSPI_3_SR_CMDFFF, INTDSPI_3_SR_SPEF_DSPI_3_SR_DPEF, INTDSPI_3_SR_DDIF, INTDSPI_4_SR_TFUF_DSPI_4_SR_RFOF_DSPI_4_SR_TFIWF, INTDSPI_4_SR_EOQF, INTDSPI_4_SR_TFFF, INTDSPI_4_SR_TCF, INTDSPI_4_SR_RFDF, INTDSPI_4_SR_CMD_TCF, INTDSPI_4_SR_CMDFFF, INTDSPI_4_SR_SPEF, INTDSPI_5_SR_TFUF_DSPI_5_SR_RFOF_DSPI_5_SR_TFIWF, INTDSPI_5_SR_EOQF, INTDSPI_5_SR_TFFF, INTDSPI_5_SR_TCF, INTDSPI_5_SR_RFDF, INTDSPI_5_SR_CMD_TCF, INTDSPI_5_SR_CMDFFF, INTDSPI_5_SR_SPEF, INTDSPI_6_SR_TFUF_DSPI_6_SR_RFOF_DSPI_6_SR_TFIWF, INTDSPI_6_SR_EOQF, INTDSPI_6_SR_TFFF, INTDSPI_6_SR_TCF, INTDSPI_6_SR_RFDF, INTDSPI_6_SR_SPITCF_DSPI_6_SR_CMD_TCF, INTDSPI_6_SR_DSITCF_DSPI_6_SR_CMDFFF, INTDSPI_6_SR_SPEF_DSPI_6_SR_DPEF, INTDSPI_7_SR_TFUF_DSPI_7_SR_RFOF_DSPI_7_SR_TFIWF, INTDSPI_7_SR_EOQF, INTDSPI_7_SR_TFFF, INTDSPI_7_SR_TCF, INTDSPI_7_SR_RFDF, INTDSPI7_5_Reserved, INTDSPI7_6_Reserved, INTDSPI_7_SR_SPEF, INTDSPI_8_SR_TFUF_DSPI_8_SR_RFOF_DSPI_8_SR_TFIWF, INTDSPI_8_SR_EOQF, INTDSPI_8_SR_TFFF, INTDSPI_8_SR_TCF, INTDSPI_8_SR_RFDF, INTDSPI8_5_Reserved, INTDSPI8_6_Reserved, INTDSPI_8_SR_SPEF, INTDSPI_9_SR_TFUF_DSPI_9_SR_RFOF_DSPI_9_SR_TFIWF, INTDSPI_9_SR_EOQF, INTDSPI_9_SR_TFFF, INTDSPI_9_SR_TCF, INTDSPI_9_SR_RFDF, INTDSPI9_5_Reserved, INTDSPI9_6_Reserved, INTDSPI_9_SR_SPEF, INTLIST0_LAST_LIST1_LAST, INTNDATA0_NDATA1_DATA_OVR0_DATA_OVR1_Trigger, INTLinFlex_0_RXI, INTLinFlex_0_TXI, INTLinFlex_0_ERR, INTLinFlex_1_RXI, INTLinFlex_1_TXI, INTLinFlex_1_ERR, INTLinFlex_2_RXI, INTLinFlex_2_TXI, INTLinFlex_2_ERR, INTLinFlex_3_RXI, INTLinFlex_3_TXI, INTLinFlex_3_ERR, INTLinFlex_4_RXI, INTLinFlex_4_TXI, INTLinFlex_4_ERR, INTLinFlex_5_RXI, INTLinFlex_5_TXI, INTLinFlex_5_ERR, INTLinFlex_6_RXI, INTLinFlex_6_TXI, INTLinFlex_6_ERR, INTLinFlex_7_RXI, INTLinFlex_7_TXI, INTLinFlex_7_ERR, INTLinFlex_8_RXI, INTLinFlex_8_TXI, INTLinFlex_8_ERR, INTLinFlex_9_RXI, INTLinFlex_9_TXI, INTLinFlex_9_ERR, INTLinFlex_10_RXI, INTLinFlex_10_TXI, INTLinFlex_10_ERR, INTLinFlex_11_RXI, INTLinFlex_11_TXI, INTLinFlex_11_ERR, INTLinFlex_12_RXI, INTLinFlex_12_TXI, INTLinFlex_12_ERR, INTLinFlex_13_RXI, INTLinFlex_13_TXI, INTLinFlex_13_ERR, INTLinFlex_14_RXI, INTLinFlex_14_TXI, INTLinFlex_14_ERR, INTLinFlex_15_RXI, INTLinFlex_15_TXI, INTLinFlex_15_ERR, INTLinFlex_16_RXI, INTLinFlex_16_TXI, INTLinFlex_16_ERR, INTLinFlex_17_RXI, INTLinFlex_17_TXI, INTLinFlex_17_ERR, INTI2C0_SR_IBAL_I2C0_SR_TCF_I2C0_SR_IAAS, INTI2C1_SR_IBAL_I2C1_SR_TCF_I2C1_SR_IAAS, INTI2C2_SR_IBAL_I2C2_SR_TCF_I2C2_SR_IAAS, INTI2C3_SR_IBAL_I2C3_SR_TCF_I2C3_SR_IAAS, INTLRNEIF_DRNEIF, INTLRCEIF_DRCEIF, INTFAFAIF, INTFAFBIF, INTWUPIF, INTPRIF, INTCHIF, INTTBIF, INTRBIF, INTMIF, INTLoss_of_lock_interrupt_request_for_PLL, INTInterrupt_request_ALARM_state_, INTInterrupt_request_miscellaneous_conditions_, INTEOUT_interrupt, INTHSM2HTIE_0, INTHSM2HTIE_1, INTHSM2HTIE_2, INTHSM2HTIE_3, INTHSM2HTIE_4, INTHSM2HTIE_5, INTHSM2HTIE_6, INTHSM2HTIE_7, INTHSM2HTIE_8, INTHSM2HTIE_9, INTHSM2HTIE_10, INTHSM2HTIE_11, INTHSM2HTIE_12, INTHSM2HTIE_13, INTHSM2HTIE_14, INTHSM2HTIE_15, INTHSM2HTIE_16, INTHSM2HTIE_17, INTHSM2HTIE_18, INTHSM2HTIE_19, INTHSM2HTIE_20, INTHSM2HTIE_21, INTHSM2HTIE_22, INTHSM2HTIE_23, INTHSM2HTIE_24, INTHSM2HTIE_25, INTHSM2HTIE_26, INTHSM2HTIE_27, INTHSM2HTIE_28, INTHSM2HTIE_29, INTHSM2HTIE_30, INTHSM2HTIE_31, INTADC_0_EOC, INTADC_0_ER, INTADC_0_WD, INTADC_1_EOC, INTADC_1_ER, INTADC_1_WD, INTCMP0, INTCMP1, INTCMP2, INTFlexCAN0_PN, INTFLEXCAN_0_ESR_ERR_INT_FLEXCAN_0_FD_ERROR, INTFLEXCAN_0_ESR_BOFF_FLEXCAN_0_ESR_BOFF_DONE_FLEXCAN_0_Transmit_Warning_FLEXCAN_0_Receive_Warning, INTFlexCAN0_BUF_00_03, INTFlexCAN0_BUF_04_07, INTFlexCAN0_BUF_08_11, INTFlexCAN0_BUF_12_15, INTFlexCAN0_BUF_16_31, INTFlexCAN0_BUF_32_63, INTFlexCAN0_BUF_64_95, INTFLEXCAN_1_ESR_ERR_INT_FLEXCAN_1_FD_ERROR, INTFLEXCAN_1_ESR_BOFF_FLEXCAN_1_ESR_BOFF_DONE_FLEXCAN_1_Transmit_Warning_FLEXCAN_1_Receive_Warning, INTFlexCAN1_BUF_00_03, INTFlexCAN1_BUF_04_07, INTFlexCAN1_BUF_08_11, INTFlexCAN1_BUF_12_15, INTFlexCAN1_BUF_16_31, INTFlexCAN1_BUF_32_63, INTFlexCAN1_BUF_64_95, INTFLEXCAN_2_ESR_ERR_INT_FLEXCAN_2_FD_ERROR, INTFLEXCAN_2_ESR_BOFF_FLEXCAN_2_ESR_BOFF_DONE_FLEXCAN_2_Transmit_Warning_FLEXCAN_2_Receive_Warning, INTFlexCAN2_BUF_00_03, INTFlexCAN2_BUF_04_07, INTFlexCAN2_BUF_08_11, INTFlexCAN2_BUF_12_15, INTFlexCAN2_BUF_16_31, INTFlexCAN2_BUF_32_63, INTFlexCAN2_BUF_64_95, INTFLEXCAN_3_ESR_ERR_INT_FLEXCAN_3_FD_ERROR, INTFLEXCAN_3_ESR_BOFF_FLEXCAN_3_ESR_BOFF_DONE_FLEXCAN_3_Transmit_Warning_FLEXCAN_3_Receive_Warning, INTFlexCAN3_BUF_00_03, INTFlexCAN3_BUF_04_07, INTFlexCAN3_BUF_08_11, INTFlexCAN3_BUF_12_15, INTFlexCAN3_BUF_16_31, INTFlexCAN3_BUF_32_63, INTFlexCAN3_BUF_64_95, INTFLEXCAN_4_ESR_ERR_INT_FLEXCAN_4_FD_ERROR, INTFLEXCAN_4_ESR_BOFF_FLEXCAN_4_ESR_BOFF_DONE_FLEXCAN_4_Transmit_Warning_FLEXCAN_4_Receive_Warning, INTFlexCAN4_BUF_00_03, INTFlexCAN4_BUF_04_07, INTFlexCAN4_BUF_08_11, INTFlexCAN4_BUF_12_15, INTFlexCAN4_BUF_16_31, INTFlexCAN4_BUF_32_63, INTFlexCAN4_BUF_64_95, INTFLEXCAN_5_ESR_ERR_INT_FLEXCAN_5_FD_ERROR, INTFLEXCAN_5_ESR_BOFF_FLEXCAN_5_ESR_BOFF_DONE_FLEXCAN_5_Transmit_Warning_FLEXCAN_5_Receive_Warning, INTFlexCAN5_BUF_00_03, INTFlexCAN5_BUF_04_07, INTFlexCAN5BUF_08_11, INTFlexCAN5_BUF_12_15, INTFlexCAN5_BUF_16_31, INTFlexCAN5_BUF_32_63, INTFlexCAN5_BUF_64_95, INTFLEXCAN_6_ESR_ERR_INT_FLEXCAN_6_FD_ERROR, INTFLEXCAN_6_ESR_BOFF_FLEXCAN_6_ESR_BOFF_DONE_FLEXCAN_6_Transmit_Warning_FLEXCAN_6_Receive_Warning, INTFlexCAN6_BUF_00_03, INTFlexCAN6_BUF_04_07, INTFlexCAN6_BUF_08_11, INTFlexCAN6_BUF_12_15, INTFlexCAN6_BUF_16_31, INTFlexCAN6_BUF_32_63, INTFlexCAN6_BUF_64_95, INTFLEXCAN_7_ESR_ERR_INT_FLEXCAN_7_FD_ERROR, INTFLEXCAN_7_ESR_BOFF_FLEXCAN_7_ESR_BOFF_DONE_FLEXCAN_7_Transmit_Warning_FLEXCAN_7_Receive_Warning, INTFlexCAN7_BUF_00_03, INTFlexCAN7_BUF_04_07, INTFlexCAN7_BUF_08_11, INTFlexCAN7_BUF_12_15, INTFlexCAN7_BUF_16_31, INTFlexCAN7_BUF_32_63, INTFlexCAN7_BUF_64_95, INTWKPU_IRQ_0, INTWKPU_IRQ_1, INTWKPU_IRQ_2, INTWKPU_IRQ_3, INTSDHC0, INTOTG, INTSPH, INTMLB_block_interrupt, INTMLB_Channel_Interrupts_0_15_Combined, INTSAI0_TX_FIFO_IRQ, INTSAI0_RX_FIFO_IRQ, INTSAI1_TX_FIFO_IRQ, INTSAI1_RX_FIFO_IRQ, INTSAI2_TX_FIFO_IRQ, INTSAI2_RX_FIFO_IRQ, INTJDC, INTCorrectable_errors_in_LPU_mode, INTEMIOS_GFR_F0_F1, INTEMIOS_GFR_F2_F3, INTEMIOS_GFR_F4_F5, INTEMIOS_GFR_F6_F7, INTEMIOS_GFR_F8_F9, INTEMIOS_GFR_F10_F11, INTEMIOS_GFR_F12_F13, INTEMIOS_GFR_F14_F15, INTEMIOS_GFR_F16_F17, INTEMIOS_GFR_F18_F19, INTEMIOS_GFR_F20_F21, INTEMIOS_GFR_F22_F23, INTEMIOS_GFR_F24_F25, INTEMIOS_GFR_F26_F27, INTEMIOS_GFR_F28_F29, INTEMIOS_GFR_F30_F31, INTEMIOS_GFR_F32_F33, INTEMIOS_GFR_F34_F35, INTEMIOS_GFR_F36_F37, INTEMIOS_GFR_F38_F39, INTEMIOS_GFR_F40_F41, INTEMIOS_GFR_F42_F43, INTEMIOS_GFR_F44_F45, INTEMIOS_GFR_F46_F47, INTEMIOS_GFR_F48_F49, INTEMIOS_GFR_F50_F51, INTEMIOS_GFR_F52_F53, INTEMIOS_GFR_F54_F55, INTEMIOS_GFR_F56_F57, INTEMIOS_GFR_F58_F59, INTEMIOS_GFR_F60_F61, INTEMIOS_GFR_F62_F63, INTEMIOS_GFR_F64_F65, INTEMIOS_GFR_F66_F67, INTEMIOS_GFR_F68_F69, INTEMIOS_GFR_F70_F71, INTEMIOS_GFR_F72_F73, INTEMIOS_GFR_F74_F75, INTEMIOS_GFR_F76_F77, INTEMIOS_GFR_F78_F79, INTEMIOS_GFR_F80_F81, INTEMIOS_GFR_F82_F83, INTEMIOS_GFR_F84_F85, INTEMIOS_GFR_F86_F87, INTEMIOS_GFR_F88_F89, INTEMIOS_GFR_F90_F91, INTEMIOS_GFR_F92_F93, INTEMIOS_GFR_F94_F95}, set at pre-compile, origin=QINeS  # 割り込み要因。 この番号の割り込みが発生すると、本ISRが呼び出される。
      enumeration OsIsrQinesPriority: {1, 2, 3, 4, 5, 6, 7, 8, 9, 10, 11, 12, 13, 14}, set at pre-compile, origin=QINeS  # 割り込み優先度。 大きな数字が、高い優先度を表す。 優先度は、ISRの種類により次の関係がある。 C1 ISRの優先度 > タイマの優先度 >＝ C2 ISRの優先度
      reference OsIsrResourceRef [0..*]: set at pre-compile, destination=OsResource  # This reference defines the resources accessed by this ISR. / ISRが獲得するリソース。
      container OsIsrTimingProtection [0..1]  # This container contains all parameters which are related to timing protection / ISRオブジェクトのタイミング保護に関するコンテナ。 | If the container exists, the timing protection is used for this interrupt. If the container does not exist, the interrupt is not supervised regarding timing violations.
        float OsIsrAllInterruptLockBudget [0..1]: 0..Inf, scope=ECU, set at pre-compile  # This parameter contains the maximum time for which the ISR is allowed to lock all interrupts (via SuspendAllInterrupts() or DisableAllInterrupts()) (in seconds). / ISRが(SuspendAllInterrupts()またはDisableAllInterrupts()を使用して)全割り込みをロック可能な最大時間。 MAX=Inf MIN=0
        float OsIsrExecutionBudget [0..1]: 0..Inf, scope=ECU, set at pre-compile  # The parameter contains the maximum allowed execution time of the interrupt (in seconds). / C2ISRの割り込み処理が可能な最大時間。 MAX=Inf MIN=0
        float OsIsrOsInterruptLockBudget [0..1]: 0..Inf, scope=ECU, set at pre-compile  # This parameter contains the maximum time for which the ISR is allowed to lock all Category 2 interrupts (via SuspendOSInterrupts()) (in seconds). / ISRが(SuspendOSInterrupts()を使用して)C2ISRの割り込みをロック可能な最大時間。 MAX=Inf MIN=0
        float OsIsrTimeFrame [0..1]: 0..Inf, scope=ECU, set at pre-compile  # This parameter contains the minimum inter-arrival time between successive interrupts (in seconds). / 連続した割り込みの最小呼出し時間。 MAX=Inf MIN=0
        container OsIsrResourceLock [0..*]  # This container contains a list of times the interrupt uses resources. / ISRのリソース確保時間に関するコンテナ。
          float OsIsrResourceLockBudget: 0..Inf, scope=ECU, set at pre-compile  # This parameter contains the maximum time the interrupt is allowed to hold the given resource (in seconds). / 割り込み処理が指定されたリソースを確保できる最大時間。 MAX=Inf MIN=0
          reference OsIsrResourceLockResourceRef: scope=ECU, set at pre-compile, destination=OsResource  # Reference to the resource the locking time is depending on / リソース確保時間を監視するためのリソース。
    container OsOS  # OS is the object used to define OSEK OS properties for an OSEK application. / OSEK OSのプロパティを定義するためのコンテナ。 | Per CPU exactly one OS object has to be defined.
      integer OsOSQinesHookStackSize [0..*]: 0..131072, set at pre-compile, origin=QINeS  # - / フックスタック領域のサイズを指定する。
      integer OsOSQinesIsrStackSize [1..*]: 0..4294967295, set at pre-compile, origin=QINeS  # - / 割り込みスタック領域のサイズを指定する。
      integer OsNumberOfCores [0..1]: 1..65535, set at pre-compile  # Maximum number of cores that are controlled by the OS. / 本OSを起動するコア数の最大値。 MAX=65535 MIN=1 | The OS uses the value internally. It depends on the ECU HW.
      boolean OsOSQinesDebuggingHook [0..1]: scope=ECU, set at pre-compile, origin=QINeS  # - / デバッグ用のPreTaskHook、PostTaskHookの有効/無効。 TRUE：有効 FALSE：無効
      integer OsOSQinesMaxRamAddr [0..0]: 1..18446744073709551615, set at pre-compile, origin=QINeS  # - / RamのRangeの最大値。SC1で使用する。 MAX=18446744073709551615 MIN=1
      integer OsOSQinesMinRamAddr [0..0]: 1..18446744073709551615, set at pre-compile, origin=QINeS  # - / RamのRangeの最小値。SC1で使用する。 MAX=18446744073709551615 MIN=1
      integer OsOSQinesSystemStackSize: 0..4294967295, set at pre-compile, origin=QINeS  # - / システムスタックサイズを指定する。SC１で使用する。 MAX=18446744073709551615 MIN=1
      enumeration OsScalabilityClass: {SC3}, scope=ECU, set at pre-compile, default-value=SC3, default-value=SC3  # A scalability class for each System Object "OS" has to be selected. In order to customize the operating system to the needs of the user and to take full advantage of the processor features the operating system can be scaled according to the scalability classes. / スケーラビリティクラス。 SC1、SC2、SC3、SC4 | If the scalability class is omitted this translates to the OIL AUTO mechanism.
      boolean OsStackMonitoring: scope=ECU, set at pre-compile  # Select stack monitoring of Tasks/Category 2 ISRs / タスク/C2ISRのスタックモニタリングの使用有無。 TRUE：スタックモニタリングを使用する FALSE：スタックモニタリングを使用しない | true: Stacks are monitored false: Stacks are not monitored
      enumeration OsStatus: {EXTENDED}, set at pre-compile, default-value=EXTENDED  # The Status attribute specifies whether a system with standard or extended status has to be used. Automatic assigment is not supported for this attribute. / エラーコード種別の指定。 STANDARD：標準エラーのみ検出 EXTENDED：標準エラーと拡張エラーを検出
      boolean OsUseGetServiceId: set at pre-compile  # As defined by OSEK / OSErrorGetServiceId()の使用有無。 TRUE：使用する FALSE：使用しない
      boolean OsUseParameterAccess: set at pre-compile  # As defined by OSEK / エラーが発生したシステムサービスの引数取得の使用有無。 TRUE：使用する FALSE：使用しない
      boolean OsUseResScheduler [0..0]: set at pre-compile, default-value=true  # The OsUseResScheduler attribute defines whether the resource RES_SCHEDULER is used within the application. / スケジューラリソース(RES_SCHEDULER)の使用有無。 TRUE：使用する FALSE：使用しない
      reference OsDefaultAppMode: set at pre-compile, origin=QINeS, destination=OsAppMode  # Reference to appmodes which have an access to this object. / このオブジェクトにアクセス可能なアプリケーションモード。
      container OsHooks  # Container to structure all hooks belonging to the OS / OSに属する全てのフックに関するコンテナ。
        boolean OsErrorHook: set at pre-compile  # Error hook as defined by OSEK / エラーフックの呼び出し有無。 TRUE：呼び出し有 FALSE：呼び出し無 | true: Hook is called false: Hook is not called
        boolean OsPostTaskHook: set at pre-compile  # Post-task hook as defined by OSEK / ポストタスクフックの呼び出し有無。 TRUE：呼び出し有 FALSE：呼び出し無 | true: Hook is called false: Hook is not called
        boolean OsPreTaskHook: set at pre-compile  # Pre-task hook as defined by OSEK / プレタスクフックの呼び出し有無。 TRUE：呼び出し有 FALSE：呼び出し無 | true: Hook is called false: Hook is not called
        boolean OsProtectionHook: scope=ECU, set at pre-compile  # Switch to enable/disable the call to the (user supplied) protection hook. / プロテクションフックの呼び出し有無。 TRUE：呼び出し有 FALSE：呼び出し無 | true: Protection hook is called on protection error false: Protection hook is not called
        boolean OsShutdownHook: set at pre-compile  # Shutdown hook as defined by OSEK / シャットダウンフックの呼び出し有無。 TRUE：呼び出し有 FALSE：呼び出し無 | true: Hook is called false: Hook is not called
        boolean OsStartupHook: set at pre-compile  # Startup hook as defined by OSEK / スタートアップフックの呼び出し有無。 TRUE：呼び出し有 FALSE：呼び出し無 | true: Hook is called false: Hook is not called
      container OsRamMapQines [0..1]  # - / Ramに関するコンテナ。
        container OsRamMapRegionQines [1..5]  # - / Ramリージョンに関するコンテナ。
          integer OsOSQinesRamMcTop: 0..4294967295, set at pre-compile, origin=QINeS  # - / Ram領域の先頭アドレス。 MAX=4294967295 MIN=0
          integer OsOSQinesRamMcBottom: 0..4294967295, set at pre-compile, origin=QINeS  # - / Ram領域の終端アドレス。 MAX=4294967295 MIN=0
      container OsRomMapQines [0..1]  # - / Romに関するコンテナ。
        container OsRomMapRegionQines [1..5]  # - / Romリージョンに関するコンテナ。
          integer OsOSQinesRomMcTop: 0..4294967295, set at pre-compile, origin=QINeS  # - / Rom領域の先頭アドレス。 MAX=4294967295 MIN=0
          integer OsOSQinesRomMcBottom: 0..4294967295, set at pre-compile, origin=QINeS  # - / Rom領域の終端アドレス。 MAX=4294967295 MIN=0
    container OsResource [0..*]  # An OsResource object is used to co-ordinate the concurrent access by tasks and ISRs to a shared resource, e.g. the scheduler, any program sequence, memory or any hardware area. / タスクとISRの同時アクセスを調整するリソースに関するコンテナ。
      enumeration OsResourceProperty: {INTERNAL, LINKED, STANDARD}, set at pre-compile  # This specifies the type of the resource. / リソースの種類。 STANDARD：標準リソース INTERNAL：内部リソース LINKED：リンクドリソース
      reference OsResourceAccessingApplication [0..0]: set at pre-compile, destination=OsApplication  # Reference to applications which have an access to this object. / 本リソースにアクセス可能なOSアプリケーション。
      reference OsResourceLinkedResourceRef [0..1]: set at pre-compile, destination=OsResource  # The link to the resource. Must be valid if OsResourceProperty is LINKED. If OsResourceProperty is not LINKED the value is ignored. / リンクドリソースにおけるリンク先リソース。
    container OsScheduleTable [0..*]  # An OsScheduleTable addresses the synchronization issue by providing an encapsulation of a statically defined set of alarms that cannot be modified at runtime. / スケジュールテーブルに関するコンテナ。
      integer OsScheduleTableDuration: 1..4294967295, set at pre-compile  # This parameter defines the modulus of the schedule table (in ticks). / スケジュールテーブルの周期(ティック数)。 MAX=4294967295 MIN=1
      integer OsScheduleTableQinesNumEntry: 1..4294967295, set at pre-compile, origin=QINeS  # - / 満了点の数。 MAX=4294967295 MIN=0
      boolean OsScheduleTableRepeating: scope=ECU, set at pre-compile  # true: first expiry point on the schedule table shall be processed at final expiry point delay ticks after the final expiry point is processed. / スケジュールテーブルの繰り返し指定。 TRUE：周期動作 FALSE：単発動作 | false: the schedule table processing stops when the final expiry point is processed.
      reference OsSchTblAccessingApplication [0..*]: set at pre-compile, destination=OsApplication  # Reference to applications which have an access to this object. / スケジュールテーブルにアクセス可能なOSアプリケーション。
      reference OsScheduleTableCounterRef: scope=ECU, set at pre-compile, destination=OsCounter  # This parameter contains a reference to the counter which drives the schedule table. / スケジュールテーブルを駆動するカウンタ。
      container OsScheduleTableAutostart [0..1]  # This container specifies if and how the schedule table is started on startup of the Operating System. The options to start a schedule table correspond to the API calls to start schedule tables during runtime. / OS起動時のスケジュールテーブル自動起動に関するコンテナ。
        enumeration OsScheduleTableAutostartType: {ABSOLUTE, RELATIVE}, set at pre-compile  # This specifies the type of the autostart for the schedule table. / スケジュールテーブルの自動起動種別。 ABSOLUTE：ティックの絶対値で自動起動する RELATIVE：ティックの相対値で自動起動する SYNCHRON：同期待ち状態で自動起動する
        integer OsScheduleTableStartValue [0..1]: 0..4294967295, scope=ECU, set at pre-compile  # Absolute autostart tick value when the schedule table starts. Only used if the OsScheduleTableAutostartType is ABSOLUTE. / OsScheduleTableAutostartTypeがABSOLUTEの場合自動起動されるスケジュールテーブルに設定するティックとの絶対値、OsScheduleTableAutostartTypeがRELATIVEの場合は相対値。 ・ABSOLUTEの場合 MAX=OsCounterMaxAllowedValue MIN=0 ・RELATIVEの場合 MAX=OsCounterMaxAllowedValue - 最初の満了点 MIN=1 | Relative offset in ticks when the schedule table starts. Only used if the OsScheduleTableAutostartType is RELATIVE.
        reference OsScheduleTableAppModeRef [1..*]: scope=ECU, set at pre-compile, destination=OsAppMode  # Reference in which application modes the schedule table should be started during startup / 自動起動するアプリケーションモード。
      container OsScheduleTableExpiryPoint [1..*]  # The point on a Schedule Table at which the OS activates tasks and/or sets events / スケジュール満了点の設定に関するコンテナ。
        integer OsScheduleTblExpPointQinesNumAction: 0..4294967295, set at pre-compile, origin=QINeS  # - / スケジュール満了時のアクションの数。 MAX=4294967295 MIN=0
        integer OsScheduleTblExpPointOffset: 0..4294967295, set at pre-compile  # The offset from zero (in ticks) at which the expiry point is to be processed. / 0から満了点までのオフセット値。 MAX=4294967295 MIN=0
        container OsScheduleTableEventSetting [0..*]  # Event that is triggered by that schedule table. / スケジュールテーブル満了点セットするイベントの設定に関するコンテナ。
          reference OsScheduleTableSetEventRef: set at pre-compile, destination=OsEvent  # Reference to event that will be set by action / 満了点アクションでセットするイベント。
          reference OsScheduleTableSetEventTaskRef: set at pre-compile, destination=OsTask  # - / 満了点アクションでイベントをセットするタスク。
        container OsScheduleTableTaskActivation [0..*]  # Task that is triggered by that schedule table. / スケジュールテーブル満了点で起動するタスクの設定に関するコンテナ。
          reference OsScheduleTableActivateTaskRef: scope=ECU, set at pre-compile, destination=OsTask  # Reference to task that will be activated by action / 満了点アクションで起動するするタスク。
        container OsScheduleTblAdjustableExpPoint [0..1]  # Adjustable expiry point / スケジュールテーブル満了点同期設定に関するコンテナ。
          integer OsScheduleTableMaxLengthen: 0..18446744073709551615, set at pre-compile  # The maximum positive adjustment that can be made to the expiry point offset (in ticks). / 「同期補正による満了点間の最大遅延可能値(ティック値)」 MAX=18446744073709551615 MIN=0
          integer OsScheduleTableMaxShorten: 0..18446744073709551615, set at pre-compile  # The maximum negative adjustment that can be made to the expiry point offset (in ticks). / 同期補正による満了点間の最大短縮可能値(ティック値) MAX=18446744073709551615 MIN=0
      container OsScheduleTableSync [0..1]  # This container specifies the synchronization parameters of the schedule table. / スケジュールテーブル同期設定に関するコンテナ。
        integer OsScheduleTblExplicitPrecision [0..1]: 0..18446744073709551615, scope=ECU, set at pre-compile  # This configuration is only valid if the explicit synchronisation is used. / スケジュールテーブルを同期状態とみなす最大差分。 MAX=18446744073709551615 MIN=0
        enumeration OsScheduleTblSyncStrategy: {EXPLICIT, IMPLICIT, NONE}, scope=ECU, set at pre-compile, origin=AUTOSAR ECUC, default-value=NONE  # AUTOSAR OS provides support for synchronisation in two ways: explicit and implicit. / スケジュールテーブルの同期方式。 EXPLICIT：明示的同期 IMPLICIT：暗黙的同期 NONE：同期なし
    container OsSpinlock [0..*]  # An OsSpinlock object is used to co-ordinate concurrent access by TASKs/ISR2s on different cores to a shared resource. / 異なるコア間でタスク/C2ISRの同期アクセスを調整するためのスピンロックに関するコンテナ。
      enumeration OsSpinlockLockMethod: {LOCK_ALL_INTERRUPTS, LOCK_CAT2_INTERRUPTS, LOCK_NOTHING, LOCK_WITH_RES_SCHEDULER}, set at pre-compile, default-value=LOCK_NOTHING  # Lock method which is used when a spinlock is taken. Note that it is possible that a user (e.g. a Task) might hold more than one spinlock. In this case the last lock taken is forced to use at least a lock methode which locks as strong as the current one. / スピンロック種別。 LOCK_NOTHING：標準スピンロック LOCK_ALL_INTERRUPTS：全割り込み禁止スピンロック LOCK_CAT2_INTERRUPTS：OS割り込み禁止スピンロック LOCK_WITH_RES_SCHEDULER：タスクとの排他のみ行うスピンロック
      reference OsSpinlockAccessingApplication [1..*]: set at pre-compile, destination=OsApplication  # Reference to OsApplications that have an access to this object. / スピンロックにアクセス可能なOSアプリケーション。
      reference OsSpinlockSuccessor [0..1]: set at pre-compile, destination=OsSpinlock  # Reference to OsApplications that have an access to this object. / ネストして獲得可能なスピンロック指定。 | To check whether a spinlock can be occupied (in a nested way) without any danger of deadlock, a linked list of spinlocks can be defined. A spinlock can only be occupied in the order of the linked list. It is allowed to skip a spinlock. If no linked list is specified, spinlocks cannot be nested.
    container OsStackQines [1..*]  # - / OsTaskが使用するスタック領域を定義する。
      integer OsStackQinesSize: 0..4294967295, set at pre-compile, origin=QINeS  # - / OsTaskが使用するスタック領域のサイズを指定する。 MAX=18446744073709551615 MIN=0
    container OsTask [1..*]  # This container represents an OSEK task. / タスク設定に関するコンテナ。
      integer OsTaskActivation: 1..255, set at pre-compile  # This attribute defines the maximum number of queued activation requests for the task. A value equal to "1" means that at any time only a single activation is permitted for this task. Note that the value must be a natural number starting at 1. / タスクの最大起動回数。1から始まる自然数であること。対象タスクが拡張タスクの場合は1を設定すること。 MAX=255 MIN=1
      integer OsTaskPriority: 0..255, set at pre-compile  # The priority of a task is defined by the value of this attribute. This value has to be understood as a relative value, i.e. the values show only the relative ordering of the tasks. / タスクの優先度。 MAX=255 MIN=0 | OSEK OS defines the lowest priority as zero (0); larger values correspond to higher priorities.
      function name OsTaskQinesEntryFunction: set at pre-compile, origin=QINeS, max-length=32, min-length=1  # タスクの開始関数名。
      enumeration OsTaskSchedule: {FULL, NON}, set at pre-compile  # The OsTaskSchedule attribute defines the preemptability of the task. / タスクのスケジューリングポリシ。 FULL：フルプリエンプティブスケジューリング NON：ノンプリエンティブスケジューリング | If this attribute is set to NON, no internal resources may be assigned to this task.
      reference OsTaskAccessingApplication [0..*]: set at pre-compile, destination=OsApplication  # Reference to applications which have an access to this object. / タスクにアクセス可能なOSアプリケーション。
      reference OsTaskEventRef [0..*]: set at pre-compile, destination=OsEvent  # This reference defines the list of events the extended task may react on. / 拡張タスクを動作させるイベント。
      reference OsTaskQinesOsStackAssignment: set at pre-compile, origin=QINeS, destination=OsStackQines  # - / タスクに割り当てられたスタック領域。
      reference OsTaskResourceRef [0..*]: set at pre-compile, destination=OsResource  # This reference defines a list of resources accessed by this task. / タスクが獲得するリソース。
      container OsTaskAutostart [0..1]  # This container determines whether the task is activated during the system start-up procedure or not for some specific application modes. / タスクオブジェクトの自動起動指定に関するコンテナ。 | If the task shall be activated during the system start-up, this container is present and holds the references to the application modes in which the task is auto-started.
        reference OsTaskAppModeRef [1..*]: set at pre-compile, destination=OsAppMode  # Reference to application modes in which that task is activated on startup of the OS / タスクを自動起動するアプリケーションモード。
      container OsTaskTimingProtection [0..1]  # This container contains all parameters regarding timing protection of the task. / タスクのタイミング保護に関するコンテナ。
        float OsTaskAllInterruptLockBudget [0..1]: 0..Inf, scope=ECU, set at pre-compile  # This parameter contains the maximum time for which the task is allowed to lock all interrupts (via SuspendAllInterrupts() or DisableAllInterrupts()) (in seconds). / タスクの全割り込み禁止時間上限(秒単位)。 MAX=Inf MIN=0
        float OsTaskExecutionBudget [0..1]: 0..Inf, scope=ECU, set at pre-compile  # This parameter contains the maximum allowed execution time of the task (in seconds). / タスクの実行時間上限(秒単位)。 MAX=Inf MIN=0
        float OsTaskOsInterruptLockBudget [0..1]: 0..Inf, scope=ECU, set at pre-compile  # This parameter contains the maximum time for which the task is allowed to lock all Category 2 interrupts (via SuspendOSInterrupts()) (in seconds). / タスクのC2ISR割り込み禁止時間上限(秒単位)。 MAX=Inf MIN=0
        float OsTaskTimeFrame [0..1]: 0..Inf, scope=ECU, set at pre-compile  # The minimum inter-arrival time between activations and/or releases of a task (in seconds). / タスクの起動間隔最小時間(秒単位)。 MAX=Inf MIN=0
        container OsTaskResourceLock [0..*]  # This container contains the worst case time between getting and releasing a given resource (in seconds). / タスクのリソース確保時間監視に関するコンテナ。
          float OsTaskResourceLockBudget: 0..Inf, scope=ECU, set at pre-compile  # This parameter contains the maximum time the task is allowed to lock the resource (in seconds) / タスクのリソース確保時間上限(秒単位)。 MAX=Inf MIN=0
          reference OsTaskResourceLockResourceRef: scope=ECU, set at pre-compile, destination=OsResource  # Reference to the resource used by the task / リソース確保時間を監視するリソース。

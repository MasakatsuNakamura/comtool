AUTOSAR XML (schema 4-0-3)
package /QINeS
  ecuc definition collection AUTOSARParameterDefinition: module=Fee
  module definition Fee [0..1]: refined-module-def=Fee, variants pre-compile  # Configuration of the Fee (Flash EEPROM Emulation) module. / Feeモジュールのコンフィグレーション。
    container FeeBlockConfiguration [1..65536]  # Configuration of block specific parameters for the Flash EEPROM Emulation module. / 論理ブロック情報のアドレス。 Feeモジュールのための論理ブロック特有パラメータのコンフィグレーションを設定する。
      integer FeeBlockNumber: 1..65534, set at pre-compile, symbolic-name-value=true, default-value=8  # Block identifier (handle). / 論理ブロックの識別子を定義する。 | 0x0000 and 0xFFFF shall not be used for block numbers (see FEE006). Range: min = 2^NVM_DATASET_SELECTION_BITS max = 0xFFFF -2^NVM_DATASET_SELECTION_BITS Note: Depending on the number of bits set aside for dataset selection several other block numbers shall also be left out to ease implementation.
      integer FeeBlockSize: 1..4294967295, set at pre-compile, default-value=1024  # Size of a logical block in bytes. / 論理ブロックサイズを定義する。 単位はバイトで指定する。
      boolean FeeImmediateData: set at pre-compile, default-value=false  # Marker for high priority data. / 即時ライト用の論理ブロックかを判定する。 TRUE：即時ライト FALSE：即時ライトではない | true: Block contains immediate data. false: Block does not contain immediate data.
      integer FeeNumberOfWriteCycles: 1..4294967295, set at pre-compile, default-value=1  # Number of write cycles required for this block. / 論理ブロックに必要なライト回数を定義する。 ※未サポート。1を設定する。
      symbolic name reference FeeDeviceIndex: set at pre-compile, destination=FlsGeneral  # Device index (handle). / フラッシュドライバ（Fls)のデバイスインデックスを指定する。 | Range: 0 .. 254 (0xFF reserved for broadcast call to GetStatus function).
    container FeeGeneral  # Container for general parameters. These parameters are not specific to a block. / Feeモジュールのジェネラルコンフィグレーションパラメータを設定する。
      boolean FeeDevErrorDetect: set at pre-compile, default-value=true  # Pre-processor switch to enable and disable development error detection. / 開発時エラー検出の有効/無効スイッチ。 TRUE：開発時エラー検出有効 FALSE：開発時エラー検出無効 | true: Development error detection enabled. false: Development error detection disabled.
      integer FeeIndex: 0..254, set at pre-compile, default-value=0  # Specifies the InstanceId of this module instance. If only one instance is present it shall have the Id 0. / モジュールのインスタンスIDを指定する。 AUTOSARに廃止項目と明記されているため、0を設定する。
      function name FeeNvmJobEndNotification: set at pre-compile, default-value=NvM_JobEndNotification  # Mapped to the job end notification routine provided by the upper layer module (NvM_JobEndNotification). / NvMのNvM_JobEndNotificationを呼び出す。
      function name FeeNvmJobErrorNotification: set at pre-compile, default-value=NvM_JobErrorNotification  # Mapped to the job error notification routine provided by the upper layer module (NvM_JobErrorNotification). / NvM_JobErrorNotificationを呼び出す。
      boolean FeePollingMode: set at pre-compile, default-value=true  # Pre-processor switch to enable and disable the polling mode for this module. / ポーリングモードの有効／無効スイッチ。 TRUE：ポーリングモード有効 FALSE：ポーリングモード無効 | true: Polling mode enabled, callback functions (provided to FLS module) disabled. false: Polling mode disabled, callback functions (provided to FLS module) enabled.
      boolean FeeSetModeSupported: set at pre-compile, default-value=true  # Compiler switch to enable/disable the 'SetMode' functionality of the FEE module. / Fee_SetMode関数の有効／無効スイッチ。 TRUE：モード設定有効 FALSE：モード設定無効 | TRUE: SetMode functionality supported / code present, FALSE: SetMode functionality not supported / code not present. Note: This configuration setting has to be consistent with that of all underlying flash device drivers (configuration parameter FlsSetModeApi).
      boolean FeeVersionInfoApi: set at pre-compile, default-value=true  # Pre-processor switch to enable / disable the API to read out the modules version information. / バージョン情報取得関数（Fee_GetVersionInfo）の有効／無効スイッチ。 TRUE：バージョン情報取得関数有効 FALSE：バージョン情報取得関数無効 | true: Version info API enabled. false: Version info API disabled.
      integer FeeVirtualPageSize: 0..65535, set at pre-compile, default-value=0  # The size in bytes to which logical blocks shall be aligned. / 論理ブロックにライトするサイズを設定する。 ※未サポート。0を設定する。
      integer FEE_Q_NUM_OF_FEE_BLOCK_CONFIGURATION: 1..65536, set at pre-compile, origin=QINeS, default-value=8  # - / FeeBlockConfigurationコンテナの要素数を設定する。
      integer FEE_Q_NUM_OF_FEE_DEVICES [0..0]: 1..65535, set at pre-compile, origin=QINeS, default-value=1  # - / 未使用
      boolean FEE_Q_PUBLISHEDINFORMATIONTYPE_ENABLED: set at pre-compile, origin=QINeS, default-value=true  # - / FeePublishedInformationコンテナを生成する。 TRUE：生成する FALSE：生成しない
    container FeePublishedInformation [0..1]  # Additional published parameters not covered by CommonPublishedInformation container. / CommonPublishedInformationコンテナでカバーされない追加一般パラメータ。 | Note that these parameters do not have any configuration class setting, since they are published information.
      integer FeeBlockOverhead: 0..65535, set at published-information, default-value=0  # Management overhead per logical block in bytes. / ブロックオーバーヘッド。※未サポート。0を設定する。 | Note: If the management overhead depends on the block size or block location a formula has to be provided that allows the configurator to calculate the management overhead correctly.
      float FeeMaximumBlockingTime: 0..4294967295, set at published-information, default-value=0  # The maximum time the FEE module's API routines shall be blocked (delayed) by internal operations. / 内部処理によりブロック（遅延）されるFEEモジュールのAPIルーチンの最大回数。※未サポート。0を設定する。 | Note: Internal operations in that case means operations that are not explicitly invoked from the upper layer module but need to be handled for proper operation of this module or the underlying memory driver.
      integer FeePageOverhead: 0..65535, set at published-information, default-value=0  # Management overhead per page in bytes. / ページのオーバーヘッド。※未サポート。0を設定する。 | Note: If the management overhead depends on the block size or block location a formula has to be provided that allows the configurator to calculate the management overhead correctly.

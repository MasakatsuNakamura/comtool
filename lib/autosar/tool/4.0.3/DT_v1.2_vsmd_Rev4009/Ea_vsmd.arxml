AUTOSAR XML (schema 4-0-3)
package /QINeS
  ecuc definition collection AUTOSARParameterDefinition: module=Ea
  module definition Ea [0..1]: refined-module-def=Ea, variants pre-compile  # Configuration of the Ea (EEPROM Abstraction) module. / Eaモジュールのコンフィグレーション。 | The module shall abstract from the device specific addressing scheme and segmentation and provide the upper layers with a virtual addressing scheme and segmentation as well as a 'virtually' unlimited number of erase cycles.
    container EaBlockConfiguration [1..65536]  # Configuration of block specific parameters for the EEPROM abstraction module. / Eaブロックコンフィグレーション。 EEPROMアブストラクションモジュールのためのブロック特有パラメータのコンフィグレーション。
      integer EaBlockNumber: 1..65534, set at pre-compile, symbolic-name-value=true, default-value=8  # Block identifier (handle). / ブロックID。 | 0x0000 and 0xFFFF shall not be used for block numbers (see EA006). Range: min = 2^NVM_DATASET_SELECTION_BITS max = 0xFFFF -2^NVM_DATASET_SELECTION_BITS Note: Depending on the number of bits set aside for dataset selection several other block numbers shall also be left out to ease implementation.
      integer EaBlockSize: 1..65535, set at pre-compile, default-value=1024  # Size of a logical block in bytes. / 論理ブロックサイズ（バイト）。
      boolean EaImmediateData: set at pre-compile, default-value=false  # Marker for high priority data. / 即時データ 高い優先度データのためのマーカー。 | true: Block contains immediate data. false: Block does not contain immediate data.
      integer EaNumberOfWriteCycles: 1..4294967295, set at pre-compile, default-value=1  # Number of write cycles required for this block. / ライトサイクル 本ブロックに必要なライトサイクル数。
      symbolic name reference EaDeviceIndex: set at pre-compile, destination=EepGeneral  # Device index (handle). / デバイスインデックス。 | Range: 0 .. 254 (0xFF reserved for broadcast call to GetStatus function).
    container EaGeneral  # General configuration of the EEPROM abstraction module. This container lists block independent configuration parameters. / 抽象化されたEEPROMモジュールのジェネラルコンフィグレーション。
      boolean EaDevErrorDetect: set at pre-compile, origin=QINeS, default-value=true  # Pre-processor switch to enable and disable development error detection. / 開発エラー検出の有効/無効スイッチ。 TRUE：有効 FALSE：無効 | true: Development error detection enabled. false: Development error detection disabled.
      integer EaIndex: 0..254, set at pre-compile, origin=QINeS, default-value=0  # Specifies the InstanceId of this module instance. If only one instance is present it shall have the Id 0. / EAインデックス モジュールインスタンスIDを指定する。
      function name EaNvmJobEndNotification: set at pre-compile, origin=QINeS, default-value=NvM_JobEndNotification  # Mapped to the job end notification routine provided by the upper layer module (NvM_JobEndNotification). / NvM_JobEndNotification()関数名。
      function name EaNvmJobErrorNotification: set at pre-compile, origin=QINeS, default-value=NvM_JobErrorNotification  # Mapped to the job error notification routine provided by the upper layer module (NvM_JobErrorNotification). / NvM_JobErrorNotification()関数名。
      boolean EaPollingMode: set at pre-compile, origin=QINeS, default-value=true  # Pre-processor switch to enable and disable the polling mode for this module. / ポーリングモードの有効/無効スイッチ。 TRUE：有効 FALSE：無効 | true: Polling mode enabled, callback functions (provided to EEP module) disabled. false: Polling mode disabled, callback functions (provided to EEP module) enabled.
      boolean EaSetModeSupported: set at pre-compile, origin=QINeS, default-value=true  # Compile switch to enable / disable the function Ea_SetMode. / SetMode機能の有効/無効スイッチ。 TRUE：有効 FALSE：無効
      boolean EaVersionInfoApi: set at pre-compile, origin=QINeS, default-value=true  # Pre-processor switch to enable / disable the API to read out the modules version information. / モジュールバージョン情報APIの有効/無効スイッチ。 TRUE：有効 FALSE：無効 | true: Version info API enabled. false: Version info API disabled.
      integer EaVirtualPageSize: 0..65535, set at pre-compile, origin=QINeS, default-value=0  # The size in bytes to which logical blocks shall be aligned. / 仮想ページサイズ。 論理ブロックはバイト単位に整列しなければならない。 MAX=65535 MIN=0
      boolean EA_Q_PUBLISHEDINFORMATIONTYPE_ENABLED: set at pre-compile, origin=QINeS, default-value=true  # - / EaPublishedInformationコンテナを生成するかしないかを決める。 TRUE：生成する FALSE：生成しない
      integer EA_Q_NUM_OF_EA_BLOCK_CONFIGURATION: 1..65536, set at pre-compile, origin=QINeS, default-value=8  # - / EaBlockConfigurationコンテナの要素数を設定する。
    container EaPublishedInformation  # Additional published parameters not covered by CommonPublishedInformation container. / 公開情報 CommonPublishedInformationコンテナでカバーされない追加一般パラメータ。 | Note that these parameters do not have any configuration class setting, since they are published information.
      integer EaBlockOverhead: 0..65535, set at published-information, default-value=0  # Management overhead per logical block in bytes. / ブロックオーバーヘッド。 | Note: If the management overhead depends on the block size or block location a formula has to be provided that allows the configurator to calculate the management overhead correctly.
      float EaMaximumBlockingTime: 0..4294967295, set at published-information, default-value=0  # The maximum time the EA module's API routines shall be blocked (delayed) by internal operations. (EA070) / マックスブロックタイム 内部処理によりブロック（遅延）されるEAモジュールのAPIルーチンの最大回数。 | Note: Internal operations in that case means operations that are not explicitly invoked from the upper layer module but need to be handled for proper operation of this module or the underlying memory driver.
      integer EaPageOverhead: 0..65535, set at published-information, default-value=0  # Management overhead per page in bytes. / ページオーバーヘッド ページの管理オーバーヘッド。 | Note: If the management overhead depends on the block size or block location a formula has to be provided that allows the configurator to calculate the management overhead correctly.

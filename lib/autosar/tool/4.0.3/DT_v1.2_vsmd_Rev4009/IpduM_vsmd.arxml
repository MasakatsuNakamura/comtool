AUTOSAR XML (schema 4-0-3)
package /QINeS
  ecuc definition collection AUTOSARParameterDefinition: module=IpduM
  module definition IpduM [0..1]: refined-module-def=IpduM, variants link-time/post-build/pre-compile  # Configuration of the IpduM (Ipdu Multiplexer) module. / IpduMモジュールのコンフィグレーション。
    container IpduMConfig: multiple-configuration-container=true  # This container contains the sub containers of the IpduM module. The IpduMTxPathway subcontainer includes information about sent I-PDUs. The IpduMRxPathway includes information about received I-PDUs. / IpduMモジュールのコンテナ。 | This container is a MultipleConfigurationContainer, i.e. this container and its sub-containers exist once per configuration set.
      container IpduMRxPathway [0..*]  # Contains the configuration parameters received I-PDUs by the IpduM module. / 受信I-PDUパスに関するコンテナ。
        container IpduMRxIndication  # Contains the configuration for incoming RxIndication calls. / 受信通知に関するコンテナ。
          enumeration IpduMByteOrder: {IPDUM_BIG_ENDIAN, IPDUM_LITTLE_ENDIAN}, set at link in variant link-time / post-build in variant post-build / pre-compile in variant pre-compile  # This parameter defines the ByteOrder for all IpduMSegments (static and dynamic part) and for the selectorField within the MultiplexedPdu. / スタティックパートとダイナミックパートの全てのセグメントと、セレクタフィールドのバイトオーダー設定。 | The absolute position of a segment in the MultiplexedIPdu is determined by the definition of the ByteOrder parameter: If BIG_ENDIAN is specified, the SegmentPosition indicates the bit position of the most significant bit in an IPDU. If LITTLE_ENDIAN is specified, the SegmentPosition indicates the bit position of the least significant bit in an IPDU.
          integer IpduMRxHandleId: 0..255, set at link in variant link-time / post-build in variant post-build / pre-compile in variant pre-compile, symbolic-name-value=true  # This is the I-PDU ID of the incoming I-PDU. If an incoming RxIndication's I-PDU ID matches this value then it is unpacked according to the specification in this container. / 受信通知元が参照するI-PDU ID。
          reference IpduMRxIndicationPduRef: set at link in variant link-time / post-build in variant post-build / pre-compile in variant pre-compile, destination=Pdu  # Reference to the received Pdu representation in the ECU Configuration Description exchange file. / 未使用
          container IpduMRxDynamicPart [1..*]  # This container contains the configuration for the dynamic part of incoming RxIndication calls. When an incoming received I-PDU's selector field matches the IpduM_Selector_Value, the new outgoing I-PDU for the dynamic part is constructed as defined by the segments of this container and sent out with the I-PDU ID referenced by IpduMOutgoingDynamicPduRef. / 受信I-PDUのダイナミックパートに関するコンテナ。
            integer IpduMRxSelectorValue: 0..255, set at link in variant link-time / post-build in variant post-build / pre-compile in variant pre-compile  # This is the selector value that this container refers to. / セレクタフィールド値。
            reference IpduMOutgoingDynamicPduRef: set at link in variant link-time / post-build in variant post-build / pre-compile in variant pre-compile, destination=Pdu  # When the new I-PDU is sent out it is sent with this I-PDU ID. Reference to the sent PDU representation in the ECU Configuration Description exchange file. / ダイナミックパートの受信通知先のI-PDU ID。
            container IpduMSegment [1..*]  # This contains the location and the length of a segment. A segment must fit inside the I-PDU. The segment in the source I-PDU that is located at the IpduMSegmentPosition is copied to the same position in the destination I-PDU. / スタティックパートのセグメントに関するコンテナ。
              integer IpduMSegmentLength: 1..2032, set at link in variant link-time / post-build in variant post-build / pre-compile in variant pre-compile  # Length of the segment in bits. / スタティックパートのセグメント長。
              integer IpduMSegmentPosition: 0..2031, set at link in variant link-time / post-build in variant post-build / pre-compile in variant pre-compile  # Segments bit position in the multiplexed Pdu. / スタティックパートのセグメント開始ビット位置。
          container IpduMRxStaticPart [0..*]  # This container contains the configuration for the static part of incoming RxIndication calls. On reception, the new outgoing I-PDU for the static part is constructed as defined by the segments of this container and sent out with the I-PDU ID referenced by IpduMOutgoingStaticPduRef. / 受信I-PDUのスタティックパートに関するコンテナ。
            reference IpduMOutgoingStaticPduRef: set at link in variant link-time / post-build in variant post-build / pre-compile in variant pre-compile, destination=Pdu  # When the new I-PDU is sent out it is sent with this I-PDU ID. Reference to the sent Pdu representation in the ECU Configuration Description exchange file. / スタティックパートの受信通知先のI-PDU ID。
            container IpduMSegment [1..*]  # This contains the location and the length of a segment. A segment must fit inside the I-PDU. The segment in the source I-PDU that is located at the IpduMSegmentPosition is copied to the same position in the destination I-PDU. / スタティックパートのセグメントに関するコンテナ。
              integer IpduMSegmentLength: 1..2032, set at link in variant link-time / post-build in variant post-build / pre-compile in variant pre-compile  # Length of the segment in bits. / スタティックパートのセグメント長。
              integer IpduMSegmentPosition: 0..2031, set at link in variant link-time / post-build in variant post-build / pre-compile in variant pre-compile  # Segments bit position in the multiplexed Pdu. / スタティックパートのセグメント開始ビット位置。
          container IpduMSelectorFieldPosition  # This contains the location and the length of the selector field. / セレクタフィールド開始ビット位置。
            integer IpduMSelectorFieldLength: 1..8, set at link in variant link-time / post-build in variant post-build / pre-compile in variant pre-compile  # Length of the selector field in bits. / セレクタフィールド長。
            integer IpduMSelectorFieldPosition: 0..2031, set at link in variant link-time / post-build in variant post-build / pre-compile in variant pre-compile  # Selector field bit position in the multiplexed Pdu.
      container IpduMTxPathway [0..*]  # Contains the configuration parameters transmitted I-PDUs by the IpduM module. / 送信I-PDUパスに関するコンテナ。
        container IpduMTxRequest  # This is used to specify the configuration for Transmit requests. / 送信要求に関するコンテナ。 | There will one instance of this container for each I-PDU that can be requested for transmission (the outgoing I-PDUs) by the IpduM.
          enumeration IpduMByteOrder: {IPDUM_BIG_ENDIAN, IPDUM_LITTLE_ENDIAN}, set at link in variant link-time / post-build in variant post-build / pre-compile in variant pre-compile  # This parameter defines the ByteOrder for all IpduMSegments (static and dynamic part) and for the selectorField within the MultiplexedPdu. / スタティックパートとダイナミックパートの全てのセグメントと、セレクタフィールドのバイトオーダー設定。 | The absolute position of a segment in the MultiplexedIPdu is determined by the definition of the ByteOrder parameter: If BIG_ENDIAN is specified, the SegmentPosition indicates the bit position of the most significant bit in an IPDU. If LITTLE_ENDIAN is specified, the SegmentPosition indicates the bit position of the least significant bit in an IPDU.
          integer IpduMIPduUnusedAreasDefault [0..1]: 0..255, set at link in variant link-time / post-build in variant post-build / pre-compile in variant pre-compile  # IpduM module fills not used areas of an I-PDU with this bit-pattern / 送信I-PDUの未使用領域のデフォルト値。 | If this attribute is omitted the IpduM module does not fill the I-PDU.
          integer IpduMTxConfirmationPduId: 0..255, set at link in variant link-time / post-build in variant post-build / pre-compile in variant pre-compile, symbolic-name-value=true  # The handle Id to be used by the PduR to confirm the transmission of this Pdu. / 送信要求先が参照するI-PDU ID。 | The existence of this parameter is essential for the PduR generation tool to actually find a symbolicNameValue for the OutgoingPdu.
          float IpduMTxConfirmationTimeout [0..1]: 0..3600000, set at link in variant link-time / post-build in variant post-build / pre-compile in variant pre-compile  # This timeout (in seconds) defines the timeout period for monitoring the reception of the TxConfirmation. / 送信要求から送信完了通知までのタイムアウト値。 | It is not used when an I-PDU is requested using the trigger transmit API.
          enumeration IpduMTxTriggerMode: {IPDUM_DYNAMIC_PART_TRIGGER, IPDUM_NONE, IPDUM_STATIC_OR_DYNAMIC_PART_TRIGGER, IPDUM_STATIC_PART_TRIGGER}, set at link in variant link-time / post-build in variant post-build / pre-compile in variant pre-compile  # Selects whether to send the multiplexed I-PDU immediately or at some later date. / 送信I-PDUのスタティックパートまたはダイナミックパート更新時のトリガー送信モード。
          integer IpduM_Q_PduLength: 1..255, set at link in variant link-time / post-build in variant post-build / pre-compile in variant pre-compile, origin=QINeS  # -
          reference IpduMInitialDynamicPart: set at link in variant link-time / post-build in variant post-build / pre-compile in variant pre-compile, destination=IpduMTxDynamicPart  # Reference to the dynamic part that shall be used to initialize this multiplexed TX-I-PDU. / 送信I-PDUのダイナミックパートの初期値。
          reference IpduMOutgoingPduRef: set at link in variant link-time / post-build in variant post-build / pre-compile in variant pre-compile, destination=Pdu  # Reference to the PDU defining the outgoing I-PDU. / 送信要求先のI-PDU ID。 | When the outgoing I-PDU is sent this is the I-PDU ID to give it. It is the IpduM I-PDU ID of the assembled I-PDU.
          container IpduMSelectorFieldPosition  # This contains the location and the length of the selector field. / セレクタフィールド開始ビット位置。
            integer IpduMSelectorFieldLength: 1..8, set at link in variant link-time / post-build in variant post-build / pre-compile in variant pre-compile  # Length of the selector field in bits. / セレクタフィールド長。
            integer IpduMSelectorFieldPosition: 0..2031, set at link in variant link-time / post-build in variant post-build / pre-compile in variant pre-compile  # Selector field bit position in the multiplexed Pdu.
          container IpduMTxDynamicPart [1..*]  # Configuration parameters for an instance of a TxRequest call into the IpduM. When a Tx Request with the IpduMTxDynamicHandleId is received by the IpduM, all segments as defined by this container are copied from the incoming I-PDU into the outgoing I-PDU buffer and then the send mode honoured. This container is used by the dynamic part of a TxRequest configuration. Therefore, for each outgoing I-PDU there will be one instance of this container for the dynamic part. / 送信I-PDUのダイナミックパートに関するコンテナ。
            boolean IpduMJitUpdate [0..1]: set at link in variant link-time / post-build in variant post-build / pre-compile in variant pre-compile, default-value=false  # If configured to true fetch the data of this part Just-In-Time via the triggerTransmit API of the PduR. / ダイナミックパートのJIT更新有無の設定。
            boolean IpduMTxDynamicConfirmation: set at link in variant link-time / post-build in variant post-build / pre-compile in variant pre-compile  # A transmit request can be confirmed by the lower layer. If this parameter is set to true a confirmation of the I-PDU in COM representing the dynamic part is generated. / ダイナミックパートの送信完了通知有無の設定。
            integer IpduMTxDynamicHandleId: 0..255, set at link in variant link-time / post-build in variant post-build / pre-compile in variant pre-compile, symbolic-name-value=true  # This is an incoming handle id. When the handle of an incoming Tx Request matches this, the bits fields (see IpduMSegment) are copied and the IpduMTxTriggerMode is honored. / ダイナミックパートの送信要求元が参照するI-PDU ID。
            reference IpduMTxDynamicPduRef: set at link in variant link-time / post-build in variant post-build / pre-compile in variant pre-compile, destination=Pdu  # Reference to the Pdu representation in the ECU Configuration Description exchange file to be transmitted. / ダイナミックパートの送信完了通知先のI-PDU ID。
            container IpduMSegment [1..*]  # This contains the location and the length of a segment. A segment must fit inside the I-PDU. The segment in the source I-PDU that is located at the IpduMSegmentPosition is copied to the same position in the destination I-PDU. / ダイナミックパートのセグメントに関するコンテナ。
              integer IpduMSegmentLength: 1..2032, set at link in variant link-time / post-build in variant post-build / pre-compile in variant pre-compile  # Length of the segment in bits. / ダイナミックパートのセグメント長。
              integer IpduMSegmentPosition: 0..2031, set at link in variant link-time / post-build in variant post-build / pre-compile in variant pre-compile  # Segments bit position in the multiplexed Pdu. / ダイナミックパートのセグメント開始ビット位置。
          container IpduMTxStaticPart [0..*]  # Configuration parameters for an instance of a Tx_Request call into the IpduM. When a Tx Request with the IpduMTxStaticHandleId is received by the IpduM, all segments as defined by this container are copied from the incoming I-PDU into the outgoing I-PDU buffer and then the send mode honoured. This container is used for the static part of a TxRequest configuration. Therefore, for each outgoing I-PDU there will be one instance of this container for the static part if it exists. / 送信I-PDUのスタティックパートに関するコンテナ。
            boolean IpduMJitUpdate [0..1]: set at link in variant link-time / post-build in variant post-build / pre-compile in variant pre-compile, default-value=false  # If configured to true fetch the data of this part Just-In-Time via the triggerTransmit API of the PduR. / スタティックパートのJIT更新有無の設定。
            boolean IpduMTxStaticConfirmation: set at link in variant link-time / post-build in variant post-build / pre-compile in variant pre-compile  # A transmit request can be confirmed by the lower layer. If this parameter is set to true a confirmation of the I-PDU in COM representing the static part is generated. / スタティックパートの送信完了通知有無の設定。
            integer IpduMTxStaticHandleId: 0..255, set at link in variant link-time / post-build in variant post-build / pre-compile in variant pre-compile, symbolic-name-value=true  # This is an incoming handle id. When the handle of an incoming Tx Request matches this, the segments are copied (IPduMSegment) and the IpduMTxTriggerMode is honored. / スタティックパートの送信要求元が参照するI-PDU ID。
            reference IpduMTxStaticPduRef: set at link in variant link-time / post-build in variant post-build / pre-compile in variant pre-compile, destination=Pdu  # Reference to the Pdu representation in the ECU Configuration Description exchange file to be transmitted. / スタティックパートの送信完了通知先のI-PDU ID。
            container IpduMSegment [1..*]  # This contains the location and the length of a segment. A segment must fit inside the I-PDU. The segment in the source I-PDU that is located at the IpduMSegmentPosition is copied to the same position in the destination I-PDU. / スタティックパートのセグメントに関するコンテナ。
              integer IpduMSegmentLength: 1..2032, set at link in variant link-time / post-build in variant post-build / pre-compile in variant pre-compile  # Length of the segment in bits. / スタティックパートのセグメント長。
              integer IpduMSegmentPosition: 0..2031, set at link in variant link-time / post-build in variant post-build / pre-compile in variant pre-compile  # Segments bit position in the multiplexed Pdu. / スタティックパートのセグメント開始ビット位置。
    container IpduMGeneral  # Contains the general configuration parameters of IpduM. / IpduMのジェネラルコンフィグレーション。
      float IpduMConfigurationTimeBase: 0..3600000, set at pre-compile  # The cycle time with which IpduM_MainFunction should be invoked (in seconds). / IpduM_MainFunctionをコールする周期時間。
      boolean IpduMDevErrorDetect: set at pre-compile  # Active/Deactivate the detection of development errors, for production code this parameter has to be False. / Detへの通知の有効化・無効化。 | True: error detection activated False: error detection deactivated
      integer IpduMQSizeOfSduData: 1..255, set at pre-compile, origin=QINeS, default-value=8  # Max SIze Of SDU
      boolean IpduMStaticPartExists: set at pre-compile  # This is to allow optimizations in the case the IpduM will never be used with a static part. / スタティックパート使用有無。 | Note that this is a pre-compile option. If this is set to False then it will not be possible to add static parts after compilation. True: A static part may exist. False: A static part will never exist.
      boolean IpduMVersionInfoApi: set at pre-compile  # Active/Deactivate the version information API. / バージョン情報取得API使用有無。 | true: version information activated false: version information deactivated
    container IpduMPublishedInformation  # Additional published parameters not covered by / 未使用 | CommonPublishedInformation container. Note that these parameters do not have any configuration class setting, since they are published information.
      boolean IpduMRxDirectComInvocation: set at published-information  # If set to TRUE the COM invocation optimization as defined in / 未使用 | IPDUM140 is implemented.
    container IpduMQTxPathwayInfo [0..0]  # - / 未使用
      function name IpduMQTxPathWayBuffer: set at pre-compile, origin=QINeS  # - / 未使用
      integer IpduMQTxPathWaySize: 0..65535, set at pre-compile, origin=QINeS  # - / 未使用
      integer timeoutCounter: 0..4294967295, set at pre-compile, origin=QINeS  # - / 未使用
      reference ActiveDynamicPart [0..*]: scope=ECU, set at pre-compile, origin=QINeS, destination=IpduMTxDynamicPart  # -

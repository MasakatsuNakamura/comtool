AUTOSAR XML (schema 4-0-3)
package /QINeS
  ecuc definition collection AUTOSARParameterDefinition: module=LinSM
  module definition LinSM [0..1]: refined-module-def=LinSM, variants link-time/post-build/pre-compile  # Configuration of the Lin State Manager module. / LinSMモジュールのコンフィグレーション。
    container LinSMConfigSet: multiple-configuration-container=true  # This container describes one of multiple configuration sets of LinSm. / LinSMモジュールのコンフィグレーション。 | This is a MultipleConfigurationContainer, i.e. this container and its sub-containers exist once per configuration set.
      container LinSMChannel [1..*]  # Describes each LIN channel the LinSM is connected to. / LINチャネル情報のコンフィグレーション。
        float LinSMConfirmationTimeout: 0..255, set at link in variant link-time+post-build / pre-compile in variant pre-compile  # Timeout in seconds for the goto sleep and wakeup calls to LinIf. The timeout must be longer than a goto-sleep command on the bus (i.e. it is bit rate dependent). / スリープ移行要求、ウェイクアップ実行要求、スケジュール要求を行う際のタイムアウトまでのタイマー。
        boolean LinSMSleepSupport: set at link in variant link-time+post-build / pre-compile in variant pre-compile, default-value=true  # Some LIN clusters does not need sleep, they will just shut off. This parameter will affect the behavior to achieve the no communication state. / スリープ移行要求、ウェイクアップ実行要求があった際に、実際にLinIfに移行要求を行うかの有無。
        boolean LinSMTransceiverPassiveMode [0..1]: set at link in variant link-time+post-build / pre-compile in variant pre-compile, default-value=false  # Selects STANDBY (true) or SLEEP (false) transceiver mode when entering LINSM_NO_COM. / LINSM_NO_COMに遷移した際のトランシーバーモードの状態。
        symbolic name reference LinSMComMNetworkHandleRef: set at link in variant link-time+post-build / pre-compile in variant pre-compile, destination=ComMChannel  # Unique handle to identify one certain LIN network. Reference to one of the network handles configured in the ComM. / LINチャネルを参照するためのID。
        container LinSMSchedule [1..*]  # The schedule references to a schedule that is located in the LinIf configuration. Moreover, the PDU groups are located in the COM configuration. Note that there are two references to PDU groups. The simple reason is that a PDU group is only allowed to contain one direction (TX or RX). / スケジュール情報を設定するコンフィグレーション。
          integer LinSMScheduleIndex [0..1]: 0..255, set at link in variant link-time / post-build in variant post-build / pre-compile in variant pre-compile, symbolic-name-value=true  # This index parameter can be used by the BswM as a SymbolicNameReference target. The LinSM just forwards the request from the BswM to LinIf. Note that the value of the LinSMScheduleIndex shall be the same as the value from the LinIf. / BswMのから受け取ったスケジュールを参照するためのID。
          symbolic name reference LinSMScheduleIndexRef: set at link in variant link-time / post-build in variant post-build / pre-compile in variant pre-compile, destination=LinIfScheduleTable  # Reference to a schedule table in the LinIf configuration / LinIfのスケジュールを参照するためのスケジュールのID。
    container LinSMGeneral  # This container contains general parameters of LIN State Manager module. / LINSMの一般的なコンフィグレーション。
      boolean LinSMDevErrorDetect: set at pre-compile  # Switches the Development Error Detection and Notification ON or OFF. / 実行時エラー検知・通知機能のオンオフ。
      float LinSMMainProcessingPeriod: 0..255, set at pre-compile  # Fixed period that the MainFunction shall be called. / MainFunctionが呼び出される固定周期。
      boolean LinSMVersionInfoApi: set at pre-compile  # Switches the LinSM_GetVersionInfo function ON or OFF. / バージョン情報取得API使用有無。

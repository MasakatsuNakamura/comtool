AUTOSAR XML (schema 4-0-3)
package /QINeS
  ecuc definition collection AUTOSARParameterDefinition: module=ComM
  module definition ComM [0..1]: refined-module-def=ComM, variants post-build/pre-compile  # Configuration of the ComM (Communications Manager) module. / ComMモジュールのコンフィグレーション。
    container ComMConfigSet: multiple-configuration-container=true  # This container is the base for a multiple configuration set. / 多重コンフィグレーションセットのベースコンテナ。
      boolean ComMPncEnabled [0..0]: set at post-build in variant post-build / pre-compile in variant pre-compile, default-value=false  # Defines whether in this configuration set the partial networking is enabled. / 未使用 | true: Enabled false: Disabled
      container ComMChannel [1..256]  # This container contains the configuration (parameters) of the bus channel(s). The channel parameters shall be harmonized within the whole communication stack. / チャネル毎に設定を定義する構造体。 このコンテナには、バスチャンネル（複数可）の設定（パラメータ）が含まれる。 チャネルパラメータは、通信スタック内の全体で調和されなければならない。
        enumeration ComMBusType: {COMM_BUS_TYPE_CAN, COMM_BUS_TYPE_ETH, COMM_BUS_TYPE_FR, COMM_BUS_TYPE_INTERNAL, COMM_BUS_TYPE_LIN}, set at pre-compile  # Identifies the bus type of the channel. / チャンネルのバスタイプを識別する。
        integer ComMChannelId: 0..255, set at pre-compile, symbolic-name-value=true  # Channel identification number of the corresponding channel. / 対応するチャネルのチャネル識別番号。
        boolean ComMFullCommRequestNotificationEnabled: set at pre-compile, default-value=false  # Defines if the optional SenderReceiver Port of Interface ComM_CurrentChannelRequest will be provided for this channel. / フルコム要求状態を管理するかどうかのフラグ。 インタフェース(ComM_CurrentChannelRequest)のオプションポート(Sender/Receiver)をこのチャネルに提供するかどうかを定義する。 TRUE：有効 FALSE：無効 | True means enabled. False means disabled
        boolean ComMGlobalNvmBlockDescriptor [0..0]: set at pre-compile  # If this parameter is set to "true", the NoWakeUp inhibition state of the channel shall be stored (in some implementation specific way) in the block pointed to by ComMGlobalNvmBlockDescriptor. / 未使用
        float ComMMainFunctionPeriod: 1..100, set at pre-compile, default-value=20  # Specifies the period in seconds that the MainFunction has to be triggered with. / MainFunctionの作動期間([ms]単位)を指定する。 ComMのスケジューリングは少なくとも通信スタックと同じぐらいの速さになり、100msecを超過するスケジュールは無効となる。 | Comment: ComM scheduling shall be at least as fast as the communication stack and a schedule longer than 100ms makes no sense for communication.
        boolean ComMNoCom [0..0]: set at pre-compile, default-value=false  # Not allowed to change state of ComM channel to COMM_SILENT_COMMUNICATION or COMM_FULL_COMMUNICATION. / 未使用 | true: Enabled - Not allowed to switch to Communication Modes above. false: Disabled - Allowed to switch Communication Modes above. Shall be possible to change parameter during runtime with ComM API's. ECU/All channels: ComM_LimitECUToNoComMode(). Separate channels: ComM_LimitChannelToNoComMode().
        boolean ComMNoWakeup [0..0]: set at pre-compile, default-value=false  # Defines if an ECU is not allowed to wake-up the channel. / 未使用 | true: Enabled (not allowed to wake-up)) false: Disabled This is the default/init value of a runtime variable that can be changed during runtime using ComM_PreventWakeUp().
        enumeration ComMPncGatewayType [0..0]: {COMM_GATEWAY_TYPE_ACTIVE, COMM_GATEWAY_TYPE_PASSIVE}, set at pre-compile  # Identifies the Partial Network Gateway behaviour of a ComMChannel. / 未使用
        container ComMNetworkManagement  # This container contains the configuration parameters of the networkmanagement. / ネットワーク管理用パラメータ。
          float ComMNmLightTimeout [0..1]: 0..255000, set at pre-compile, default-value=10000  # Defines the timeout (in seconds) after COMM_FULL_COMMUNICATION sub-state COMM_FULL_COM_READY_SLEEP is left. / ComM チャネルモードのサブステート。 「COMM_FULL_COM_READY_SLEEP」から別の状態に遷移したときのタイムアウト時間を指定する。(0..255000[ms]) | The range shall be greater than 0.0 and less or equal to 255.0.
          enumeration ComMNmVariant: {FULL, LIGHT, NONE, PASSIVE}, set at pre-compile, default-value=LIGHT  # Defines the functionality of the networkmanagement. / NetworkManagementの機能を定義する。 | Shall be harmonized with NM configuration.
          boolean ComMPncNmRequest [0..0]: set at pre-compile, default-value=false  # If this parameter equals true then every time a FULL Communication is requested due to a change in the PNC state machine to PNC_REQUESTED Nm shall be called using the API Nm_NetworkRequest. / 未使用
        container ComMUserPerChannel [0..256]  # This container contains a list of identifiers that are needed to refer to a user in the system which is linked to a channel. / このコンテナには、チャネルにリンクされているシステムのユーザを参照が必要とされている識別子のリストが含まれる。
          reference ComMUserChannel: set at pre-compile, destination=ComMUser  # Reference to the ComMUser that corresponds to this channel user. / このチャネルのユーザーに対応するComMUserへの参照。 | ImplementationType: COMM_UserHandleType
      container ComMPnc [0..*]  # This container contains the configuration of the partial network cluster (PNC). / 未使用
        integer ComMPncId: 0..47, set at pre-compile, symbolic-name-value=true  # Partial network cluster identification number. / 未使用
        reference ComMChannelPerPnc [0..0]: set at pre-compile, destination=ComMChannel  # Reference to the ComMChannel that is required for this PNC. / 未使用 | ImplementationType: COMM_ChannelType
        reference ComMUserPerPnc [0..0]: set at pre-compile, destination=ComMUser  # Reference to the ComMUsers that correspond to this PNC. / 未使用 | ImplementationType: COMM_UserHandleType
        container ComMPncComSignal [0..0]  # Represents the PncComSignals which are used to communicate the EIRA and ERA status of this PNC. / 未使用
          enumeration ComMPncComSignalDirection [0..0]: {RX, TX}, set at pre-compile  # Indicates the communication direction of this PncComSignal. / 未使用
          enumeration ComMPncComSignalKind [0..0]: {EIRA, ERA}, set at pre-compile  # Indicates whether this PncComSignal represents EIRA or ERA PNC information. / 未使用
          reference ComMPncComSignalChannelRef [0..0]: set at pre-compile, destination=ComMChannel  # Reference to the ComMChannel which is used to determine whether this PncComSignal shall participate in the active or passive role (via the parameter ComMPncGatewayType of the ComMChannel). / 未使用 | Not applicable if ComMPncComSignalKind is EIRA.
          symbolic name reference ComMPncComSignalRef [0..0]: set at pre-compile, destination=ComSignal  # Reference to the ComSignal which is used to transport the partial network channel request information. / 未使用
      container ComMUser [1..256]  # This container contains a list of identifiers that are needed to refer to a user in the system which is designated to request Communication modes. / ユーザー毎のコンフィグデータへのアクセスポインタを指定する。 このコンテナには、通信モードを要求するように示されているシステムのユーザを参照するために必要な識別子のリストが含まれる。
        integer ComMUserIdentifier: 0..255, set at pre-compile, symbolic-name-value=true  # An identifier that is needed to refer to a user in the system which is designated to request Communication Modes. / 通信モードを要求するように指定さているシステムのユーザを参照するために必要な識別子。 | ImplementationType: ComM_UserHandleType
        reference ComMUserEcucPartitionRef [0..1]: set at pre-compile, destination=EcucPartition  # Denotes in which "EcucPartition" the requester is executed. When the / EcucPartitionの中でリクエスタが実行されることを意味する。 | partition is stopped, the communication request shall be cancelled in the ComM to avoid a stay-awake situation of the bus due to a stopped partition.
    container ComMGeneral  # General configuration parameters of the Communication Manager. / Communication Managerの一般的なコンフィグレーションパラメータ。
      boolean ComMDevErrorDetect: set at pre-compile, default-value=false  # Switches the Development Error Detection and Notification ON or OFF. / 開発エラーの検知および通知を有効/無効に切り替える。 | true: Enabled false: Disabled
      boolean ComMDirectUserMapping [0..0]: set at pre-compile, default-value=false  # If this parameter is set to true the configuration tool shall automatically create a ComMUser per ComMPnc and a ComMUser per ComMChannel. / 未使用 | The shortName of the generated ComMUsers shall follow the following naming convention: PNCUser_ComMPncId, e.g. PNCUser_13 ChannelUser_ComMChannelId, e.g. ChannelUser_25 Restriction: ComMUser, which are created due to this configuration parameter, shall not be used by SWCs (only available for BswM).
      integer ComMEcuGroupClassification [0..0]: 0..255, set at pre-compile, default-value=3  # Defines whether a mode inhibition affects the ECU or not. / 未使用 | Examples: 000: No mode inhibition can be activated 001: Wake up inhibition can be enabled Forcing into COMM_NO_COMMUNICATION mode shall be switched on if ComMNmVariant=PASSIVE.
      boolean ComMModeLimitationEnabled [0..0]: set at pre-compile, default-value=false  # true if mode limitation functionality shall be enabled. / 未使用 | true: Enabled false: Disabled
      boolean ComMPncGatewayEnabled [0..0]: set at pre-compile, default-value=false  # Enables or disables support of Partial Network Gateway. / 未使用 | False: Partial Networking Gateway is disabled True: Partial Networking Gateway is enabled
      float ComMPncPrepareSleepTimer [0..0]: 0..63000, set at pre-compile  # Time in seconds the PNC state machine shall wait in PNC_PREPARE_SLEEP. / 未使用
      boolean ComMPncSupport [0..0]: set at pre-compile, default-value=false  # Enables or disables support of partial networking. / 未使用 | False: Partial Networking is disabled True: Partial Networking is enabled
      boolean ComMSynchronousWakeUp: set at pre-compile, default-value=true  # Wake up of one channel shall lead to a wake up of all channels if true. / EcuM_WakeUpIndication による全チャネルの同期処理の有効/無効を設定します。TRUE：有効。１つのチャネルのウェイクアップにより、全チャネルのウェイクアップを導く。 FALSE：無効 | true: Enabled false: Disabled
      float ComMTMinFullComModeDuration: 1..65000, set at pre-compile, default-value=5000  # Minimum time duration in seconds, spent in the COMM_FULL_COMMUNICATION sub-state COMM_FULL_COM_NETWORK_REQUESTED. / COMM_FULL_COMMUNICATIONのサブステートであるCOMM_FULL_COM_NETWORK_REQUESTED状態の最小持続時間([ms]単位)を定義する。
      boolean ComMVersionInfoApi [0..0]: set at pre-compile, default-value=true  # Switches the possibility to read the published information with the service ComM_GetPublishedInformation(). / 未使用 | true: Enabled false: Disabled
      boolean ComMWakeupInhibitionEnabled [0..0]: set at pre-compile, default-value=false  # true if wake up inhibition functionality enabled. / 未使用 | true: Enabled false: Disabled
      symbolic name reference ComMGlobalNvMBlockDescriptor [0..0]: set at pre-compile, destination=NvMBlockDescriptor  # Reference to NVRAM block containing the none volatile data. If this parameter is not configured it means that no NVRam is used at all. / 未使用

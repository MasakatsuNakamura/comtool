AUTOSAR XML (schema 4-0-3)
package /eSOL/EcucDefs
  ecuc definition collection AUTOSARParameterDefinition: module=Lin
  module definition Lin [0..*]: refined-module-def=Lin, variants post-build/pre-compile  # Configuration of the Lin (LIN driver) module. / Lin通信モジュールのコンフィグレーション。
    container LinGeneral  # This container contains the parameters related to each LIN Driver Unit. / このコンテナには各LINドライバユニットに関するパラメータが含まれる。
      boolean LinDevErrorDetect: set at pre-compile  # Switches the Development Error Detection and Notification ON or OFF. / 開発エラー検知と通知を有効化(ON)・無効化（OFF）するスイッチ。
      integer LinIndex: 0..255, set at pre-compile  # Specifies the InstanceId of this module instance. If only one instance is present it shall have the Id 0. / モジュールインスタンスのインスタンスIDを指定する。インスタンスが１つだけの場合、ID=0で無ければならない。
      integer LinTimeoutDuration: 0..65535, set at pre-compile  # Specifies the maximum number of loops for blocking function until a timeout is raised in short term wait loops / タイムアウトするまでの最大ループ回数を指定する。指定回数（時間）を超えるとタイムアウトエラーを上げる。
      boolean LinVersionInfoApi: set at pre-compile  # Switches the Lin_GetVersionInfo function ON or OFF. / Lin_GetVersionInfoを有効化（ON）・無効化（OFF)するスイッチ。
    container LinGlobalConfig: multiple-configuration-container=true  # This container contains the global configuration parameter of the Lin driver. This container is a MultipleConfigurationContainer, i.e. this container and its sub-containers exit once per configuration set. / このコンテナにはLINドライバのグローバルコンフィグレーションパラメータが含まれる。１つのコンフィグレーションセットでは、コンテナとそれのサブコンテナは一回だけ存在する。
      container LinChannel [1..*]  # This container contains the configuration (parameters) of the LIN Controller(s). / このコンテナにはLINコントローラのコンフィグレーション（パラメータ）が含まれる。
        integer LinChannelBaudRate: 1000..20000, set at post-build in variant post-build / pre-compile in variant pre-compile  # Specifies the baud rate of the LIN channel / LINチャネルの通信ボーレートを指定する。
        integer LinChannelId: 0..65535, set at pre-compile, symbolic-name-value=true  # Identifies the LIN channel. Replaces LIN_CHANNEL_INDEX_NAME from the LIN SWS. / LINチャネルの識別No.を指定する。
        boolean LinChannelWakeupSupport: set at pre-compile  # Specifies if the LIN hardware channel supports wake up functionality / LINハードウェアチャネルがウェイクアップ機能をサポートしているかを指定する。
        reference LinClockRef: set at post-build in variant post-build / pre-compile in variant pre-compile, destination=McuClockReferencePoint  # Reference to the LIN clock source configuration, which is set in the MCU driver configuration. / MCUドライバコンフィグレーションにより設定されているLINクロックコンフィグレーションに参照する。
        symbolic name reference LinChannelEcuMWakeupSource [0..1]: set at pre-compile, destination=EcuMWakeupSource  # This parameter contains a reference to the Wakeup Source for this controller as defined in the ECU State Manager. / このパラメータにはECUステートマネジャーでこのコントローラ用として定義されているウェイクアップソースへの参照が含まれる。
      container LinDemEventParameterRefs [0..1]  # Container for the references to DemEventParameter elements which shall be invoked using the API Dem_ReportErrorStatus API in case the corresponding error occurs. The EventId is taken from the referenced DemEventParameter's DemEventId value. The standardized errors are provided in the container and can be extended by vendor specific error references. / DemEventParameterのエレメントへの参照用のコンテナであり、対応するエラーが発生した場合、API Dem_ReportErrorStatus APIを使用して起動しなければならない。 EventIdは参照するDemEventParameterのDemEventId値から取得される。コンテナでは標準化されたエラーが提供され、ベンダー固有エラー参照へ拡張することができる。
        symbolic name reference LIN_E_TIMEOUT [0..1]: set at post-build in variant post-build / pre-compile in variant pre-compile, destination=DemEventParameter  # Reference to the DemEventParameter which shall be issued when the error "Timeout caused by hardware error" has occured. If the reference is not configured the error shall be reported as DET error. / 「ハードウェアエラーが起因のタイムアウト」エラーが発生した場合に発行されなければならないDemEventParameterへの参照である。参照がコンフィグされていない場合はエラーがDETエラーとして報告されなければならない。

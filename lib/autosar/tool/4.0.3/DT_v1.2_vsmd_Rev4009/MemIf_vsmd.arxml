AUTOSAR XML (schema 4-0-3)
package /QINeS
  ecuc definition collection AUTOSARParameterDefinition: module=MemIf
  module definition MemIf [0..1]: refined-module-def=MemIf, variants pre-compile  # Configuration of the MemIf (Memory Abstraction Interface) module. / MemIfモジュールのコンフィグレーション。
    container MemIfGeneral  # Configuration of the memory abstraction interface (Memif) module. / MemIfモジュールのジェネラルコンフィグレーション。
      boolean MemIfDevErrorDetect: set at pre-compile, default-value=true  # Pre-processor switch to enable and disable development error detection. / 開発時エラーの有効／無効プリ・プロセッサ・スイッチ。 TRUE：開発時エラー検出有効 FALSE：開発時エラー検出無効 | true: Development error detection enabled. false: Development error detection disabled.
      integer MemIfNumberOfDevices: 1..255, set at pre-compile, default-value=1  # Concrete number of underlying memory abstraction modules. / 下層メモリ抽象化モジュールの具体的な数。 計算式：設定したEaとFeeのモジュールのカウント数。 ※非サポート。１を設定すること。 | Calculation Formula: Count number of configured EA and FEE modules.
      boolean MemIfVersionInfoApi: set at pre-compile, default-value=true  # Pre-processor switch to enable / disable the API to read out the modules version information. / バージョン情報取得関数（MemIf_GetVersionInfo）の有効／無効プリ・プロセッサ・スイッチ。 TRUE：バージョン情報取得関数有効 FALSE：バージョン情報取得関数無効 | true: Version info API enabled. false: Version info API disabled.
      boolean MEMIF_Q_EA_EXIST: set at pre-compile, origin=QINeS, default-value=false  # Pre-processor switch to enable and disable deviceIndex detection. / Eaモジュールを呼び出すための有効/無効プリ・プロセッサ・スイッチ。 TRUE：Ea有効 FALSE：Ea無効 | true: EA detection enabled. false: EA detection disabled.
      boolean MEMIF_Q_FEE_EXIST: set at pre-compile, origin=QINeS, default-value=true  # Pre-processor switch to enable and disable deviceIndex detection. / Feeモジュールを呼び出すための有効/無効プリ・プロセッサ・スイッチ。 TRUE：Fee有効 FALSE：Fee無効 | true: fee detection enabled. false: fee detection disabled.

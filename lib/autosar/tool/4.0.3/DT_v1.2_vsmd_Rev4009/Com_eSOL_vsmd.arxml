AUTOSAR XML (schema 4-0-3)
package /eSOL/EcucDefs
  ecuc definition collection AUTOSARParameterDefinition: module=Com
  module definition Com [0..1]: refined-module-def=Com, refined-module-def=Com, variants link-time/post-build/pre-compile  # Configuration of the AUTOSAR COM module. / Comモジュールのコンフィグレーション。
    container ComConfig: multiple-configuration-container=true  # This container contains the configuration parameters and sub containers of the AUTOSAR COM module. This container is a MultipleConfigurationContainer, i.e. this container and its sub-containers exist once per configuration set. / コンフィグレーション毎の設定パラメータとAUTOSAR COMモジュールのサブコンテナを含むコンテナ。
      integer ComConfigurationId: 0..0, set at link in variant link-time / post-build in variant post-build / pre-compile in variant pre-compile  # This ID is returned by a call to Com_GetConfigurationId. / コンフィグレーションのID。 0を指定してください。 （ComConfigは1つのみ作成するため）
      container ComGwMapping [0..*]
        choice container ComGwDestination [1..*]  # Each instance of this choice container allows to define one routing destination either by reference to an already configured COM signal / signal group or by a destination description container. / ゲートウェイ先シグナルの設定に関するコンテナ。
          container ComGwDestinationDescription [0..1]  # Description of a gateway destination. This container allows defining a gateway destination without the configuration of a complete COM signal. This allows adding / changing gateway relations post build without the configuration of new signals. / ゲートウェイ先シグナルの記述の設定に関するコンテナ。
            integer ComBitPosition: 0..2031, set at link in variant link-time / post-build in variant post-build / pre-compile in variant pre-compile  # Starting position within the I-PDU. This parameter refers to the position in the I-PDU and not in the shadow buffer. If the endianness conversion is configured to Opaque the parameter ComBitPosition shall define the bit0 of the first byte like in little endian byte order / ゲートウェイ先シグナルのI-PDU内でのビット位置。
            enumeration ComSignalEndianness: {BIG_ENDIAN, LITTLE_ENDIAN, OPAQUE}, set at link in variant link-time / post-build in variant post-build / pre-compile in variant pre-compile  # Defines the endianness of the signal's network representation. / ゲートウェイ先シグナルのエンディアン。 BIG_ENDIAN：ビッグエンディアン LITTLE_ENDIAN：リトルエンディアン OPAQUE：オペーク
            string ComSignalInitValue [0..1]: set at link in variant link-time / post-build in variant post-build / pre-compile in variant pre-compile, default-value=0  # Initial value for this signal. The default value is 0. / ゲートウェイ先シグナルの初期値。デフォルト値は0。 | In case the ComSignalType is UINT8, UINT16, UINT32, SINT8, SINT16, SINT32 the string shall be interpreted as defined in the chapter Integer Type in the AUTOSAR EcuC specification. In case the ComSignalType is FLOAT32, FLOAT64 the string shall be interpreted as defined in the chapter Float Type in the AUTOSAR EcuC specification. In case the ComSignalType is BOOLEAN the string shall be interpreted as defined in the chapter Boolean Type in the AUTOSAR EcuC specification. In case the ComSignal is a UINT8_N, UINT6_DYN the string shall be interpreted as a decimal representation of the characters separated by blanks, e.g. "97 98 100" means a string "abd", where the char "a" is in byte 0(lowest address), "b" is in byte 1, and "d" is in byte 2 and (highest address).
            enumeration ComTransferProperty [0..1]: {PENDING, TRIGGERED, TRIGGERED_ON_CHANGE, TRIGGERED_ON_CHANGE_WITHOUT_REPETITION, TRIGGERED_WITHOUT_REPETITION}, set at link in variant link-time / post-build in variant post-build / pre-compile in variant pre-compile  # Defines if a write access to this signal can trigger the transmission of the corresponding I-PDU. If the I-PDU is triggered, depends also on the transmission mode of the corresponding I-PDU. / ゲートウェイ先シグナルの送信プロパティ。 PENDING：シグナルのライトが発生しても、所属I-PDUの送信(繰り返しあり)トリガにしない。周期送信のみ。 TRIGGERED：シグナルのライトが発生した場合、所属I-PDUの送信(繰り返しあり)トリガにする。 TRIGGERED_ON_CHANGE：シグナルのライトが発生した場合、前回値と異なる場合は所属I-PDUの送信(繰り返しあり)トリガにする。 TRIGGERED_WITHOUT_REPETITION：シグナルのライトが発生した場合、所属I-PDUの送信(繰り返しなし)トリガにする。 TRIGGERED_ON_CHANGE_WITHOUT_REPETITION：シグナルのライトが発生した場合、前回値と異なる場合は所属I-PDUの送信(繰り返しなし)トリガにする。
            integer ComUpdateBitPosition [0..1]: 0..2031, set at link in variant link-time / post-build in variant post-build / pre-compile in variant pre-compile  # Bit position of update-bit inside I-PDU. / ゲートウェイ先シグナルのアップデートビット位置。 範囲 0..63：CANまたはLIN通信するI-PDUの場合 0..2031：FlexRay通信するI-PDUの場合 | If this attribute is omitted then there is no update-bit. This setting must be consistently on sender and on receiver side. Range: 0..63 for CAN and LIN 0..2031 for FlexRay
            reference ComGwIPduRef: set at link in variant link-time / post-build in variant post-build / pre-compile in variant pre-compile, destination=ComIPdu  # Reference to an I-PDU of a Signal Gateway source or destination description. / ゲートウェイ先シグナルの所属I-PDUへの参照。
            container ComFilter [0..1]  # This container contains the configuration parameters of the AUTOSAR COM module's Filters. / Comモジュールのフィルタ設定に関するコンテナ。 | Note: On sender side the container is used to specify the transmission mode conditions.
              enumeration ComFilterAlgorithm: {ALWAYS, MASKED_NEW_DIFFERS_MASKED_OLD, MASKED_NEW_DIFFERS_X, MASKED_NEW_EQUALS_X, NEVER, NEW_IS_OUTSIDE, NEW_IS_WITHIN, ONE_EVERY_N}, set at link in variant link-time+post-build / pre-compile in variant pre-compile  # The range of values is specified in the [17] specification, chapter 2.2.2, Reception Filtering. / フィルタのアルゴリズム。 ALWAYS：フィルタ結果は常にTRUE MASKED_NEW_DIFFERS_MASKED_OLD：マスクした今回値とマスクした前回値が異なる場合にTRUE MASKED_NEW_DIFFERS_X：マスクした今回値とXが異なる場合にTRUE MASKED_NEW_EQUALS_X：マスクした今回値とXが同じ場合にTRUE NEVER：フィルタ結果は常にFALSE NEW_IS_OUTSIDE：今回値が範囲外である場合にTRUE NEW_IS_WITHIN：今回値が範囲内である場合にTRUE ONE_EVERY_N：N回フィルタされる度に1回TRUE
              integer ComFilterMask [0..1]: 0..18446744073709551615, set at link in variant link-time+post-build / pre-compile in variant pre-compile  # The name of this attribute corresponds to the parameter name in the [17] specification of Reception Filtering. / フィルタのマスク値。ComFilterAlgorithmがMASKED_NEW_DIFFERS_MASKED_OLD、MASKED_NEW_DIFFERS_X、MASKED_NEW_EQUALS_Xのいずれかの場合に有効。
              integer ComFilterMax [0..1]: 0..18446744073709551615, set at link in variant link-time+post-build / pre-compile in variant pre-compile  # The name of this attribute corresponds to the parameter name in the [17] specification of Reception Filtering. / フィルタの範囲チェック最大値。ComFilterAlgorithmがNEW_IS_OUTSIDE、NEW_IS_WITHINのいずれかの場合に有効。
              integer ComFilterMin [0..1]: 0..18446744073709551615, set at link in variant link-time+post-build / pre-compile in variant pre-compile  # The name of this attribute corresponds to the parameter name in the [17] specification of Reception Filtering. / フィルタの範囲チェック最少値。ComFilterAlgorithmがNEW_IS_OUTSIDE、NEW_IS_WITHINのいずれかの場合に有効。
              integer ComFilterOffset [0..1]: 0..18446744073709551615, set at link in variant link-time+post-build / pre-compile in variant pre-compile  # The name of this attribute corresponds to the parameter name in the [17] specification of Reception Filtering. / フィルタのオフセット。ComFilterAlgorithmがONE_EVERY_Nの場合に有効。 | Range = 0..(ComFilterPeriod-1)
              integer ComFilterPeriod [0..1]: 0..18446744073709551615, set at link in variant link-time / post-build in variant post-build / pre-compile in variant pre-compile  # This parameter defines the period of the ComFilterAlgorithm ONE_EVERY_N. / フィルタの通過周期。ComFilterAlgorithmがONE_EVERY_Nの場合に有効。
              integer ComFilterX [0..1]: 0..18446744073709551615, set at link in variant link-time+post-build / pre-compile in variant pre-compile  # The name of this attribute corresponds to the parameter name in the [17] specification of Reception Filtering. / フィルタのXの値。ComFilterAlgorithmがMASKED_NEW_DIFFERS_X、MASKED_NEW_EQUALS_Xのいずれかの場合に有効。
          container ComGwSignal [0..1]  # This container allows specifying a gateway source or destination respectively with a reference to a ComSignal, a ComGroupSignal or a ComSignalGroup. / ゲートウェイするシグナルへの参照を含むコンテナ。
            choice reference ComGwSignalRef: set at link in variant link-time / post-build in variant post-build / pre-compile in variant pre-compile, destination=[ComGroupSignal, ComSignal, ComSignalGroup]  # Reference to an object of a gateway relation. Either to a ComSignal, ComGroupSignal or to a SignalGroup. / ゲートウェイするシグナルへの参照。
        choice container ComGwSource  # This choice container allows the definition of the gateway source signal either by reference to an already configured COM signal / signal group or by a source description container. / ゲートウェイ元シグナルの設定を含むコンテナ。
          container ComGwSignal [0..1]  # This container allows specifying a gateway source or destination respectively with a reference to a ComSignal, a ComGroupSignal or a ComSignalGroup. / ゲートウェイするシグナルへの参照を含むコンテナ。
            choice reference ComGwSignalRef: set at link in variant link-time / post-build in variant post-build / pre-compile in variant pre-compile, destination=[ComGroupSignal, ComSignal, ComSignalGroup]  # Reference to an object of a gateway relation. Either to a ComSignal, ComGroupSignal or to a SignalGroup. / ゲートウェイするシグナルへの参照。
          container ComGwSourceDescription [0..1]  # Description of a gateway source. This container allows defining a gateway source without the configuration of a complete COM signal. This allows adding / changing gateway relations post build without the configuration of new signals. / ゲートウェイ元シグナルの記述の設定を含むコンテナ。
            integer ComBitPosition: 0..2031, set at link in variant link-time / post-build in variant post-build / pre-compile in variant pre-compile  # Starting position within the I-PDU. This parameter refers to the position in the I-PDU and not in the shadow buffer. If the endianness conversion is configured to Opaque the parameter ComBitPosition shall define the bit0 of the first byte like in little endian byte order / ゲートウェイ先シグナルのI-PDU内でのビット位置。
            integer ComBitSize [0..1]: 0..64, set at link in variant link-time / post-build in variant post-build / pre-compile in variant pre-compile  # Size in bits, for non-array signal types. / ゲートウェイ元シグナルのビットサイズ。 ComSignalTypeがUINT8_NまたはUINT8_DYNの場合は無効。 | For ComSignalType UINT8_N and UINT8_DYN this size shall be configured by ComSignalLength.
            enumeration ComSignalEndianness: {BIG_ENDIAN, LITTLE_ENDIAN, OPAQUE}, set at link in variant link-time / post-build in variant post-build / pre-compile in variant pre-compile  # Defines the endianness of the signal's network representation. / ゲートウェイ先シグナルのエンディアン。 BIG_ENDIAN：ビッグエンディアン LITTLE_ENDIAN：リトルエンディアン OPAQUE：オペーク
            integer ComSignalLength [0..1]: 1..8, set at link in variant link-time+post-build / pre-compile in variant pre-compile  # Description: / ゲートウェイ元シグナルの長さ(byte)。 ComSignalTypeがUINT8_NまたはUINT8_DYNの場合に有効。 範囲1..8 | For ComSignalType UINT8_N this parameter specifies the length n in bytes. For ComSignalType UINT8_DYN it specifies the maximum length in bytes. For all other types this parameter shall be ignored. Range: 0..8 for normal CAN/ LIN I-PDUs, 0..254 for normal FlexRay I-PDUs, and 0..4095 for I-PDUs with ComIPduType TP.
            enumeration ComSignalType: {BOOLEAN, FLOAT32, FLOAT64, SINT16, SINT32, SINT8, UINT16, UINT32, UINT8, UINT8_DYN, UINT8_N}, set at link in variant link-time / post-build in variant post-build / pre-compile in variant pre-compile  # The AUTOSAR type of the signal. Whether or not the signal is signed or unsigned can be found by examining the value of this attribute. / ゲートウェイ元シグナルの型。 BOOLEAN：boolean FLOAT32：浮動小数点(32bit) FLOAT64：浮動小数点(64bit) SINT8：符号あり整数(8bit) SINT16：符号あり整数(16bit) SINT32：符号あり整数(32bit) UINT8：符号なし整数(8bit) UINT16：符号なし整数(16bit) UINT32：符号なし整数(32bit) UINT8_N：配列(8bit) UINT8_DYN：可変長配列(bit) | This type could also be used to reserved appropriate storage in AUTOSAR COM.
            integer ComUpdateBitPosition [0..1]: 0..2031, set at link in variant link-time / post-build in variant post-build / pre-compile in variant pre-compile  # Bit position of update-bit inside I-PDU. / ゲートウェイ先シグナルのアップデートビット位置。 範囲 0..63：CANまたはLIN通信するI-PDUの場合 0..2031：FlexRay通信するI-PDUの場合 | If this attribute is omitted then there is no update-bit. This setting must be consistently on sender and on receiver side. Range: 0..63 for CAN and LIN 0..2031 for FlexRay
            reference ComGwIPduRef: set at link in variant link-time / post-build in variant post-build / pre-compile in variant pre-compile, destination=ComIPdu  # Reference to an I-PDU of a Signal Gateway source or destination description. / ゲートウェイ先シグナルの所属I-PDUへの参照。
      container ComIPdu [0..65535]  # Contains the configuration parameters of the AUTOSAR COM module's I-PDUs. / I-PDUの設定に関するコンテナ。
        function name ComIPduCallout [0..1]: set at pre-compile, max-length=255  # This parameter defines the existence and the name of a callout function for the corresponding I-PDU. If this parameter is omitted no I-PDU callout shall take place for the corresponding I-PDU. / I-PDU通信前に呼び出されるコールアウト関数。
        boolean ComIPduCancellationSupport [0..1]: set at pre-compile, default-value=false  # Defines for I-PDUs with ComIPduType NORMAL: / I-PDU通信要求キャンセルの使用有無。 TRUE：I-PDU通信要求キャンセル有効 FALSE：I-PDU通信要求キャンセル無効 | If the underlying IF-modul supports cancellation of transmit requests. Defines for I-PDUs with ComIPduType TP: If the underlying TP-module supports RX and TX cancellation of ongoing requests.
        enumeration ComIPduDirection: {RECEIVE, SEND}, set at link in variant link-time / post-build in variant post-build / pre-compile in variant pre-compile  # The direction defines if this I-PDU, and therefore the contributing signals and signal groups, shall be sent or received. / I-PDU通信の方向。 RECEIVE：受信I-PDU SEND：送信I-PDU
        integer ComIPduHandleId: 0..65535, set at link in variant link-time+post-build / pre-compile in variant pre-compile, symbolic-name-value=true  # The numerical value used as the ID of this I-PDU. The ComIPduHandleId is required by the API calls to receive I-PDUs from the PduR (ComIP-duDirection: Receive). For Tx-I-PDUs (ComIPduDirection: Send) this handle Id is used by the PduR to confirm the transmission of the ComIPdu. In case no Tx-Confirmation is configured for a Tx-I-PDU, the ComIPduHandleId is not used. / I-PDUのハンドルID。 ※ComIPduDirectionがRECEIVEのComIPduとSENDのComIPduのそれぞれで0ベースの連続値を指定する。
        enumeration ComIPduSignalProcessing: {DEFERRED, IMMEDIATE}, set at link in variant link-time / post-build in variant post-build / pre-compile in variant pre-compile  # For the definition of the two modes Immediate and Deferred. / I-PDUの受信/送信完了通知の処理タイミング。 ※IMMEDIATEを指定する。（DEFERREDは未サポートのため）
        function name ComIPduTriggerTransmitCallout [0..1]: set at pre-compile  # If there is a trigger transmit callout defined for this I-PDU this parameter contains the name of the callout function. / Com_TriggerTransmit コールアウトの関数名。 ※関数名を設定した場合、ComGeneral/ComTriggerTransmitApiにtrueを設定する。
        enumeration ComIPduType: {NORMAL, TP}, set at link in variant link-time / post-build in variant post-build / pre-compile in variant pre-compile  # Defines if this I-PDU is a normal I-PDU that can be sent unfragmented or if this is a large I-PDU that shall be sent via the Transport Protocol of the underlying bus. / I-PDUのNORMAL/TPの種別。
        reference ComIPduGroupRef [1..65535]: set at link in variant link-time / post-build in variant post-build / pre-compile in variant pre-compile, destination=ComIPduGroup  # Reference to the I-PDU groups this I-PDU belongs to. / 所属しているI-PDUグループへの参照。
        reference ComIPduSignalGroupRef [0..*]: set at link in variant link-time / post-build in variant post-build / pre-compile in variant pre-compile, destination=ComSignalGroup  # References to all signal groups contained in this I-Pdu / I-PDUが所持しているシグナルグループへの参照。
        reference ComIPduSignalRef [0..65535]: set at link in variant link-time / post-build in variant post-build / pre-compile in variant pre-compile, destination=ComSignal  # References to all signals contained in this I-PDU. / I-PDUが所持しているシグナルへの参照。
        reference ComPduIdRef: set at link in variant link-time+post-build / pre-compile in variant pre-compile, destination=Pdu  # Reference to the "global" Pdu structure to allow harmonization of handle IDs in the COM-Stack. / EcuCで管理するPduへの参照。
        container ComIPduCounter [0..1]  # This optional container contains the configuration parameters of PDU Counter. / PDUカウンタの設定に関するコンテナ。
          function name ComIPduCounterErrorNotification [0..1]: set at link in variant link-time+post-build / pre-compile in variant pre-compile  # Name of Com_CbkCounterErr callback function to be called. If this / I-PDUカウンタエラー通知Callback関数（Com_CbkCounterErr()）の名前。 | parameter is omitted no I-PDU counter mismatch notification shall take place.
          integer ComIPduCounterSize: 1..8, set at pre-compile  # Size of PDU Counter expressed in bits / I-PDUカウンタサイズ(bit)。
          integer ComIPduCounterStartPosition: 0..2031, set at pre-compile  # Position of PDU counter expressed in bits from start position of data content / I-PDUカウンタ開始位置。 | of I-PDU (SDU). Note that PDU counter is not allowed to cross a byte border. The parameter ComIPduCounterStartPosition shall define the bit0 of the first byte like in little endian byte order.
          integer ComIPduCounterThreshold [0..1]: 0..255, set at pre-compile, default-value=0  # Threshold value of I-PDU counter algorithm, see COM590. / I-PDUカウンタ閾値。
        container ComIPduReplication [0..1]  # This optional container contains the information needed for each I-PDU replicated. / I-PDU複製の設定に関するコンテナ。
          integer ComIPduReplicationQuorum: 1..3, set at pre-compile  # The number of identical I-PDUs needed for successful voting. / I-PDU複製数。
          reference ComIPduReplicaRef [1..2]: set at pre-compile, destination=Pdu  # Reference to replicas PduR PDUs of this IPDU. / 複製するI-PDUのレプリカPDUへの参照。
        container ComTxIPdu [0..1]  # This container contains additional transmission related configuration parameters of the AUTOSAR COM module's I-PDUs. / 送信I-PDUの設定に関するコンテナ。 ※ComIPduDirectionがSENDである場合のみ設定可能なコンテナであり、その場合は必ず設定が必要となる。
          float ComMinimumDelayTime [0..1]: 0..3600, set at link in variant link-time / post-build in variant post-build / pre-compile in variant pre-compile, origin=AUTOSAR_ECUC V3.0  # Defines the Minimum Delay Time (MDT) between successive transmissions of this I-PDU in seconds. The MDT is independent of the possible different transmission modes. There is only one minimum delay time parameter for one I-PDU. The minimum delay timer is not reset by changing the transmission mode. Hence, it is not allowed to violate the minimum delay time by transmission mode changes. It is not possible to monitor the minimum delay time for I-PDUs that are requested using the Com_TriggerTransmit API. / 最少遅延時間(MDT)(秒単位)。
          enumeration ComTxIPduClearUpdateBit [0..1]: {Confirmation, Transmit, TriggerTransmit}, set at link in variant link-time / post-build in variant post-build / pre-compile in variant pre-compile  # Defines when the update-bits of signals or signal groups, contained in this I-PDU, will be cleared. / 送信I-PDUのシグナル、シグナルグループのアップデートビットクリアタイミング。 Confirmation：送信完了通知受信契機にクリア Transmit：PduR_ComTransmit()を呼び出した契機にクリア TriggerTransmit：Com_TriggerTransmit()によりIPDUがフェッチされた契機にクリア
          integer ComTxIPduUnusedAreasDefault: 0..255, set at link in variant link-time+post-build / pre-compile in variant pre-compile  # The AUTOSAR COM module fills not used areas of an I-PDU with this byte pattern. This attribute is mandatory to avoid undefined behaviour. This byte-pattern will be repeated throughout the I-PDU before any init-values or update-bits were set. / I-PDUの未使用領域のデフォルト値（バイトパターン）。
          container ComTxModeFalse [0..1]  # This container contains the configuration parameters of the AUTOSAR COM module's transmission modes in the case the ComFilter evaluates to false. / TMSの判定結果がFALSEの場合の送信モードの設定に関するコンテナ。
            container ComTxMode  # This container contains the configuration parameters of the AUTOSAR COM module's transmission modes. / 送信モードの設定に関するコンテナ。
              enumeration ComTxModeMode: {DIRECT, MIXED, NONE, PERIODIC}, set at link in variant link-time / post-build in variant post-build / pre-compile in variant pre-compile  # The available transmission modes described in [18] shall be extended by the additional mode None. / I-PDUの送信モード。 DIRECT：上位層からの要求を受けて即時に送信を行う PERIODIC：上位層からの要求を受けるが直ぐには送信を行わず、周期処理により送信を行う MIXED：DIRECTとPERIODICの両方の振る舞いをする NONE：COMモジュールで送信タイミングをコントロールせず、下位層からの要求で送信を行う | The transmission mode None shall not have any further sub-attributes in the ComTxMode object.
              integer ComTxModeNumberOfRepetitions [0..1]: 0..255, set at link in variant link-time / post-build in variant post-build / pre-compile in variant pre-compile  # Defines the number of repetitions for the transmission mode DIRECT and the event driven part of transmission mode MIXED. / 送信要求の繰り返し数。 ※0を指定する。（送信要求の繰り返しは未サポートのため）
              float ComTxModeRepetitionPeriod [0..1]: 0..3600, set at link in variant link-time / post-build in variant post-build / pre-compile in variant pre-compile  # Defines the repetition period in seconds of the multiple transmissions in case ComTxModeNumberOfRepetitions is configured greater than 1 and ComTxModeMode is configured to DIRECT or MIXED. In case of the mixed transmission mode only the event driven part is affected. / 直接N回送信の送信間隔(秒単位)。ComTxModeNumberOfRepetitionsが1以上かつ、ComTxModeModeがDIRECTまたはMIXEDの場合に有効。
              float ComTxModeTimeOffset [0..1]: 0..3600, set at link in variant link-time / post-build in variant post-build / pre-compile in variant pre-compile  # Defines the period in seconds between the start of the I-PDU by Com_IpduGroupControl and the first transmission request in case ComTxModeMode is configured to PERIODIC or MIXED. In case of the mixed transmission mode only the periodic part is affected. / 送信デッドラインモニタリングのタイムアウト値[sec]。 ※ComTxTimeBaseで割り切れること。
              float ComTxModeTimePeriod [0..1]: 0..3600, set at link in variant link-time / post-build in variant post-build / pre-compile in variant pre-compile  # Defines the repetition period in seconds of the periodic transmission requests in case ComTxModeMode is configured to PERIODIC or MIXED. In case of the mixed transmission mode only the periodic part is affected. / 周期送信の周期時間[sec]。 ※ComTxTimeBaseで割り切れること。 ※ComTxModeModeがPERIODICまたはMIXEDの場合、設定が必須となる。
          container ComTxModeTrue  # This container contains the configuration parameters of the AUTOSAR COM module's transmission modes in the case the ComFilter evaluates to true. / TMSの判定結果がTRUEの場合の送信モードの設定に関するコンテナ。
            container ComTxMode  # This container contains the configuration parameters of the AUTOSAR COM module's transmission modes. / 送信モードの設定に関するコンテナ。
              enumeration ComTxModeMode: {DIRECT, MIXED, NONE, PERIODIC}, set at link in variant link-time / post-build in variant post-build / pre-compile in variant pre-compile  # The available transmission modes described in [18] shall be extended by the additional mode None. / I-PDUの送信モード。 DIRECT：上位層からの要求を受けて即時に送信を行う PERIODIC：上位層からの要求を受けるが直ぐには送信を行わず、周期処理により送信を行う MIXED：DIRECTとPERIODICの両方の振る舞いをする NONE：COMモジュールで送信タイミングをコントロールせず、下位層からの要求で送信を行う | The transmission mode None shall not have any further sub-attributes in the ComTxMode object.
              integer ComTxModeNumberOfRepetitions [0..1]: 0..0, set at link in variant link-time / post-build in variant post-build / pre-compile in variant pre-compile  # Defines the number of repetitions for the transmission mode DIRECT and the event driven part of transmission mode MIXED. / 送信要求の繰り返し数。 ※0を指定する。（送信要求の繰り返しは未サポートのため）
              float ComTxModeRepetitionPeriod [0..1]: 0..3600, set at link in variant link-time / post-build in variant post-build / pre-compile in variant pre-compile  # Defines the repetition period in seconds of the multiple transmissions in case ComTxModeNumberOfRepetitions is configured greater than 1 and ComTxModeMode is configured to DIRECT or MIXED. In case of the mixed transmission mode only the event driven part is affected. / 直接N回送信の送信間隔(秒単位)。ComTxModeNumberOfRepetitionsが1以上かつ、ComTxModeModeがDIRECTまたはMIXEDの場合に有効。
              float ComTxModeTimeOffset [0..1]: 0..3600, set at link in variant link-time / post-build in variant post-build / pre-compile in variant pre-compile  # Defines the period in seconds between the start of the I-PDU by Com_IpduGroupControl and the first transmission request in case ComTxModeMode is configured to PERIODIC or MIXED. In case of the mixed transmission mode only the periodic part is affected. / 送信デッドラインモニタリングのタイムアウト値[sec]。 ※ComTxTimeBaseで割り切れること。
              float ComTxModeTimePeriod [0..1]: 0..3600, set at link in variant link-time / post-build in variant post-build / pre-compile in variant pre-compile  # Defines the repetition period in seconds of the periodic transmission requests in case ComTxModeMode is configured to PERIODIC or MIXED. In case of the mixed transmission mode only the periodic part is affected. / 周期送信の周期時間[sec]。 ※ComTxTimeBaseで割り切れること。 ※ComTxModeModeがPERIODICまたはMIXEDの場合、設定が必須となる。
      container ComIPduGroup [1..65535]  # Contains the configuration parameters of the AUTOSAR COM module's I-PDU groups. / I-PDUグループの設定に関するコンテナ。
        integer ComIPduGroupHandleId: 0..65535, set at link in variant link-time+post-build / pre-compile in variant pre-compile, symbolic-name-value=true  # The numerical value used as the ID of this I-PDU Group . / I-PDUグループID。 | The ComIPduGroupHandleId is required by the API calls to start and stop I-PDU Groups. Range: 0 .. (ComSupportedIPduGroups-1)
        reference ComIPduGroupGroupRef [0..65535]: set at link in variant link-time / post-build in variant post-build / pre-compile in variant pre-compile, destination=ComIPduGroup  # References to all I-PDU groups that includes this I-PDU group. If this reference is omitted this I-PDU group does not belong to another I-PDU group. / 所属するI-PDUグループの参照。
      container ComSignal [0..65535]  # Contains the configuration parameters of the AUTOSAR COM module's signals. / シグナル毎の設定に関するコンテナ。
        integer ComBitPosition: 0..63, set at link in variant link-time / post-build in variant post-build / pre-compile in variant pre-compile  # Starting position within the I-PDU. This parameter refers to the position in the I-PDU and not in the shadow buffer. If the endianness conversion is configured to Opaque the parameter ComBitPosition shall define the bit0 of the first byte like in little endian byte order / ゲートウェイ先シグナルのI-PDU内でのビット位置。
        integer ComBitSize [0..1]: 0..64, set at link in variant link-time / post-build in variant post-build / pre-compile in variant pre-compile  # Size in bits, for non-array signal types. / ゲートウェイ元シグナルのビットサイズ。 ComSignalTypeがUINT8_NまたはUINT8_DYNの場合は無効。 | For ComSignalType UINT8_N and UINT8_DYN this size shall be configured by ComSignalLength.
        enumeration ComDataInvalidAction [0..1]: {NOTIFY, REPLACE}, set at link in variant link-time+post-build / pre-compile in variant pre-compile  # This parameter defines the action performed upon reception of an invalid signal. / シグナルの無効値を受信した場合の処理。 NOTIFY：無効値受信通知用Callback関数呼び出し REPLACE：初期値に置き換え | Relating to signal groups the action in case if one of the included signals is an invalid signal. If Replace is used the ComSignalInitValue will be used for the replacement.
        function name ComErrorNotification [0..1]: set at link in variant link-time+post-build / pre-compile in variant pre-compile  # Only valid on sender side: Name of Com_CbkTxErr callback function to be called. / シグナルのエラー通知のためのCallback関数。 | If this parameter is omitted no error notification shall take place.
        float ComFirstTimeout [0..1]: 0..3600, set at link in variant link-time+post-build / pre-compile in variant pre-compile  # Defines the length of the first deadline monitoring timeout period in seconds. This timeout is used immediately after start (or restart) of the deadline monitoring service. The timeout period of the successive periods is configured by COM263_Conf. / 受信シグナルの初回タイムアウト値[sec]。 ※親コンテナを参照するComIPduのComIPduDirectionがRECEIVEの場合、ComTxTimeBaseで割り切れること。
        integer ComHandleId: 0..65535, set at link in variant link-time+post-build / pre-compile in variant pre-compile, symbolic-name-value=true  # The numerical value used as the ID. / シグナルのハンドルID。 ※0ベースの連続値を指定する。 ※ComBitSizeが0の受信シグナルのComHandleIdは同一I-PDU内のComBitSizeが1以上の受信シグナルのComHandleIdより大きな値を設定する。 | For signals it is required by the API calls Com_UpdateShadowSignal, Com_ReceiveShadowSignal and Com_InvalidateShadowSignal. For signals groups it is required by the Com_SendSignalGroup and Com_ReceiveSignalGroup calls.
        function name ComInvalidNotification [0..1]: set at link in variant link-time+post-build / pre-compile in variant pre-compile  # Only valid on receiver side: Name of Com_CbkInv callback function to be called. Name of the function which notifies the RTE about the reception of an invalidated signal/ signal group. Only applicable if ComDataInvalidAction is configured to NOTIFY. / シグナルの無効通知受信を通知するためのCallback関数名。
        function name ComNotification [0..1]: set at link in variant link-time+post-build / pre-compile in variant pre-compile, max-length=255  # On sender side: Name of Com_CbkTxAck callback function to be called. / シグナルの送信完了通知または受信通知のためのCallback関数名。 | On receiver side: Name of Com_CbkRxAck callback function to be called. If this parameter is omitted no notification shall take place.
        enumeration ComRxDataTimeoutAction [0..1]: {NONE, REPLACE}, set at link in variant link-time+post-build / pre-compile in variant pre-compile  # This parameter defines the action performed upon expiration of the reception deadline monitoring timer. / シグナル受信タイムアウト時の処理。 NONE：何もしない REPLACE：初期値に置き換え
        string ComSignalDataInvalidValue [0..1]: set at link in variant link-time+post-build / pre-compile in variant pre-compile  # Defines the data invalid value of the signal. / シグナルの無効値。 | In case the ComSignalType is UINT8, UINT16, UINT32, SINT8, SINT16, SINT32 the string shall be interpreted as defined in the chapter Integer Type in the AUTOSAR EcuC specification. In case the ComSignalType is FLOAT32, FLOAT64 the string shall be interpreted as defined in the chapter Float Type in the AUTOSAR EcuC specification. In case the ComSignalType is BOOLEAN the string shall be interpreted as defined in the chapter Boolean Type in the AUTOSAR EcuC specification. In case the ComSignal is a UINT8_N, UINT6_DYN the string shall be interpreted as a decimal representation of the characters separated by blanks, e.g. "97 98 100" means a string "abd", where the char "a" is in byte 0(lowest address), "b" is in byte 1, and "d" is in byte 2 and (highest address).
        enumeration ComSignalEndianness: {BIG_ENDIAN, LITTLE_ENDIAN, OPAQUE}, set at link in variant link-time / post-build in variant post-build / pre-compile in variant pre-compile  # Defines the endianness of the signal's network representation. / ゲートウェイ先シグナルのエンディアン。 BIG_ENDIAN：ビッグエンディアン LITTLE_ENDIAN：リトルエンディアン OPAQUE：オペーク
        string ComSignalInitValue [0..1]: set at link in variant link-time / post-build in variant post-build / pre-compile in variant pre-compile, default-value=0  # Initial value for this signal. The default value is 0. / ゲートウェイ先シグナルの初期値。デフォルト値は0。 | In case the ComSignalType is UINT8, UINT16, UINT32, SINT8, SINT16, SINT32 the string shall be interpreted as defined in the chapter Integer Type in the AUTOSAR EcuC specification. In case the ComSignalType is FLOAT32, FLOAT64 the string shall be interpreted as defined in the chapter Float Type in the AUTOSAR EcuC specification. In case the ComSignalType is BOOLEAN the string shall be interpreted as defined in the chapter Boolean Type in the AUTOSAR EcuC specification. In case the ComSignal is a UINT8_N, UINT6_DYN the string shall be interpreted as a decimal representation of the characters separated by blanks, e.g. "97 98 100" means a string "abd", where the char "a" is in byte 0(lowest address), "b" is in byte 1, and "d" is in byte 2 and (highest address).
        integer ComSignalLength [0..1]: 1..4095, set at link in variant link-time+post-build / pre-compile in variant pre-compile  # Description: / ゲートウェイ元シグナルの長さ(byte)。 ComSignalTypeがUINT8_NまたはUINT8_DYNの場合に有効。 範囲 1..8：CANまたはLIN通信するI-PDUの場合 1..254：FlexRay通信するI-PDUの場合 1..4095：TP通信するI-PDUの場合 | For ComSignalType UINT8_N this parameter specifies the length n in bytes. For ComSignalType UINT8_DYN it specifies the maximum length in bytes. For all other types this parameter shall be ignored. Range: 0..8 for normal CAN/ LIN I-PDUs, 0..254 for normal FlexRay I-PDUs, and 0..4095 for I-PDUs with ComIPduType TP.
        enumeration ComSignalType: {BOOLEAN, FLOAT32, FLOAT64, SINT16, SINT32, SINT8, UINT16, UINT32, UINT8, UINT8_N}, set at link in variant link-time / post-build in variant post-build / pre-compile in variant pre-compile  # The AUTOSAR type of the signal. Whether or not the signal is signed or unsigned can be found by examining the value of this attribute. / ゲートウェイ元シグナルの型。 BOOLEAN：boolean FLOAT32：浮動小数点(32bit) FLOAT64：浮動小数点(64bit) SINT8：符号あり整数(8bit) SINT16：符号あり整数(16bit) SINT32：符号あり整数(32bit) UINT8：符号なし整数(8bit) UINT16：符号なし整数(16bit) UINT32：符号なし整数(32bit) UINT8_N：配列(8bit) UINT8_DYN：可変長配列(bit) | This type could also be used to reserved appropriate storage in AUTOSAR COM.
        float ComTimeout [0..1]: 0..3600, set at link in variant link-time / post-build in variant post-build / pre-compile in variant pre-compile  # Defines the length of the deadline monitoring timeout period in seconds. The period for the first timeout period can be configured separately by COM183_Conf. / シグナルのタイムアウト値[sec]。 ※ComTxTimeBaseで割り切れること。
        function name ComTimeoutNotification [0..1]: set at link in variant link-time+post-build / pre-compile in variant pre-compile, max-length=255  # On sender side: Name of Com_CbkTxTOut callback function to be called. / タイムアウト通知の関数名。 ※親コンテナを参照するComIPduのComIPduDirectionがSEND、且つ、ComTimeoutが設定されている場合、設定が必須となる。 | On receiver side: Name of Com_CbkRxTOut callback function to be called.
        enumeration ComTransferProperty [0..1]: {PENDING, TRIGGERED}, set at link in variant link-time / post-build in variant post-build / pre-compile in variant pre-compile  # Defines if a write access to this signal can trigger the transmission of the corresponding I-PDU. If the I-PDU is triggered, depends also on the transmission mode of the corresponding I-PDU. / ゲートウェイ先シグナルの送信プロパティ。 PENDING：シグナルのライトが発生しても、所属I-PDUの送信(繰り返しあり)トリガにしない。周期送信のみ。 TRIGGERED：シグナルのライトが発生した場合、所属I-PDUの送信(繰り返しあり)トリガにする。 TRIGGERED_ON_CHANGE：シグナルのライトが発生した場合、前回値と異なる場合は所属I-PDUの送信(繰り返しあり)トリガにする。 TRIGGERED_WITHOUT_REPETITION：シグナルのライトが発生した場合、所属I-PDUの送信(繰り返しなし)トリガにする。 TRIGGERED_ON_CHANGE_WITHOUT_REPETITION：シグナルのライトが発生した場合、前回値と異なる場合は所属I-PDUの送信(繰り返しなし)トリガにする。
        integer ComUpdateBitPosition [0..1]: 0..2031, set at link in variant link-time / post-build in variant post-build / pre-compile in variant pre-compile  # Bit position of update-bit inside I-PDU. / ゲートウェイ先シグナルのアップデートビット位置。 範囲 0..63：CANまたはLIN通信するI-PDUの場合 0..2031：FlexRay通信するI-PDUの場合 | If this attribute is omitted then there is no update-bit. This setting must be consistently on sender and on receiver side. Range: 0..63 for CAN and LIN 0..2031 for FlexRay
        foreign reference ComSystemTemplateSystemSignalRef [0..1]: set at link in variant link-time / post-build in variant post-build / pre-compile in variant pre-compile, destination-type=I-SIGNAL-TO-I-PDU-MAPPING  # Reference to the ISignalToIPduMapping that contains a reference to the ISignal (System Template) which this ComSignal (or ComGroupSignal) represents.
        container ComFilter [0..1]  # This container contains the configuration parameters of the AUTOSAR COM module's Filters. / Comモジュールのフィルタ設定に関する情報。 | Note: On sender side the container is used to specify the transmission mode conditions.
          enumeration ComFilterAlgorithm: {ALWAYS, MASKED_NEW_DIFFERS_MASKED_OLD, MASKED_NEW_DIFFERS_X, MASKED_NEW_EQUALS_X, NEVER, NEW_IS_OUTSIDE, NEW_IS_WITHIN, ONE_EVERY_N}, set at link in variant link-time+post-build / pre-compile in variant pre-compile  # The range of values is specified in the [17] specification, chapter 2.2.2, Reception Filtering. / フィルタのアルゴリズム。 ALWAYS：フィルタ結果は常にTRUE MASKED_NEW_DIFFERS_MASKED_OLD：マスクした今回値とマスクした前回値が異なる場合にTRUE MASKED_NEW_DIFFERS_X：マスクした今回値とXが異なる場合にTRUE MASKED_NEW_EQUALS_X：マスクした今回値とXが同じ場合にTRUE NEVER：フィルタ結果は常にFALSE NEW_IS_OUTSIDE：今回値が範囲外である場合にTRUE NEW_IS_WITHIN：今回値が範囲内である場合にTRUE ONE_EVERY_N：N回フィルタされる度に1回TRUE
          integer ComFilterMask [0..1]: 0..18446744073709551615, set at link in variant link-time+post-build / pre-compile in variant pre-compile  # The name of this attribute corresponds to the parameter name in the [17] specification of Reception Filtering. / フィルタのマスク値。ComFilterAlgorithmがMASKED_NEW_DIFFERS_MASKED_OLD、MASKED_NEW_DIFFERS_X、MASKED_NEW_EQUALS_Xのいずれかの場合に有効。
          integer ComFilterMax [0..1]: 0..18446744073709551615, set at link in variant link-time+post-build / pre-compile in variant pre-compile  # The name of this attribute corresponds to the parameter name in the [17] specification of Reception Filtering. / フィルタの範囲チェック最大値。ComFilterAlgorithmがNEW_IS_OUTSIDE、NEW_IS_WITHINのいずれかの場合に有効。
          integer ComFilterMin [0..1]: 0..18446744073709551615, set at link in variant link-time+post-build / pre-compile in variant pre-compile  # The name of this attribute corresponds to the parameter name in the [17] specification of Reception Filtering. / フィルタの範囲チェック最少値。ComFilterAlgorithmがNEW_IS_OUTSIDE、NEW_IS_WITHINのいずれかの場合に有効。
          integer ComFilterOffset [0..1]: 0..18446744073709551615, set at link in variant link-time+post-build / pre-compile in variant pre-compile  # The name of this attribute corresponds to the parameter name in the [17] specification of Reception Filtering. / フィルタのオフセット。ComFilterAlgorithmがONE_EVERY_Nの場合に有効。 | Range = 0..(ComFilterPeriod-1)
          integer ComFilterPeriod [0..1]: 0..18446744073709551615, set at link in variant link-time / post-build in variant post-build / pre-compile in variant pre-compile  # This parameter defines the period of the ComFilterAlgorithm ONE_EVERY_N. / フィルタの通過周期。ComFilterAlgorithmがONE_EVERY_Nの場合に有効。
          integer ComFilterX [0..1]: 0..18446744073709551615, set at link in variant link-time+post-build / pre-compile in variant pre-compile  # The name of this attribute corresponds to the parameter name in the [17] specification of Reception Filtering. / フィルタのXの値。ComFilterAlgorithmがMASKED_NEW_DIFFERS_X、MASKED_NEW_EQUALS_Xのいずれかの場合に有効。
      container ComSignalGroup [0..*]  # Contains the configuration parameters of the AUTOSAR COM module's signal groups. / シグナルグループの設定に関するコンテナ。
        enumeration ComDataInvalidAction [0..1]: {NOTIFY, REPLACE}, set at link in variant link-time+post-build / pre-compile in variant pre-compile  # This parameter defines the action performed upon reception of an invalid signal. / シグナルの無効値を受信した場合の処理。 NOTIFY：無効値受信通知用Callback関数呼び出し REPLACE：初期値に置き換え | Relating to signal groups the action in case if one of the included signals is an invalid signal. If Replace is used the ComSignalInitValue will be used for the replacement.
        function name ComErrorNotification [0..1]: set at link in variant link-time+post-build / pre-compile in variant pre-compile  # Only valid on sender side: Name of Com_CbkTxErr callback function to be called. / シグナルのエラー通知のためのCallback関数。 | If this parameter is omitted no error notification shall take place.
        float ComFirstTimeout [0..1]: 0..3600, set at link in variant link-time+post-build / pre-compile in variant pre-compile  # Defines the length of the first deadline monitoring timeout period in seconds. This timeout is used immediately after start (or restart) of the deadline monitoring service. The timeout period of the successive periods is configured by COM263_Conf. / 受信シグナルの初回タイムアウト値[sec]。 ※親コンテナを参照するComIPduのComIPduDirectionがRECEIVEの場合、ComTxTimeBaseで割り切れること。
        integer ComHandleId: 0..65535, set at link in variant link-time+post-build / pre-compile in variant pre-compile, symbolic-name-value=true  # The numerical value used as the ID. / シグナルのハンドルID。 ※0ベースの連続値を指定する。 ※ComBitSizeが0の受信シグナルのComHandleIdは同一I-PDU内のComBitSizeが1以上の受信シグナルのComHandleIdより大きな値を設定する。 | For signals it is required by the API calls Com_UpdateShadowSignal, Com_ReceiveShadowSignal and Com_InvalidateShadowSignal. For signals groups it is required by the Com_SendSignalGroup and Com_ReceiveSignalGroup calls.
        function name ComInvalidNotification [0..1]: set at link in variant link-time+post-build / pre-compile in variant pre-compile  # Only valid on receiver side: Name of Com_CbkInv callback function to be called. Name of the function which notifies the RTE about the reception of an invalidated signal/ signal group. Only applicable if ComDataInvalidAction is configured to NOTIFY. / シグナルの無効通知受信を通知するためのCallback関数名。
        function name ComNotification [0..1]: set at link in variant link-time+post-build / pre-compile in variant pre-compile  # On sender side: Name of Com_CbkTxAck callback function to be called. / シグナルの送信完了通知または受信通知のためのCallback関数名。 | On receiver side: Name of Com_CbkRxAck callback function to be called. If this parameter is omitted no notification shall take place.
        enumeration ComRxDataTimeoutAction [0..1]: {NONE, REPLACE}, set at link in variant link-time+post-build / pre-compile in variant pre-compile  # This parameter defines the action performed upon expiration of the reception deadline monitoring timer. / シグナル受信タイムアウト時の処理。 NONE：何もしない REPLACE：初期値に置き換え
        float ComTimeout [0..1]: 0..3600, set at link in variant link-time / post-build in variant post-build / pre-compile in variant pre-compile  # Defines the length of the deadline monitoring timeout period in seconds. The period for the first timeout period can be configured separately by COM183_Conf. / シグナルのタイムアウト値[sec]。 ※ComTxTimeBaseで割り切れること。
        function name ComTimeoutNotification [0..1]: set at link in variant link-time+post-build / pre-compile in variant pre-compile  # On sender side: Name of Com_CbkTxTOut callback function to be called. / タイムアウト通知の関数名。 ※親コンテナを参照するComIPduのComIPduDirectionがSEND、且つ、ComTimeoutが設定されている場合、設定が必須となる。 | On receiver side: Name of Com_CbkRxTOut callback function to be called.
        enumeration ComTransferProperty [0..1]: {PENDING, TRIGGERED, TRIGGERED_ON_CHANGE, TRIGGERED_ON_CHANGE_WITHOUT_REPETITION, TRIGGERED_WITHOUT_REPETITION}, set at link in variant link-time / post-build in variant post-build / pre-compile in variant pre-compile  # Defines if a write access to this signal can trigger the transmission of the corresponding I-PDU. If the I-PDU is triggered, depends also on the transmission mode of the corresponding I-PDU. / ゲートウェイ先シグナルの送信プロパティ。 PENDING：シグナルのライトが発生しても、所属I-PDUの送信(繰り返しあり)トリガにしない。周期送信のみ。 TRIGGERED：シグナルのライトが発生した場合、所属I-PDUの送信(繰り返しあり)トリガにする。 TRIGGERED_ON_CHANGE：シグナルのライトが発生した場合、前回値と異なる場合は所属I-PDUの送信(繰り返しあり)トリガにする。 TRIGGERED_WITHOUT_REPETITION：シグナルのライトが発生した場合、所属I-PDUの送信(繰り返しなし)トリガにする。 TRIGGERED_ON_CHANGE_WITHOUT_REPETITION：シグナルのライトが発生した場合、前回値と異なる場合は所属I-PDUの送信(繰り返しなし)トリガにする。
        integer ComUpdateBitPosition [0..1]: 0..2031, set at link in variant link-time / post-build in variant post-build / pre-compile in variant pre-compile  # Bit position of update-bit inside I-PDU. / ゲートウェイ先シグナルのアップデートビット位置。 範囲 0..63：CANまたはLIN通信するI-PDUの場合 0..2031：FlexRay通信するI-PDUの場合 | If this attribute is omitted then there is no update-bit. This setting must be consistently on sender and on receiver side. Range: 0..63 for CAN and LIN 0..2031 for FlexRay
        foreign reference ComSystemTemplateSignalGroupRef [0..1]: set at link in variant link-time / post-build in variant post-build / pre-compile in variant pre-compile, destination-type=I-SIGNAL-TO-I-PDU-MAPPING  # Reference to the ISignalToIPduMapping that contains a reference to the ISignalGroup (SystemTemplate) which this ComSignalGroup represents. / システムテンプレートのシグナルグループ情報参照。
        container ComGroupSignal [0..*]  # This container contains the configuration parameters of group signals. I.e. signals that are included within a signal group. / グループシグナルの設定に関するコンテナ。
          integer ComBitPosition: 0..2031, set at link in variant link-time / post-build in variant post-build / pre-compile in variant pre-compile  # Starting position within the I-PDU. This parameter refers to the position in the I-PDU and not in the shadow buffer. If the endianness conversion is configured to Opaque the parameter ComBitPosition shall define the bit0 of the first byte like in little endian byte order / ゲートウェイ先シグナルのI-PDU内でのビット位置。
          integer ComBitSize [0..1]: 0..64, set at link in variant link-time / post-build in variant post-build / pre-compile in variant pre-compile  # Size in bits, for non-array signal types. / ゲートウェイ元シグナルのビットサイズ。 ComSignalTypeがUINT8_NまたはUINT8_DYNの場合は無効。 | For ComSignalType UINT8_N and UINT8_DYN this size shall be configured by ComSignalLength.
          integer ComHandleId: 0..65535, set at link in variant link-time+post-build / pre-compile in variant pre-compile, symbolic-name-value=true  # The numerical value used as the ID. / シグナルのハンドルID。 ※0ベースの連続値を指定する。 ※ComBitSizeが0の受信シグナルのComHandleIdは同一I-PDU内のComBitSizeが1以上の受信シグナルのComHandleIdより大きな値を設定する。 | For signals it is required by the API calls Com_UpdateShadowSignal, Com_ReceiveShadowSignal and Com_InvalidateShadowSignal. For signals groups it is required by the Com_SendSignalGroup and Com_ReceiveSignalGroup calls.
          string ComSignalDataInvalidValue [0..1]: set at link in variant link-time+post-build / pre-compile in variant pre-compile  # Defines the data invalid value of the signal. / シグナルの無効値。 | In case the ComSignalType is UINT8, UINT16, UINT32, SINT8, SINT16, SINT32 the string shall be interpreted as defined in the chapter Integer Type in the AUTOSAR EcuC specification. In case the ComSignalType is FLOAT32, FLOAT64 the string shall be interpreted as defined in the chapter Float Type in the AUTOSAR EcuC specification. In case the ComSignalType is BOOLEAN the string shall be interpreted as defined in the chapter Boolean Type in the AUTOSAR EcuC specification. In case the ComSignal is a UINT8_N, UINT6_DYN the string shall be interpreted as a decimal representation of the characters separated by blanks, e.g. "97 98 100" means a string "abd", where the char "a" is in byte 0(lowest address), "b" is in byte 1, and "d" is in byte 2 and (highest address).
          enumeration ComSignalEndianness: {BIG_ENDIAN, LITTLE_ENDIAN, OPAQUE}, set at link in variant link-time / post-build in variant post-build / pre-compile in variant pre-compile  # Defines the endianness of the signal's network representation. / ゲートウェイ先シグナルのエンディアン。 BIG_ENDIAN：ビッグエンディアン LITTLE_ENDIAN：リトルエンディアン OPAQUE：オペーク
          string ComSignalInitValue [0..1]: set at link in variant link-time / post-build in variant post-build / pre-compile in variant pre-compile, default-value=0  # Initial value for this signal. The default value is 0. / ゲートウェイ先シグナルの初期値。デフォルト値は0。 | In case the ComSignalType is UINT8, UINT16, UINT32, SINT8, SINT16, SINT32 the string shall be interpreted as defined in the chapter Integer Type in the AUTOSAR EcuC specification. In case the ComSignalType is FLOAT32, FLOAT64 the string shall be interpreted as defined in the chapter Float Type in the AUTOSAR EcuC specification. In case the ComSignalType is BOOLEAN the string shall be interpreted as defined in the chapter Boolean Type in the AUTOSAR EcuC specification. In case the ComSignal is a UINT8_N, UINT6_DYN the string shall be interpreted as a decimal representation of the characters separated by blanks, e.g. "97 98 100" means a string "abd", where the char "a" is in byte 0(lowest address), "b" is in byte 1, and "d" is in byte 2 and (highest address).
          integer ComSignalLength [0..1]: 0..4095, set at link in variant link-time+post-build / pre-compile in variant pre-compile  # Description: / ゲートウェイ元シグナルの長さ(byte)。 ComSignalTypeがUINT8_NまたはUINT8_DYNの場合に有効。 範囲 0..8：CANまたはLIN通信するI-PDUの場合 0..254：FlexRay通信するI-PDUの場合 0..4095：TP通信するI-PDUの場合 | For ComSignalType UINT8_N this parameter specifies the length n in bytes. For ComSignalType UINT8_DYN it specifies the maximum length in bytes. For all other types this parameter shall be ignored. Range: 0..8 for normal CAN/ LIN I-PDUs, 0..254 for normal FlexRay I-PDUs, and 0..4095 for I-PDUs with ComIPduType TP.
          enumeration ComSignalType: {BOOLEAN, FLOAT32, FLOAT64, SINT16, SINT32, SINT8, UINT16, UINT32, UINT8, UINT8_DYN, UINT8_N}, set at link in variant link-time / post-build in variant post-build / pre-compile in variant pre-compile  # The AUTOSAR type of the signal. Whether or not the signal is signed or unsigned can be found by examining the value of this attribute. / ゲートウェイ元シグナルの型。 BOOLEAN：boolean FLOAT32：浮動小数点(32bit) FLOAT64：浮動小数点(64bit) SINT8：符号あり整数(8bit) SINT16：符号あり整数(16bit) SINT32：符号あり整数(32bit) UINT8：符号なし整数(8bit) UINT16：符号なし整数(16bit) UINT32：符号なし整数(32bit) UINT8_N：配列(8bit) UINT8_DYN：可変長配列(bit) | This type could also be used to reserved appropriate storage in AUTOSAR COM.
          enumeration ComTransferProperty: {PENDING, TRIGGERED_ON_CHANGE}, set at link in variant link-time / post-build in variant post-build / pre-compile in variant pre-compile  # Optionally defines whether this group signal shall contribute to the TRIGGERED_ON_CHANGE transfer property of the signal group. If at least one group signal of a signal group has the "ComTransferProperty" configured all other group signals of that signal group shall have the attribute configured as well. / ゲートウェイ先シグナルの送信プロパティ。 PENDING：シグナルのライトが発生しても、所属I-PDUの送信(繰り返しあり)トリガにしない。周期送信のみ。 TRIGGERED：シグナルのライトが発生した場合、所属I-PDUの送信(繰り返しあり)トリガにする。 TRIGGERED_ON_CHANGE：シグナルのライトが発生した場合、前回値と異なる場合は所属I-PDUの送信(繰り返しあり)トリガにする。 TRIGGERED_WITHOUT_REPETITION：シグナルのライトが発生した場合、所属I-PDUの送信(繰り返しなし)トリガにする。 TRIGGERED_ON_CHANGE_WITHOUT_REPETITION：シグナルのライトが発生した場合、前回値と異なる場合は所属I-PDUの送信(繰り返しなし)トリガにする。
          foreign reference ComSystemTemplateSystemSignalRef [0..1]: set at link in variant link-time / post-build in variant post-build / pre-compile in variant pre-compile, destination-type=I-SIGNAL-TO-I-PDU-MAPPING  # Reference to the ISignalToIPduMapping that contains a reference to the ISignal (System Template) which this ComSignal (or ComGroupSignal) represents.
          container ComFilter [0..1]  # This container contains the configuration parameters of the AUTOSAR COM module's Filters. / Comモジュールのフィルタ設定に関する情報。 | Note: On sender side the container is used to specify the transmission mode conditions.
            enumeration ComFilterAlgorithm: {ALWAYS, MASKED_NEW_DIFFERS_MASKED_OLD, MASKED_NEW_DIFFERS_X, MASKED_NEW_EQUALS_X, NEVER, NEW_IS_OUTSIDE, NEW_IS_WITHIN, ONE_EVERY_N}, set at link in variant link-time+post-build / pre-compile in variant pre-compile  # The range of values is specified in the [17] specification, chapter 2.2.2, Reception Filtering. / フィルタのアルゴリズム。 ALWAYS：フィルタ結果は常にTRUE MASKED_NEW_DIFFERS_MASKED_OLD：マスクした今回値とマスクした前回値が異なる場合にTRUE MASKED_NEW_DIFFERS_X：マスクした今回値とXが異なる場合にTRUE MASKED_NEW_EQUALS_X：マスクした今回値とXが同じ場合にTRUE NEVER：フィルタ結果は常にFALSE NEW_IS_OUTSIDE：今回値が範囲外である場合にTRUE NEW_IS_WITHIN：今回値が範囲内である場合にTRUE ONE_EVERY_N：N回フィルタされる度に1回TRUE
            integer ComFilterMask [0..1]: 0..18446744073709551615, set at link in variant link-time+post-build / pre-compile in variant pre-compile  # The name of this attribute corresponds to the parameter name in the [17] specification of Reception Filtering. / フィルタのマスク値。ComFilterAlgorithmがMASKED_NEW_DIFFERS_MASKED_OLD、MASKED_NEW_DIFFERS_X、MASKED_NEW_EQUALS_Xのいずれかの場合に有効。
            integer ComFilterMax [0..1]: 0..18446744073709551615, set at link in variant link-time+post-build / pre-compile in variant pre-compile  # The name of this attribute corresponds to the parameter name in the [17] specification of Reception Filtering. / フィルタの範囲チェック最大値。ComFilterAlgorithmがNEW_IS_OUTSIDE、NEW_IS_WITHINのいずれかの場合に有効。
            integer ComFilterMin [0..1]: 0..18446744073709551615, set at link in variant link-time+post-build / pre-compile in variant pre-compile  # The name of this attribute corresponds to the parameter name in the [17] specification of Reception Filtering. / フィルタの範囲チェック最少値。ComFilterAlgorithmがNEW_IS_OUTSIDE、NEW_IS_WITHINのいずれかの場合に有効。
            integer ComFilterOffset [0..1]: 0..18446744073709551615, set at link in variant link-time+post-build / pre-compile in variant pre-compile  # The name of this attribute corresponds to the parameter name in the [17] specification of Reception Filtering. / フィルタのオフセット。ComFilterAlgorithmがONE_EVERY_Nの場合に有効。 | Range = 0..(ComFilterPeriod-1)
            integer ComFilterPeriod [0..1]: 0..18446744073709551615, set at link in variant link-time / post-build in variant post-build / pre-compile in variant pre-compile  # This parameter defines the period of the ComFilterAlgorithm ONE_EVERY_N. / フィルタの通過周期。ComFilterAlgorithmがONE_EVERY_Nの場合に有効。
            integer ComFilterX [0..1]: 0..18446744073709551615, set at link in variant link-time+post-build / pre-compile in variant pre-compile  # The name of this attribute corresponds to the parameter name in the [17] specification of Reception Filtering. / フィルタのXの値。ComFilterAlgorithmがMASKED_NEW_DIFFERS_X、MASKED_NEW_EQUALS_Xのいずれかの場合に有効。
      container ComTimeBase  # Contains the timebase parameters for Tx, Rx and routing. / 送信、受信、ルーティングのタイムベースの設定。
        float ComGwTimeBase [0..1]: 0..3600, set at link in variant link-time / post-build in variant post-build / pre-compile in variant pre-compile  # The period between successive calls to Com_MainFunctionRouteSignals in seconds. This parameter may be used by the COM generator to transform the values of the signal gateway related timing configuration parameters of the COM module to internal implementation specific counter or tick values. The COM module's internal timing handling is implementation specific. / Com_MainFunctionRouteSignals()の呼び出し周期[sec]。 | The COM module (generator) might rely on the fact that Com_MainFunctionRouteSignals is scheduled according to the value configured here.
        float ComRxTimeBase [0..1]: 0..3600, set at link in variant link-time / post-build in variant post-build / pre-compile in variant pre-compile  # The period between successive calls to Com_MainFunctionRx in seconds. This parameter may be used by the COM generator to transform the values of the reception related timing configuration parameters of the COM module to internal implementation specific counter or tick values. The COM module's internal timing handling is implementation specific. / Com_MainFunctionRxを実行する周期時間[sec]。 ※RTEのスケジューラの周期時間で割り切れること。 ※ComIPduDirectionがRECEIVE、且つ、ComIPduSignalRefで参照するComSignalコンテナのComTimeoutに値が設定されているComIPduコンテナが存在する場合、設定が必須となる。 | The COM module (generator) may rely on the fact that Com_MainFunctionRx is scheduled according to the value configured here.
        float ComTxTimeBase [0..1]: 0..3600, set at link in variant link-time / post-build in variant post-build / pre-compile in variant pre-compile  # The period between successive calls to Com_MainFunctionTx in seconds. This parameter may be used by the COM generator to transform the values of the transmission related timing configuration parameters of the COM module to internal implementation specific counter or tick values. The COM module's internal timing handling is implementation specific. / Com_MainFunctionTxを実行する周期時間[sec] 。 ※RTEのスケジューラの周期時間で割り切れること。 ※以下の条件に合致する場合、設定が必須となる。 ・ComIPduDirectionがSEND、且つ、ComIPduSignalRefにで参照するComSignalコンテナのComTimeoutに値が設定されているComIPduコンテナが存在する場合 ・ComIPduDirectionがSEND、且つ、ComTxModeModeがMIXEDもしくはPERIODICのComIPduコンテナが存在する場合 | The COM module (generator) may rely on the fact that Com_MainFunctionTx is scheduled according to the value configured here.
    container ComGeneral  # Contains the general configuration parameters of the module. / Comモジュールのジェネラルパラメータ。
      boolean ComConfigurationUseDet: set at pre-compile  # The error hook shall contain code to call the Det. / 開発エラー検出および通知の有効/無効情報。 TRUE：有効 FALSE：無効 | If this parameter is configured COM_DEV_ERROR_DETECT shall be set to ON as output of the configuration tool. (as input for the source code), see COM028.
      boolean ComEnableMDTForCyclicTransmission [0..1]: set at pre-compile, default-value=true  # Enables globally for the whole Com module the minimum delay time monitoring for cyclic and repeated transmissions (ComTxModeMode=PERIODIC or ComTxModeMode=MIXED for the cyclic transmissions, ComTxModeNumberOfRepetitions > 0 for repeated transmissions). / 周期送信のMDTの使用有効/無効情報。 TRUE：MDT有効 FALSE：MDT無効
      boolean ComRetryFailedTransmitRequests [0..1]: set at pre-compile, default-value=true  # If this Parameter is set to true, retry of failed transmission requests is enabled. If this Parameter is not present, the default value is assumed. / 失敗した送信の再要求機能の設定。 再要求機能は未サポートのため、FALSEを設定してください。
      integer ComSupportedIPduGroups: 0..65535, set at pre-compile  # Defines the maximum number of supported I-PDU groups. / I-PDUグループの最大数。
      boolean ComVersionInfoApi: set at pre-compile  # Activate/Deactivate the version information API (Com_GetVersionInfo). / バージョン情報取得サービスの有効/無効情報。 バージョン情報取得サービスCom_GetVersionInfoは未サポートのためFALSEを指定してください。 | True: version information API activated False: version information API deactivated
      enumeration ComBaseGenerationOptimizationLevel [0..1]: {COMMON, INDIVIDUAL, PATTERN}, set at pre-compile, origin=eSOL  # Base optimization level of the Packing/Unpacking processing. / パッキング/アンパッキング処理の最適化レベルのベース値。 COMMON/PATTERN/INDIVIDUALから選択してください。
      boolean ComTriggerTransmitApi [0..1]: set at pre-compile, origin=eSOL, default-value=true  # Activate/Deactivate the trigger transmit API (Com_TriggerTransmit). / トリガ送信サービスCom_TriggerTransmitの有効/無効情報。 ComTxModeMode が1つ以上にNONE設定されている場合、TRUEを設定してください。 | True: trigger transmit API activated False: trigger transmit API deactivated
      enumeration ComMcuEndianness: {BIG_ENDIAN, LITTLE_ENDIAN}, set at pre-compile, origin=eSOL  # Defines the endianness of the ECU.
    container ComGeneration [0..1]  # Optimization level individual setting of the Packing/Unpacking processing. / パッキング/アンパッキング処理の最適化レベルの個別設定に関するコンテナ。
      container ComPackingOptimizationLevelCommon [0..1]  # Contains the signal configuration parameters of optimization level COMMON. / パッキング処理の最適化レベルがCOMMONの場合の設定に関するコンテナ。
        reference ComPackingOptimizationLevelCommonSignalRef [0..65535]: set at pre-compile, origin=eSOL, destination=ComSignal  # Reference to the ComSignal. / ComSignal参照。
        reference ComPackingOptimizationLevelCommonSignalGroupRef [0..65535]: set at pre-compile, origin=eSOL, destination=ComSignalGroup  # Reference to the ComSignalGroup. / ComSignalGroup参照。
      container ComPackingOptimizationLevelIndividual [0..1]  # Contains the signal configuration parameters of optimization level INDIVIDUAL. / パッキング処理の最適化レベルがINDIVIDUALの場合の設定に関するコンテナ。
        reference ComPackingOptimizationLevelIndividualSignalRef [0..65535]: set at pre-compile, origin=eSOL, destination=ComSignal  # Reference to the ComSignal. / ComSignal参照。
        reference ComPackingOptimizationLevelIndividualSignalGroupRef [0..65535]: set at pre-compile, origin=eSOL, destination=ComSignalGroup  # Reference to the ComSignalGroup. / ComSignalGroup参照。
      container ComPackingOptimizationLevelPattern [0..1]  # Contains the signal configuration parameters of optimization level PATTERN. / パッキング処理の最適化レベルがPATTERNの場合の設定に関するコンテナ。
        reference ComPackingOptimizationLevelPatternSignalRef [0..65535]: set at pre-compile, origin=eSOL, destination=ComSignal  # Reference to the ComSignal. / ComSignal参照。
        reference ComPackingOptimizationLevelPatternSignalGroupRef [0..65535]: set at pre-compile, origin=eSOL, destination=ComSignalGroup  # Reference to the ComSignalGroup. / ComSignalGroup参照。
      container ComUnpackingOptimizationLevelCommon [0..1]  # Contains the IPdu configuration parameters of optimization level COMMON. / アンパッキング処理の最適化レベルがCOMMONの場合の設定に関するコンテナ。
        reference ComUnpackingOptimizationLevelCommonPduRef [0..65535]: set at pre-compile, origin=eSOL, destination=ComIPdu  # Reference to the ComIPdu. / ComIPdu参照。
      container ComUnpackingOptimizationLevelIndividual [0..1]  # Contains the IPdu configuration parameters of optimization level INDIVIDUAL. / アンパッキング処理の最適化レベルがINDIVIDUALの場合の設定に関するコンテナ。
        reference ComUnpackingOptimizationLevelIndividualPduRef [0..65535]: set at pre-compile, origin=eSOL, destination=ComIPdu  # Reference to the ComIPdu. / ComIPdu参照。
      container ComUnpackingOptimizationLevelPattern [0..1]  # Contains the IPdu configuration parameters of optimization level PATTERN / アンパッキング処理の最適化レベルがPATTERNの場合の設定に関するコンテナ。
        reference ComUnpackingOptimizationLevelPatternPduRef [0..65535]: set at pre-compile, origin=eSOL, destination=ComIPdu  # Reference to the ComIPdu. / ComIPdu参照。

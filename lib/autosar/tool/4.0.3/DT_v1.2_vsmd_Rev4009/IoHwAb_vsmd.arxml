AUTOSAR XML (schema 4-1-1)
package /QINeS
  ecuc definition collection AUTOSARParameterDefinition: module=IoHwAb
  module definition IoHwAb [0..1]: refined-module-def=IoHwAb, variants pre-compile  # Configuration of the IoHwAb (Runtime Environment 2) module. / IoHwAbモジュールのコンフィグレーション。
    container IoHwAbPwmConvFactor [0..1]  # - / ユーザーの指定した周期値をPWMドライバの単位に変換するマクロで使用する変換テーブル。（0..65535）
      integer ConvMcalValue [1..256]: 0..65535, set at pre-compile, origin=QINeS  # - / MCALのチャネルごとのTick変換用の倍率。 MAX=255 MIN=0
    container IoHwAbGptConvFactor [0..1]  # - / ユーザーの指定した周期値をPWMドライバの単位に変換するマクロで使用する変換テーブル。（0..65535）
      integer GptConvFactorValue [1..65535]: 0..65535, set at pre-compile, origin=QINeS  # -
    container IoHwAbIcuConvFactor [0..1]  # - / ユーザーの指定した周期値をPWMドライバの単位に変換するマクロで使用する変換テーブル。（0..65535）
      integer IcuConvFactorValue [1..65535]: 0..65535, set at pre-compile, origin=QINeS  # -
    container IoHwAbQAdcConfig  # - / このコンテナはIoHwAb_Adcの構成パラメータを設定する。
      integer IoHwAbAdcNumOfConfigSet: 0..256, set at pre-compile, origin=QINeS, scope=ECU  # - / IoHwAb_Adcで、コンフィグレーションされるIoHwAb_Q_AdcConfSetの数（Elementの数）。
      container IoHwAbQAdcConfigSet [0..256]  # This is the base container that contains the post-build selectable configuration parameters / Element管理のコンテナのアドレスを指定する。IoHwAbAdcConfigSetの先頭アドレスを設定すること。
        enumeration Access: {IOHWAB_Q_ADC_ACCESS_HW_ONE_SINGLE, IOHWAB_Q_ADC_ACCESS_HW_MULTI_SINGLE, IOHWAB_Q_ADC_ACCESS_HW_ONE_CIRSTREAM, IOHWAB_Q_ADC_ACCESS_HW_ONE_LINSTREAM, IOHWAB_Q_ADC_ACCESS_SW_ONE_POLLING, IOHWAB_Q_ADC_ACCESS_SW_MULTI_POLLING, IOHWAB_Q_ADC_ACCESS_SW_ONE_SINGLE, IOHWAB_Q_ADC_ACCESS_SW_MULTI_SINGLE, IOHWAB_Q_ADC_ACCESS_SW_ONE_CIRSTREAM, IOHWAB_Q_ADC_ACCESS_SW_ONE_LINSTREAM}, set at pre-compile, origin=QINeS, scope=ECU  # - / アクセス種別を指定すること。 IOHWAB_Q_ADC_ACCESS_HW_ONE_SINGLE：ハードウェアトリガにより1回のみ変換が実施される信号。変換完了をトリガに通知される。ADCドライバのハードウェアトリガ・シングルアクセス設定信号を対象とする。（単一変換方式のみ可能） IOHWAB_Q_ADC_ACCESS_HW_MULTI_SINGLE：ハードウェアトリガにより停止が指示されるまで何度も変換が実施される信号。変換完了をトリガ毎に通知される。ADCドライバのハードウェアトリガ・シングルアクセス設定信号を対象とする。（連続変換方式のみ対象） IOHWAB_Q_ADC_ACCESS_HW_ONE_CURSTREAM：ハードウェアトリガによりバッファフルになるまでデータを蓄積する信号。バッファフルの際にADCドライバステータス（A/D変換状況）をユーザーに通知する。Adc_GetStreamLastPointerもしくは Adc_ReadGroupを呼ぶことで変換が再開される。ADCドライバのハードウェアトリガ・ストリーミングアクセス（サイクルバッファ方式）設定信号を対象とする。（単一変換方式のみ対象） IOHWAB_Q_ADC_ACCESS_HW_ONE_LINSTREAM：ハードウェアトリガによりバッファフルになるまでデータを蓄積する信号。バッファフルの際に通知されSW-Cからの指示によるAdc_EnableHardwareTriggerを呼ぶことで変換が再開される。ADCドライバのハードウェアトリガ・ストリーミングアクセス（リニアバッファ方式）設定信号を対象とする。（単一変換方式のみ対象） IOHWAB_Q_ADC_ACCESS_SW_ONE_POLLING：ソフトウェアトリガにより1回のみ変換が実施される信号。周期処理にて変換完了を監視する。ADCドライバのソフトウェアトリガ・シングルアクセス設定信号を対象とする。（単一変換方式のみ対象） IOHWAB_Q_ADC_ACCESS_SW_MULTI_POLLING：ソフトウェアトリガにより停止が指示されるまで周期処理毎に何度でも変換が実施される信号。（IoHwAb_AdcでADCドライバにA/D値を読みに行くことをトリガにして、自動的に変換が開始される。）ADCドライバのソフトウェアトリガ・シングルアクセス設定信号を対象とする。（連続変換方式のみ対象） IOHWAB_Q_ADC_ACCESS_SW_ONE_SINGLE：ソフトウェアトリガにより1回のみ変換が実施される信号。変換完了をトリガに通知される。ADCドライバのソフトウェアトリガ・シングルアクセス設定信号を対象とする。（単一変換方式のみ対象） IOHWAB_Q_ADC_ACCESS_SW_MULTI_SINGLE：ソフトウェアトリガにより停止されるまで何度も変換が実施される信号。変換完了トリガ毎に通知される。ADCドライバのソフトウェアトリガ・シングルアクセス設定信号を対象とする。（連続変換方式のみ対象） IOHWAB_Q_ADC_ACCESS_SW_ONE_CURSTREAM：初回のみソフトウェアトリガ、2回目以降は循環バッファにデータが蓄積されるタイミングをトリガとする信号。循環バッファが満たされた時に通知される。ADCドライバのソフトウェアトリガ・ストリーミングアクセス（サイクルバッファ方式）設定信号を対象とする。（連続変換方式のみ対象） IOHWAB_Q_ADC_ACCESS_SW_ONE_LINSTREAM：初回のみソフトウェアトリガ、2回目以降は直列バッファにデータが蓄積されるタイミングをトリガとする信号。直列バッファが満たされた時に通知される。ADCドライバのソフトウェアトリガ・ストリーミングアクセス（リニアバッファ方式）設定信号を対象とする。（連続変換方式のみ対象）
        enumeration Fatalrecover: {IOHWAB_Q_ADC_ERROR_NORETRY, IOHWAB_Q_ADC_ERROR_RETRY}, set at pre-compile, origin=QINeS, scope=ECU, default-value=0  # - / リードまたは変換失敗時のリトライの有無。 IOHWAB_Q_ADC_ERROR_NORETRY(0)：リトライなし IOHWAB_Q_ADC_ERROR_RETRY(1)：リトライあり
        integer Groupid: 0..4294967295, set at pre-compile, origin=QINeS, scope=ECU  # Numeric ID of the group. This parameter is the symbolic name to be used on the API. This symbolic name allows accessing Channel Group data. This value will be assigned to the symbolic name derived of the AdcGroup container shortName. ImplementationType: Adc_GroupType / ADCのチャネルグループID。 ADCのコンフィグレーションで指定されているADCチャネルグループの番号を指定すること。
        integer NumSamples: 0..255, set at pre-compile, origin=QINeS, scope=ECU  # Number of ADC values to be acquired per channel in streaming access mode. Note: in single access mode this parameter assumes value 1, since only one sample per channel is processed. ImplementationType: Adc_StreamNumSampleType / ストリーミングアクセスモードにおけるA/D変換のサンプリング回数。 ADCのコンフィグレーションで指定されているサンプリング回数を指定すること。
        enumeration Permission: {IOHWAB_Q_ADC_PERMISSION_GET, IOHWAB_Q_ADC_PERMISSION_SET, IOHWAB_Q_ADC_PERMISSION_ALL}, set at pre-compile, origin=QINeS, scope=ECU  # - / パーミッション属性を指定すること。 IOHWAB_Q_ADC_PERMISSION_GET(1)：信号のリード可 IOHWAB_Q_ADC_PERMISSION_SET(2)：信号のライト可 IOHWAB_Q_ADC_PERMISSION_ALL(3)：信号のリード・ライト可
        enumeration Processing: {IOHWAB_Q_ADC_PROCESSING_ONESHOT, IOHWAB_Q_ADC_PROCESSING_DIFF}, set at pre-compile, origin=QINeS, scope=ECU  # - / フィルタリング種別を指定すること。 IOHWAB_Q_ADC_PROCESSING_FUNCTION(2)：外部関数を通して値を確認 IOHWAB_Q_ADC_PROCESSING_ONSHOT(3)：フィルタリング処理をせずに読み込んだ値を返す IOHWAB_Q_ADC_PROCESSING_DIFF(4)：前回の値との許容誤差以上の変化があれば値が変わったとみなす IOHWAB_Q_ADC_PROCESSING_DIFFFUNCTION(6)：外部関数を通して値を確認・前回の値との許容誤差以上の変化があれば値が変わったとみなす
        container IoHwAbAdcCallback  # - / このコンテナは、RTEへの通知で使用するCallback関数の設定を定義する。 RTEで提供されるCallback関数を設定すること。
          function name Adcnotifyerrorfunc: set at pre-compile, origin=QINeS, scope=ECU, default-value=NULL  # - / ADCドライバからの変換完了通知で値のリードができなかった際の通知関数。
          function name Adcnotifyreadfunc: set at pre-compile, origin=QINeS, scope=ECU, default-value=NULL  # - / ADCドライバから変換完了通知（シングル）が来た際の通知関数。
          function name Adcnotifystatusfunc: set at pre-compile, origin=QINeS, scope=ECU, default-value=NULL  # - / ADCドライバから変換完了通知（ストリーミング）が来た際の通知関数。
          function name failuer_func: set at pre-compile, origin=QINeS, scope=ECU, default-value=NULL  # - / 周期処理で変換が間に合っていなかった際の通知関数。
          function name notify_func: set at pre-compile, origin=QINeS, scope=ECU, default-value=NULL  # - / 取得値に変化があった際の通知関数。
        container IoHwAbAdcConfFunc [0..0]  # - / 未使用
          function name Coeff: set at pre-compile, origin=QINeS, scope=ECU, default-value=NULL  # - / フィルタ仕様へのアドレスを指定する。
          function name Func: set at pre-compile, origin=QINeS, scope=ECU, default-value=NULL  # - / フィルタ関数。
          function name Initfunc: set at pre-compile, origin=QINeS, scope=ECU, default-value=NULL  # - / フィルタへの初期化関数。
        container IoHwAbAdcUpdateCondition  # - / このコンテナは、フィルタリング種別にIOHWAB_Q_ADC_PROCESSING_DIFFまたはIOHWAB_Q_ADC_PROCESSING_DIFFFUNCTIONを設定した場合に、必要となる許容誤差の設定値を定義する。
          integer Negdiff: 0..4294967295, set at pre-compile, origin=QINeS, scope=ECU  # - / 下方への許容誤差。
          integer Posdiff: 0..4294967295, set at pre-compile, origin=QINeS, scope=ECU  # - / 上方への許容誤差。
    container IoHwAbQAdcDefinition  # -
      integer IOHWAB_Q_ADCCHANNEL_MAX_OF_GROUP: 0..255, set at pre-compile, origin=QINeS, default-value=1  # - / ADC全チャネルグループにおけるチャネル数の最大数。
      integer IOHWAB_Q_ADCCHANNEL_MAX_OF_SAMPLES: 0..65535, set at pre-compile, origin=QINeS, default-value=1  # - / ADC全チャネルグループにおけるストリームモードの最大サンプリング回数。
      boolean IOHWAB_Q_ADC_DEV_ERROR_DETECT: set at pre-compile, origin=QINeS, default-value=true  # Switches the Development Error Detection and Notification ON or OFF. true: Enabled. false: Disabled. / Detモジュールを使用するスイッチ。 TRUE：使用する FALSE：使用しない
      boolean IOHWAB_Q_ADC_HW_TRIG_SUPPORT: set at pre-compile, origin=QINeS  # - / ADCドライバのHWトリガ用APIサポートスイッチ。 TRUE：サポート FALSE：非サポート ※ADCドライバ側の設定に合わせて設定すること。
      boolean IOHWAB_Q_ADC_NOTIFY_SUPPORT: set at pre-compile, origin=QINeS  # - / ADCドライバの通知機能用APIサポートスイッチ。 TRUE：サポート FALSE：非サポート ※ADCドライバ側の設定に合わせて設定すること。
      integer IOHWAB_Q_ADC_NUM_OF_CHANNEL_ID: 0..255, set at pre-compile, origin=QINeS, default-value=1  # - / ADC全チャネル数。
      integer IOHWAB_Q_ADC_NUM_OF_ELEMENT: 0..256, set at pre-compile, origin=QINeS, default-value=1  # - / Element定義数。
      boolean IOHWAB_Q_ADC_READGROUP_API_SUPPORT: set at pre-compile, origin=QINeS  # - / ADCドライバのAPI（AdcReadGroup）サポートスイッチ。 TRUE：サポート FALSE：非サポート ※ADCドライバ側の設定に合わせて設定すること。
      boolean IOHWAB_Q_ADC_SW_TRIG_SUPPORT: set at pre-compile, origin=QINeS  # - / ADCドライバのSWトリガ用APIサポートスイッチ。 TRUE：サポート FALSE：非サポート ※ADCドライバ側の設定に合わせて設定すること。
      function name IoHwAb_Adc_Mutex_Enter: set at pre-compile, origin=QINeS, default-value=SchM_Enter_IoHwAb(0)  # - / IoHwAb_Q_AdcPeriodicで割り込みを禁止する関数。 SchMから提供される排他制御関数を設定する。 排他制御が必要ない場合は設定の必要はなし。
      function name IoHwAb_Adc_Mutex_Exit: set at pre-compile, origin=QINeS, default-value=SchM_Exit_IoHwAb(0)  # - / IoHwAb_Q_AdcPeriodicで割り込みを許可する関数。 SchMから提供される排他制御関数を設定する。 排他制御が必要ない場合は設定の必要はなし。
    container IoHwAbQAdcLastReadGroup [1..255]  # - / このコンテナは各チャネルグループのデータを格納するためのバッファを指定する。
      integer AdcNumOfColleagues: 0..256, set at pre-compile, origin=QINeS  # - / 同じチャネルグループを使用するElementの数。
      function name Buff: set at pre-compile, origin=QINeS  # - / ADCドライバから取得したデータを格納するバッファ領域のアドレス。 IoHwAb_Q_AdcBufferTypeでバッファを定義すること。
      function name Colleague: set at pre-compile, origin=QINeS  # - / 同じチャネルグループを使用するElement番号が格納された配列へのアドレスを指定する。
      integer IoHwAbAdcNumOfBuff: 0..255, set at pre-compile, origin=QINeS  # - / 最新のA/D変換結果格納用バッファのサイズ。(Buffersizeの値となる。)
      integer IoHwAbAdcNumOfResultBuff: 0..65535, set at pre-compile, origin=QINeS  # - / A/D変換結果格納用バッファ数。（Buffersize×チャネルグループと紐付くNumSamplesの値となる。）
      function name ResultBuff: set at pre-compile, origin=QINeS  # - / 変換結果を格納する(ADCドライバにより利用される)バッファ領域のアドレス。 IoHwAb_Q_AdcBufferTypeでバッファを定義すること。
    container IoHwAbQDioConfig  # Generic configuration parameters of the IoHwAb Dio module. / このコンテナはIoHwAb Dioの構成コンフィグレーションパラメータを設定する。
      integer IoHwAbDioNumOfConfigSet: 0..256, scope=ECU, set at pre-compile, origin=QINeS, symbolic-name-value=true  # - / IoHwAb_Dioで、コンフィグレーションされるIoHwAb_Q_DioConfSetの数（Elementの数）。
      container IoHwAbQDioConfigSet [0..256]  # Configuration of the IoHwAb Dio Config. / このコンテナはElementの設定を定義する。 チャネル信号チャネル定義数、ポート信号チャネル定義数、チャネルグループ信号チャネル定義数の合計数分だけ、本コンテナの情報を定義する必要がある。
        enumeration Access: {IOHWAB_Q_DIO_TYPE_CHANNEL, IOHWAB_Q_DIO_TYPE_PORT, IOHWAB_Q_DIO_TYPE_CHANNELGROUP}, scope=ECU, set at pre-compile, origin=QINeS, default-value=IOHWAB_Q_DIO_TYPE_CHANNEL  # - / アクセス種別を指定すること。 IOHWAB_Q_ADC_ACCESS_HW_ONE_SINGLE：ハードウェアトリガにより1回のみ変換が実施される信号。変換完了をトリガに通知される。ADCドライバのハードウェアトリガ・シングルアクセス設定信号を対象とする。（単一変換方式のみ可能） IOHWAB_Q_ADC_ACCESS_HW_MULTI_SINGLE：ハードウェアトリガにより停止が指示されるまで何度も変換が実施される信号。変換完了をトリガ毎に通知される。ADCドライバのハードウェアトリガ・シングルアクセス設定信号を対象とする。（連続変換方式のみ対象） IOHWAB_Q_ADC_ACCESS_HW_ONE_CURSTREAM：ハードウェアトリガによりバッファフルになるまでデータを蓄積する信号。バッファフルの際にADCドライバステータス（A/D変換状況）をユーザーに通知する。Adc_GetStreamLastPointerもしくは Adc_ReadGroupを呼ぶことで変換が再開される。ADCドライバのハードウェアトリガ・ストリーミングアクセス（サイクルバッファ方式）設定信号を対象とする。（単一変換方式のみ対象） IOHWAB_Q_ADC_ACCESS_HW_ONE_LINSTREAM：ハードウェアトリガによりバッファフルになるまでデータを蓄積する信号。バッファフルの際に通知されSW-Cからの指示によるAdc_EnableHardwareTriggerを呼ぶことで変換が再開される。ADCドライバのハードウェアトリガ・ストリーミングアクセス（リニアバッファ方式）設定信号を対象とする。（単一変換方式のみ対象） IOHWAB_Q_ADC_ACCESS_SW_ONE_POLLING：ソフトウェアトリガにより1回のみ変換が実施される信号。周期処理にて変換完了を監視する。ADCドライバのソフトウェアトリガ・シングルアクセス設定信号を対象とする。（単一変換方式のみ対象） IOHWAB_Q_ADC_ACCESS_SW_MULTI_POLLING：ソフトウェアトリガにより停止が指示されるまで周期処理毎に何度でも変換が実施される信号。（IoHwAb_AdcでADCドライバにA/D値を読みに行くことをトリガにして、自動的に変換が開始される。）ADCドライバのソフトウェアトリガ・シングルアクセス設定信号を対象とする。（連続変換方式のみ対象） IOHWAB_Q_ADC_ACCESS_SW_ONE_SINGLE：ソフトウェアトリガにより1回のみ変換が実施される信号。変換完了をトリガに通知される。ADCドライバのソフトウェアトリガ・シングルアクセス設定信号を対象とする。（単一変換方式のみ対象） IOHWAB_Q_ADC_ACCESS_SW_MULTI_SINGLE：ソフトウェアトリガにより停止されるまで何度も変換が実施される信号。変換完了トリガ毎に通知される。ADCドライバのソフトウェアトリガ・シングルアクセス設定信号を対象とする。（連続変換方式のみ対象） IOHWAB_Q_ADC_ACCESS_SW_ONE_CURSTREAM：初回のみソフトウェアトリガ、2回目以降は循環バッファにデータが蓄積されるタイミングをトリガとする信号。循環バッファが満たされた時に通知される。ADCドライバのソフトウェアトリガ・ストリーミングアクセス（サイクルバッファ方式）設定信号を対象とする。（連続変換方式のみ対象） IOHWAB_Q_ADC_ACCESS_SW_ONE_LINSTREAM：初回のみソフトウェアトリガ、2回目以降は直列バッファにデータが蓄積されるタイミングをトリガとする信号。直列バッファが満たされた時に通知される。ADCドライバのソフトウェアトリガ・ストリーミングアクセス（リニアバッファ方式）設定信号を対象とする。（連続変換方式のみ対象）
        string Channelgroupid: set at pre-compile, origin=QINeS  # - / チャネルグループID。
        integer Channelgroupinitid: 0..255, scope=ECU, set at pre-compile, origin=QINeS  # - / ポートの初期値テーブル（IoHwAb_DioInitPort）のオフセットを示す。 IOHWAB_Q_DIOCHGROUP_ENABLEがTRUEの時かつIOHWAB_Q_DIO_INIT_VALUE_READCHANNELGROUPがTRUEの時、本メンバが定義される。
        integer Channelid: 0..255, scope=ECU, set at pre-compile, origin=QINeS  # Channel Id of the DIO channel. This value will be assigned to the symbolic names. / 信号のチャネル番号。 DIOのチャネル番号を指定すること。 IOHWAB_Q_DIOCH_ENABLEがTRUEの時チャネル番号を設定する。
        integer Channelinitid: 0..255, scope=ECU, set at pre-compile, origin=QINeS  # - / ポートの初期値テーブル（IoHwAb_DioInitChannel）のオフセットを示す。 IOHWAB_Q_DIOCH_ENABLEがTRUEの時かつIOHWAB_Q_DIO_INIT_VALUE_READCHANNELがTRUEの時、本メンバが定義される。
        enumeration Periodic: {IOHWAB_Q_DIO_PERIODIC_MODE_ON, IOHWAB_Q_DIO_PERIODIC_MODE_OFF}, scope=ECU, set at pre-compile, origin=QINeS, default-value=IOHWAB_Q_DIO_PERIODIC_MODE_ON  # - / 周期処理対応のElementか直値読み対応のElementかの区分を設定すること。 IOHWAB_Q_DIO_PERIODIC_MODE_ON(0)：周期的に値を読み取る ※周期処理が可能なアクセス種別はチャネル単位アクセスのみ。 IOHWAB_Q_DIO_PERIODIC_MODE_OFF(1)：直接DIOドライバから値を読み取る
        enumeration Permission: {IOHWAB_Q_DIO_PERMISSION_GET, IOHWAB_Q_DIO_PERMISSION_SET, IOHWAB_Q_DIO_PERMISSION_ALL}, scope=ECU, set at pre-compile, origin=QINeS, default-value=IOHWAB_Q_DIO_PERMISSION_GET  # - / パーミッション属性を指定すること。 IOHWAB_Q_ADC_PERMISSION_GET(1)：信号のリード可 IOHWAB_Q_ADC_PERMISSION_SET(2)：信号のライト可 IOHWAB_Q_ADC_PERMISSION_ALL(3)：信号のリード・ライト可
        integer Portid: 0..255, scope=ECU, set at pre-compile, origin=QINeS  # Numeric identifier of the DIO port. Not all MCU ports may be used for DIO, thus there may be "gaps" in the list of all IDs. This value will be assigned to the DIO port symbolic name (i.e. the SHORT-NAME of the DioPort container). / 信号のポート番号。 DIOのポート番号を指定すること。 IOHWAB_Q_DIOPORT_ENABLEがTRUEの時、ポート番号を設定する。
        integer Portinitid: 0..255, scope=ECU, set at pre-compile, origin=QINeS  # - / ポートの初期値テーブル（IoHwAb_DioInitPort）のオフセットを示す。IOHWAB_Q_DIOPORT_ENABLEがTRUEの時かつIOHWAB_Q_DIO_INIT_VALUE_READPORTがTRUEの時、本メンバが定義される。
        enumeration Processing: {IOHWAB_Q_DIO_PROCESSING_TIMES, IOHWAB_Q_DIO_PROCESSING_TIMECONTINUE, IOHWAB_Q_DIO_PROCESSING_ONESHOT}, scope=ECU, set at pre-compile, origin=QINeS, default-value=IOHWAB_Q_DIO_PROCESSING_TIMECONTINUE  # - / フィルタリング種別を指定すること。 IOHWAB_Q_ADC_PROCESSING_FUNCTION(2)：外部関数を通して値を確認 IOHWAB_Q_ADC_PROCESSING_ONSHOT(3)：フィルタリング処理をせずに読み込んだ値を返す IOHWAB_Q_ADC_PROCESSING_DIFF(4)：前回の値との許容誤差以上の変化があれば値が変わったとみなす IOHWAB_Q_ADC_PROCESSING_DIFFFUNCTION(6)：外部関数を通して値を確認・前回の値との許容誤差以上の変化があれば値が変わったとみなす
        reference pChannelgroupid [0..0]: scope=ECU, set at pre-compile, origin=QINeS, destination=DioChannelGroup  # nonuse / 未使用
        container IoHwAbDioCallback  # - / このコンテナは、周期処理（IoHwAb_Q_DioPeriodic）内でのRTEへの通知で使用するCallback関数を指定する。
          function name Channelfunc: scope=ECU, set at pre-compile, origin=QINeS, default-value=NULL  # - / チャネル信号変化時のCallback関数を指定する。 IOHWAB_Q_DIOCH_ENABLEがTRUEの時のみ定義される。
          function name Chgroupfunc: scope=ECU, set at pre-compile, origin=QINeS, default-value=NULL  # - / チャネルグループ信号変化時のCallback関数を指定する。 IOHWAB_Q_DIOCHGROUP_ENABLEがTRUEの時のみ定義される。
          function name Portfunc: scope=ECU, set at pre-compile, origin=QINeS, default-value=NULL  # - / ポート信号変化時のCallback関数を指定する。 IOHWAB_Q_DIOPORT_ENABLEがTRUEの時のみ定義される。
        container IoHwAbDioConfTime  # - / 本コンテナはIoHwAb_Dioで使用するデバウンシング処理に必要な設定を定義する。
          integer Time: 0..65535, scope=ECU, set at pre-compile, origin=QINeS, default-value=3  # - / フィルタリング種別（Processing）がIOHWAB_Q_DIO_PROCESSING_TIMES、またはIOHWAB_DIO_PROCESSING_TIMECONTINUEの時の判定回数を指定する。
    container IoHwAbQDioDefinition  # -
      integer IoHwAbDioNumOfInitChannel [0..0]: 0..255, set at pre-compile, origin=QINeS  # - / 未使用
      integer IoHwAbDioNumOfInitChannelGroup [0..0]: 0..255, set at pre-compile, origin=QINeS  # - / 未使用
      integer IoHwAbDioNumOfInitPort [0..0]: 0..255, set at pre-compile, origin=QINeS  # - / 未使用
      boolean IoHwAbQDioDevErrorDetect: set at pre-compile, origin=QINeS, default-value=true  # Switches the Development Error Detection and Notification ON or OFF. / Detモジュールを使用するスイッチ。 TRUE：使用する FALSE：使用しない
      boolean IoHwAbQDioInitValueReadChannel: set at pre-compile, origin=QINeS  # Enables/Disables development error detection. / チャネル信号初期値の有効/無効スイッチ。 TRUE：Start処理（IoHwAb_Q_DioStart）においてIoHwAb_DioInitChannelで定義された値を初期値として設定する FALSE：Start処理においてリード処理を行い取得した値を初期値として設定する | TRUE or FALSE
      boolean IoHwAbQDioInitValueReadChannelGroup: set at pre-compile, origin=QINeS  # Enables/Disables development error detection. / チャネルグループ初期値の有効/無効スイッチ。 TRUE：Start処理（IoHwAb_Q_DioStart）においてIoHwAb_DioInitChannelGroupで定義された値を初期値として設定する FALSE：Start処理においてリード処理を行い取得した値を初期値として設定する | TRUE or FALSE
      boolean IoHwAbQDioInitValueReadPort: set at pre-compile, origin=QINeS  # Enables/Disables development error detection. / ポート信号初期値の有効/無効スイッチ。 TRUE：Start処理（IoHwAb_Q_DioStart）においてIoHwAb_DioInitPortで定義された値を初期値として設定する FALSE：Start処理においてリード処理を行い取得した値を初期値として設定する | TRUE or FALSE
      integer IoHwAb_DioInitChannel [0..*]: 0..255, set at pre-compile, origin=QINeS  # - / IoHwAb_DioではDIOチャネルの初期値テーブルを定義する。 初期値設定（IOHWAB_Q_DIO_INIT_VALUE_READCHANNEL）が有効の時、IoHwAb_DioInitChannelを使用する。 値は任意で、リードが完了するまで初期値を2とするなどシステム要件により決定すること。
      integer IoHwAb_DioInitChannelGroup [0..*]: 0..4294967296, set at pre-compile, origin=QINeS  # - / IoHwAb_DioではDIOチャネルグループの初期値テーブルを定義する。 初期値設定（IOHWAB_Q_DIO_INIT_VALUE_READCHANNELGROUP）が有効の時、IoHwAb_DioInitChannelGroupを使用する。 リードが完了するまでの初期値をシステム要件により決定すること。
      integer IoHwAb_DioInitPort [0..*]: 0..4294967296, set at pre-compile, origin=QINeS  # - / IoHwAb_DioではDIOポートの初期値テーブルを定義する。 初期値設定（IOHWAB_Q_DIO_INIT_VALUE_READPORT）が有効の時、IoHwAb_DioInitPortを使用する。 値は任意で、リードが完了するまでの初期値をシステム要件により決定すること。
      integer IohwabQDioNumOfChElement: 0..256, set at pre-compile, origin=QINeS  # - / チャネル信号チャネル定義数。
      integer IohwabQDioNumOfChgroupElement: 0..256, set at pre-compile, origin=QINeS  # - / チャネルグループ信号チャネル定義数。
      integer IohwabQDioNumOfPortElement: 0..256, set at pre-compile, origin=QINeS  # - / ポート信号チャネル定義数。
    container IoHwAbQEcuMIoHwAbAdc [0..1]  # - / EcuMからのAdc初期化処理。
      symbolic name reference IoHwAbQIoHwAbAdcCore [0..*]: set at pre-compile, origin=QINeS, destination=EcucCoreDefinition  # - / Core情報の参照を行う。IoHwAb_Adcの存在するCore情報を持つ。
      container IoHwAbQAdcDeInit [1..*]  # Returns all ADC HW Units to a state comparable to their power on reset state. / ADCドライバ用に定義されているElementを開始IDから終端IDまでを未初期化状態にする。 本関数呼出後、ステートは「INACTIVE」になる。
        integer DeInitEnd: 0..65535, set at pre-compile, origin=QINeS  # - / 無効化するエレメントの終了ID。 MAX=65535 MIN=0
        integer DeInitStart: 0..65535, set at pre-compile, origin=QINeS  # - / 無効化するエレメントの開始ID。 MAX=65535 MIN=0
      container IoHwAbQAdcInit [1..*]  # Initializes the ADC hardware units and driver. / ADCドライバ用に定義されているElementを開始IDから終端IDまで初期化する。 本関数呼出後、ステートは「IDLE」になる。
        integer InitEnd: 0..65535, set at pre-compile, origin=QINeS  # - / 初期化するエレメントの終了ID。 MAX=65535 MIN=0
        integer InitStart: 0..65535, set at pre-compile, origin=QINeS  # - / 初期化するエレメントの開始ID。 MAX=65535 MIN=0
      container IoHwAbQAdcStart [1..*]  # - / コンフィグレーションのADCドライバ用に定義されているElementの開始IDから終端IDまでの開始処理を行う。 本関数が正しく実行された場合、ステートは「RUNNING」になる。 本関数が正しく実行されなかった場合、指定したElementに関連するADCの機能は使用できない。
        integer StartEnd: 0..65535, set at pre-compile, origin=QINeS  # - / 開始する要素の終了ID。 MAX=65535 MIN=0
        integer StartStart: 0..65535, set at pre-compile, origin=QINeS  # - / 開始する要素の開始ID。 MAX=65535 MIN=0
      container IoHwAbQAdcStop [1..*]  # - / ADCドライバ用に定義されているElementを開始IDから終端IDまでの停止処理を行う。 本関数が正しく実行された場合、ステートは「IDLE」となる。 本関数が正しく実行されなかった場合、指定したElementに関連するADCの機能を停止できない。
        integer StopEnd: 0..65535, set at pre-compile, origin=QINeS  # - / 停止する要素の終了ID。 MAX=65535 MIN=0
        integer StopStart: 0..65535, set at pre-compile, origin=QINeS  # - / 停止する要素の開始ID。 MAX=65535 MIN=0
    container IoHwAbQEcuMIoHwAbDio [0..1]  # - / EcuMからのDio初期化処理。
      symbolic name reference IoHwAbQIoHwAbDioCore [0..*]: set at pre-compile, origin=QINeS, destination=EcucCoreDefinition  # - / Core情報の参照を行う。IoHwAb_Dioの存在するCore情報を持つ。
      container IoHwAbQDioDeInit [1..*]  # - / コンフィグレーションのDIOドライバ用に定義されているElementを開始IDから終端IDまでを未初期化状態にする。 本関数呼出後、ステートは「INACTIVE」になる。
        integer DeInitEnd: 0..65535, set at pre-compile, origin=QINeS  # - / 無効化するエレメントの終了ID。 MAX=65535 MIN=0
        integer DeInitStart: 0..65535, set at pre-compile, origin=QINeS  # - / 無効化するエレメントの開始ID。 MAX=65535 MIN=0
      container IoHwAbQDioInit [1..*]  # - / DIOドライバ用に定義されているElementを開始IDから終端IDまで、初期化する。 本関数呼出後、ステートは「IDLE」になる。
        integer InitEnd: 0..65535, set at pre-compile, origin=QINeS  # - / 初期化するエレメントの終了ID。 MAX=65535 MIN=0
        integer InitStart: 0..65535, set at pre-compile, origin=QINeS  # - / 初期化するエレメントの開始ID。 MAX=65535 MIN=0
      container IoHwAbQDioStart [1..*]  # - / コンフィグレーションのDIOドライバ用に定義されているElementの開始IDから終端IDまでの開始処理を行う。 本関数が正しく実行された場合、ステートは「RUNNING」になる。 本関数が正しく実行されなかった場合、指定したElementに関連するDIOの機能は使用できない。
        integer StartEnd: 0..65535, set at pre-compile, origin=QINeS  # - / 開始する要素の終了ID。 MAX=65535 MIN=0
        integer StartStart: 0..65535, set at pre-compile, origin=QINeS  # - / 開始する要素の開始ID。 MAX=65535 MIN=0
      container IoHwAbQDioStop [1..*]  # - / DIOドライバ用に定義されているElementを開始IDから終端IDまでの停止処理を行う。 本関数が正しく実行された場合、ステートは「IDLE」となる。 本関数が正しく実行されなかった場合、指定したElementに関連するDIOの機能を停止できない。
        integer StopEnd: 0..65535, set at pre-compile, origin=QINeS  # - / 停止する要素の終了ID。 MAX=65535 MIN=0
        integer StopStart: 0..65535, set at pre-compile, origin=QINeS  # - / 停止する要素の開始ID。 MAX=65535 MIN=0
    container IoHwAbQEcuMIoHwAbGpt [0..1]  # - / EcuMからのGpt初期化処理。
      symbolic name reference IoHwAbQIoHwAbGptCore [0..*]: set at pre-compile, origin=QINeS, destination=EcucCoreDefinition  # - / Core情報の参照を行う。IoHwAb_Gptの存在するCore情報を持つ。
      container IoHwAbQGptDeInit [1..*]  # Deinitializes the GPT driver. / GPTドライバ用に定義されているElementを開始IDから終端IDまでを未初期化状態にする。 本関数呼出後、ステートは「INACTIVE」になる。
        integer DeInitEnd: 0..65535, set at pre-compile, origin=QINeS  # - / 無効化するエレメントの終了ID。 MAX=65535 MIN=0
        integer DeInitStart: 0..65535, set at pre-compile, origin=QINeS  # - / 無効化するエレメントの開始ID。 MAX=65535 MIN=0
      container IoHwAbQGptInit [1..*]  # Initializes the GPT driver. / GPTドライバ用に定義されているElementを開始IDから終端IDまで初期化する。 本関数呼出後、ステートは「IDLE」になる。
        integer InitEnd: 0..65535, set at pre-compile, origin=QINeS  # - / 初期化するエレメントの終了ID。 MAX=65535 MIN=0
        integer InitStart: 0..65535, set at pre-compile, origin=QINeS  # - / 初期化するエレメントの開始ID。 MAX=65535 MIN=0
      container IoHwAbQGptStart [1..*]  # - / コンフィグレーションのGPTドライバ用に定義されているElementの開始IDから終端IDまでの開始処理を行う。 本関数が正しく実行された場合、ステートは「RUNNING」になる。 本関数が正しく実行されなかった場合、指定したElementに関連するGPTの機能は使用できない。
        integer StartEnd: 0..65535, set at pre-compile, origin=QINeS  # - / 開始する要素の終了ID。 MAX=65535 MIN=0
        integer StartStart: 0..65535, set at pre-compile, origin=QINeS  # - / 開始する要素の開始ID。 MAX=65535 MIN=0
      container IoHwAbQGptStop [1..*]  # - / GTPドライバ用に定義されているElementを開始IDから終端IDまでの停止処理を行う。 本関数が正しく実行された場合、ステートは「IDLE」となる。 本関数が正しく実行されなかった場合、指定したElementに関連するGPTの機能を停止できない。
        integer StopEnd: 0..65535, set at pre-compile, origin=QINeS  # - / 停止する要素の終了ID。 MAX=65535 MIN=0
        integer StopStart: 0..65535, set at pre-compile, origin=QINeS  # - / 停止する要素の開始ID。 MAX=65535 MIN=0
    container IoHwAbQEcuMIoHwAbIcu [0..1]  # - / EcuMからのIcu初期化処理。
      symbolic name reference IoHwAbQIoHwAbIcuCore [0..*]: set at pre-compile, origin=QINeS, destination=EcucCoreDefinition  # - / Core情報の参照を行う。IoHwAb_Icuの存在するCore情報を持つ。
      container IoHwAbQIcuDeInit [1..*]  # This function de-initializes the ICU module. / ICUドライバ用に定義されているElementを開始IDから終端IDまでを未初期化状態にする。 本関数呼出後、ステートは「INACTIVE」になる。
        integer DeInitEnd: 0..65535, set at pre-compile, origin=QINeS  # - / 無効化するエレメントの終了ID。 MAX=65535 MIN=0
        integer DeInitStart: 0..65535, set at pre-compile, origin=QINeS  # - / 無効化するエレメントの開始ID。 MAX=65535 MIN=0
      container IoHwAbQIcuInit [1..*]  # This function initializes the driver. / ICUドライバ用に定義されているElementを開始IDから終端IDまで初期化する。 本関数呼出後、ステートは「IDLE」になる。
        integer InitEnd: 0..65535, set at pre-compile, origin=QINeS  # - / 初期化するエレメントの終了ID。 MAX=65535 MIN=0
        integer InitStart: 0..65535, set at pre-compile, origin=QINeS  # - / 初期化するエレメントの開始ID。 MAX=65535 MIN=0
      container IoHwAbQIcuStart [1..*]  # - / コンフィグレーションのICUドライバ用に定義されているElementの開始IDから終端IDまで開始処理を行う。 本関数が正しく実行された場合、ステートは「RUNNING」になる。 本関数が正しく実行されなかった場合、指定したElementに関連するICUの機能は使用できない。
        integer StartEnd: 0..65535, set at pre-compile, origin=QINeS  # - / 開始する要素の終了ID。 MAX=65535 MIN=0
        integer StartStart: 0..65535, set at pre-compile, origin=QINeS  # - / 開始する要素の開始ID。 MAX=65535 MIN=0
      container IoHwAbQIcuStop [1..*]  # - / ICUドライバ用に定義されているElementを開始IDから終端IDまで停止処理を行う。 本関数が正しく実行された場合、ステートは「IDLE」にとなる。 本関数が正しく実行されなかった場合、指定したElementに関連するICUの機能を停止できない。
        integer StopEnd: 0..65535, set at pre-compile, origin=QINeS  # - / 停止する要素の終了ID。 MAX=65535 MIN=0
        integer StopStart: 0..65535, set at pre-compile, origin=QINeS  # - / 停止する要素の開始ID。 MAX=65535 MIN=0
    container IoHwAbQEcuMIoHwAbPwm [0..1]  # API ID / EcuMからのPwm初期化処理。
      symbolic name reference IoHwAbQIoHwAbPwmCore [0..*]: set at pre-compile, origin=QINeS, destination=EcucCoreDefinition  # - / Core情報の参照を行う。IoHwAb_Pwmの存在するCore情報を持つ。
      container IoHwAbQPwmDeInit [1..*]  # Service for PWM De-Initialization. / PWMドライバ用に定義されているElementを開始IDから終端IDまでを未初期化状態にする。本関数呼出後、ステートは「INACTIVE」になる。
        integer DeInitEnd: 0..65535, set at pre-compile, origin=QINeS  # - / 無効化するエレメントの終了ID。 MAX=65535 MIN=0
        integer DeInitStart: 0..65535, set at pre-compile, origin=QINeS  # - / 無効化するエレメントの開始ID。 MAX=65535 MIN=0
      container IoHwAbQPwmInit [1..*]  # Service for PWM initialization. / PWMドライバ用に定義されているElementを開始IDから終端IDまで初期化する。 本関数呼出後、ステートは「IDLE」になる。
        integer InitEnd: 0..65535, set at pre-compile, origin=QINeS  # - / 初期化するエレメントの終了ID。 MAX=65535 MIN=0
        integer InitStart: 0..65535, set at pre-compile, origin=QINeS  # - / 初期化するエレメントの開始ID。 MAX=65535 MIN=0
      container IoHwAbQPwmStart [1..*]  # - / コンフィグレーションのPWMドライバ用に定義されているElementの開始IDから終端IDまでの開始処理を行う。 本関数が正しく実行された場合、ステートは「RUNNING」になる。 本関数が正しく実行されなかった場合、指定したElementに関連するPWMの機能は使用できない。
        integer StartEnd: 0..65535, set at pre-compile, origin=QINeS  # - / 開始する要素の終了ID。 MAX=65535 MIN=0
        integer StartStart: 0..65535, set at pre-compile, origin=QINeS  # - / 開始する要素の開始ID。 MAX=65535 MIN=0
      container IoHwAbQPwmStop [1..*]  # - / PWMドライバ用に定義されているElementを開始IDから終端IDまでの停止処理を行う。 本関数が正しく実行された場合、ステートは「IDLE」となる。 本関数が正しく実行されなかった場合、指定したElementに関連するPWMの機能を停止できない。
        integer StopEnd: 0..65535, set at pre-compile, origin=QINeS  # - / 停止する要素の終了ID。 MAX=65535 MIN=0
        integer StopStart: 0..65535, set at pre-compile, origin=QINeS  # - / 停止する要素の開始ID。 MAX=65535 MIN=0
    container IoHwAbQGptConfig  # - / このコンテナはIoHwAb_Gptの構成パラメータを設定する。
      integer IoHwAbGptNumOfConfigSet: 0..256, scope=ECU, set at pre-compile, origin=QINeS, symbolic-name-value=true  # - / IoHwAb_Gptで、コンフィグレーションされるIoHwAb_Q_GptConfSetの数（Elementの数）。
      container IoHwAbQGptConfigSet [0..256]  # - / このコンテナはElementの設定を定義する。Element定義数分、本コンテナの情報を定義する必要がある。
        enumeration Access: {IOHWAB_Q_GPT_TYPE_ONESHOT, IOHWAB_Q_GPT_TYPE_SOFTCONTINUOUS, IOHWAB_Q_GPT_TYPE_CONTINUOUS}, scope=ECU, set at pre-compile, origin=QINeS  # - / アクセス種別を指定すること。 IOHWAB_Q_ADC_ACCESS_HW_ONE_SINGLE：ハードウェアトリガにより1回のみ変換が実施される信号。変換完了をトリガに通知される。ADCドライバのハードウェアトリガ・シングルアクセス設定信号を対象とする。（単一変換方式のみ可能） IOHWAB_Q_ADC_ACCESS_HW_MULTI_SINGLE：ハードウェアトリガにより停止が指示されるまで何度も変換が実施される信号。変換完了をトリガ毎に通知される。ADCドライバのハードウェアトリガ・シングルアクセス設定信号を対象とする。（連続変換方式のみ対象） IOHWAB_Q_ADC_ACCESS_HW_ONE_CURSTREAM：ハードウェアトリガによりバッファフルになるまでデータを蓄積する信号。バッファフルの際にADCドライバステータス（A/D変換状況）をユーザーに通知する。Adc_GetStreamLastPointerもしくは Adc_ReadGroupを呼ぶことで変換が再開される。ADCドライバのハードウェアトリガ・ストリーミングアクセス（サイクルバッファ方式）設定信号を対象とする。（単一変換方式のみ対象） IOHWAB_Q_ADC_ACCESS_HW_ONE_LINSTREAM：ハードウェアトリガによりバッファフルになるまでデータを蓄積する信号。バッファフルの際に通知されSW-Cからの指示によるAdc_EnableHardwareTriggerを呼ぶことで変換が再開される。ADCドライバのハードウェアトリガ・ストリーミングアクセス（リニアバッファ方式）設定信号を対象とする。（単一変換方式のみ対象） IOHWAB_Q_ADC_ACCESS_SW_ONE_POLLING：ソフトウェアトリガにより1回のみ変換が実施される信号。周期処理にて変換完了を監視する。ADCドライバのソフトウェアトリガ・シングルアクセス設定信号を対象とする。（単一変換方式のみ対象） IOHWAB_Q_ADC_ACCESS_SW_MULTI_POLLING：ソフトウェアトリガにより停止が指示されるまで周期処理毎に何度でも変換が実施される信号。（IoHwAb_AdcでADCドライバにA/D値を読みに行くことをトリガにして、自動的に変換が開始される。）ADCドライバのソフトウェアトリガ・シングルアクセス設定信号を対象とする。（連続変換方式のみ対象） IOHWAB_Q_ADC_ACCESS_SW_ONE_SINGLE：ソフトウェアトリガにより1回のみ変換が実施される信号。変換完了をトリガに通知される。ADCドライバのソフトウェアトリガ・シングルアクセス設定信号を対象とする。（単一変換方式のみ対象） IOHWAB_Q_ADC_ACCESS_SW_MULTI_SINGLE：ソフトウェアトリガにより停止されるまで何度も変換が実施される信号。変換完了トリガ毎に通知される。ADCドライバのソフトウェアトリガ・シングルアクセス設定信号を対象とする。（連続変換方式のみ対象） IOHWAB_Q_ADC_ACCESS_SW_ONE_CURSTREAM：初回のみソフトウェアトリガ、2回目以降は循環バッファにデータが蓄積されるタイミングをトリガとする信号。循環バッファが満たされた時に通知される。ADCドライバのソフトウェアトリガ・ストリーミングアクセス（サイクルバッファ方式）設定信号を対象とする。（連続変換方式のみ対象） IOHWAB_Q_ADC_ACCESS_SW_ONE_LINSTREAM：初回のみソフトウェアトリガ、2回目以降は直列バッファにデータが蓄積されるタイミングをトリガとする信号。直列バッファが満たされた時に通知される。ADCドライバのソフトウェアトリガ・ストリーミングアクセス（リニアバッファ方式）設定信号を対象とする。（連続変換方式のみ対象）
        integer Channelid: 0..255, scope=ECU, set at pre-compile, origin=QINeS  # Channel Id of the DIO channel. This value will be assigned to the symbolic names. / 信号のチャネル番号。 DIOのチャネル番号を指定すること。 IOHWAB_Q_DIOCH_ENABLEがTRUEの時チャネル番号を設定する。
        enumeration Notification: {IOHWAB_Q_GPT_NOTIFICATION_ON, IOHWAB_Q_GPT_NOTIFICATION_OFF}, scope=ECU, set at pre-compile, origin=QINeS, default-value=IOHWAB_Q_GPT_NOTIFICATION_OFF  # Function pointer to callback function (for non-wakeup notification) / GPTドライバからの通知要求を以下より選択すること。 IOHWAB_Q_GPT_NOTIFICATION_ON(0)：GPTドライバに通知を要求する IOHWAB_Q_GPT_NOTIFICATION_OFF(1)：GPTドライバに通知を要求しない ライト設定可能なもの（IOHWAB_Q_GPT_PERMISSION_SETのビットが立っているもの）のみ通知要求が可能である。
        enumeration Permission: {IOHWAB_Q_GPT_PERMISSION_GET, IOHWAB_Q_GPT_PERMISSION_SET, IOHWAB_Q_GPT_PERMISSION_ALL}, scope=ECU, set at pre-compile, origin=QINeS, default-value=IOHWAB_Q_GPT_PERMISSION_GET  # - / パーミッション属性を指定すること。 IOHWAB_Q_ADC_PERMISSION_GET(1)：信号のリード可 IOHWAB_Q_ADC_PERMISSION_SET(2)：信号のライト可 IOHWAB_Q_ADC_PERMISSION_ALL(3)：信号のリード・ライト可
        integer Target: 0..4294967295, scope=ECU, set at pre-compile, origin=QINeS  # - / GPTへ設定する初期目標時間を指定すること。
    container IoHwAbQGptDefinition  # -
      string IoHwAbQGpt2Mcal: set at pre-compile, origin=QINeS  # - / ユーザーの指定したタイマ値（目標時間）をGPTドライバの単位に変換するマクロ。 システム毎に変換処理を用意する必要がある。 ユーザーの使用する単位をGPTドライバの単位に変換する変換式を設定すること。
      boolean IoHwAbQGptDevErrorDetect: set at pre-compile, origin=QINeS, default-value=true  # Enables/Disables development error detection. / Detモジュールを使用するスイッチ。 TRUE：使用する FALSE：使用しない
      boolean IoHwAbQGptGettimeelapsedApiSupport: set at pre-compile, origin=QINeS  # - / GPTドライバのAPI（Gpt_GetTimeElapsed）サポートスイッチ。 TRUE：サポート FALSE：非サポート ※GPTドライバ側の設定に合わせて設定すること。
      boolean IoHwAbQGptGettimeremainingApiSupport: set at pre-compile, origin=QINeS  # Adds / removes the service Gpt_GetTimeRemaining() from the code. / GPTドライバのAPI（Gpt_GetTimeRemaining）サポートスイッチ。 TRUE：サポート FALSE：非サポート ※GPTドライバ側の設定に合わせて設定すること。
      string IoHwAbQGptMcal2IoElapsed: set at pre-compile, origin=QINeS  # - / MCALの単位をユーザの単位に変換するマクロ経過時間の取得時に使用する。
      string IoHwAbQGptMcal2IoRemain: set at pre-compile, origin=QINeS  # - / MCALの単位をユーザの単位に変換するマクロ残り時間の取得時に使用する。
      string IoHwAbQGptMcalCh2IohwCh: set at pre-compile, origin=QINeS  # - / GPTドライバが管理しているチャネルIDをIoHwAb_Gptが管理するElement IDに変換するためのマクロ。 システム毎に変換処理を用意する必要がある。
      boolean IoHwAbQGptNotifySupport: set at pre-compile, origin=QINeS  # - / GPTドライバの通知機能用APIサポートスイッチ。 TRUE：サポート FALSE：非サポート ※GPTドライバ側の設定に合わせて設定すること。
      integer IoHwAbQGptNumOfChannel: 0..256, set at pre-compile, origin=QINeS  # - / タイマチャネル定義数。
      integer IoHwAbQGptNumOfChannelId: 0..255, set at pre-compile, origin=QINeS  # - / GPT全チャネル数。
      integer IoHwAbQGptNumOfElement: 0..256, set at pre-compile, origin=QINeS  # - / Element定義数。
    container IoHwAbQGptNotifyConfig [0..255]  # - / このコンテナは、GPTドライバからの通知処理で使用するCallback関数を定義する。
      enumeration Access: {IOHWAB_Q_GPT_TYPE_ONESHOT, IOHWAB_Q_GPT_TYPE_SOFTCONTINUOUS, IOHWAB_Q_GPT_TYPE_CONTINUOUS}, scope=ECU, set at pre-compile, origin=QINeS  # - / アクセス種別を指定すること。 IOHWAB_Q_ADC_ACCESS_HW_ONE_SINGLE：ハードウェアトリガにより1回のみ変換が実施される信号。変換完了をトリガに通知される。ADCドライバのハードウェアトリガ・シングルアクセス設定信号を対象とする。（単一変換方式のみ可能） IOHWAB_Q_ADC_ACCESS_HW_MULTI_SINGLE：ハードウェアトリガにより停止が指示されるまで何度も変換が実施される信号。変換完了をトリガ毎に通知される。ADCドライバのハードウェアトリガ・シングルアクセス設定信号を対象とする。（連続変換方式のみ対象） IOHWAB_Q_ADC_ACCESS_HW_ONE_CURSTREAM：ハードウェアトリガによりバッファフルになるまでデータを蓄積する信号。バッファフルの際にADCドライバステータス（A/D変換状況）をユーザーに通知する。Adc_GetStreamLastPointerもしくは Adc_ReadGroupを呼ぶことで変換が再開される。ADCドライバのハードウェアトリガ・ストリーミングアクセス（サイクルバッファ方式）設定信号を対象とする。（単一変換方式のみ対象） IOHWAB_Q_ADC_ACCESS_HW_ONE_LINSTREAM：ハードウェアトリガによりバッファフルになるまでデータを蓄積する信号。バッファフルの際に通知されSW-Cからの指示によるAdc_EnableHardwareTriggerを呼ぶことで変換が再開される。ADCドライバのハードウェアトリガ・ストリーミングアクセス（リニアバッファ方式）設定信号を対象とする。（単一変換方式のみ対象） IOHWAB_Q_ADC_ACCESS_SW_ONE_POLLING：ソフトウェアトリガにより1回のみ変換が実施される信号。周期処理にて変換完了を監視する。ADCドライバのソフトウェアトリガ・シングルアクセス設定信号を対象とする。（単一変換方式のみ対象） IOHWAB_Q_ADC_ACCESS_SW_MULTI_POLLING：ソフトウェアトリガにより停止が指示されるまで周期処理毎に何度でも変換が実施される信号。（IoHwAb_AdcでADCドライバにA/D値を読みに行くことをトリガにして、自動的に変換が開始される。）ADCドライバのソフトウェアトリガ・シングルアクセス設定信号を対象とする。（連続変換方式のみ対象） IOHWAB_Q_ADC_ACCESS_SW_ONE_SINGLE：ソフトウェアトリガにより1回のみ変換が実施される信号。変換完了をトリガに通知される。ADCドライバのソフトウェアトリガ・シングルアクセス設定信号を対象とする。（単一変換方式のみ対象） IOHWAB_Q_ADC_ACCESS_SW_MULTI_SINGLE：ソフトウェアトリガにより停止されるまで何度も変換が実施される信号。変換完了トリガ毎に通知される。ADCドライバのソフトウェアトリガ・シングルアクセス設定信号を対象とする。（連続変換方式のみ対象） IOHWAB_Q_ADC_ACCESS_SW_ONE_CURSTREAM：初回のみソフトウェアトリガ、2回目以降は循環バッファにデータが蓄積されるタイミングをトリガとする信号。循環バッファが満たされた時に通知される。ADCドライバのソフトウェアトリガ・ストリーミングアクセス（サイクルバッファ方式）設定信号を対象とする。（連続変換方式のみ対象） IOHWAB_Q_ADC_ACCESS_SW_ONE_LINSTREAM：初回のみソフトウェアトリガ、2回目以降は直列バッファにデータが蓄積されるタイミングをトリガとする信号。直列バッファが満たされた時に通知される。ADCドライバのソフトウェアトリガ・ストリーミングアクセス（リニアバッファ方式）設定信号を対象とする。（連続変換方式のみ対象）
      container IoHwAbGptNotifyCallback  # - / GPTドライバからの通知処理を行うためのCallback関数を設定するコンテナ。
        function name TimeReachedfunc: set at pre-compile, origin=QINeS  # - / RTEへ通知を行うCallback関数。 使用しない場合はNULLを設定すること。
    container IoHwAbQIcuConfig  # Generic configuration parameters of the IoHwAb Icu module. / このコンテナはIoHwAb Icuのコンフィグレーションパラメータを設定する。
      integer IoHwAbIcuNumOfConfigSet: 0..65535, scope=ECU, set at pre-compile, origin=QINeS  # - / IoHwAb_Icuで、コンフィグレーションされるIoHwAb_Q_IcuConfSetの数（Elementの数）。
      container IoHwAbQIcuConfigSet [0..65535]  # Configuration of the IoHwAb Dio Config. / このコンテナはElementの設定を定義する。 エッジカウントチャネル定義数、エッジ検出チャネル定義数、信号計測チャネル定義数、タイムスタンプチャネル定義数の合計数分、本コンテナの情報を定義する必要がある。
        enumeration Access: {IOHWAB_Q_ICU_TYPE_EDGE_COUNTER, IOHWAB_Q_ICU_TYPE_EDGE_DETECT, IOHWAB_Q_ICU_TYPE_SM_INPUT_STATE, IOHWAB_Q_ICU_TYPE_SM_TIME_ELAPSED, IOHWAB_Q_ICU_TYPE_SM_DUTY_CYCLE, IOHWAB_Q_ICU_TYPE_TIMESTAMP}, scope=ECU, set at pre-compile, origin=QINeS, default-value=IOHWAB_Q_ICU_TYPE_EDGE_COUNTER  # - / アクセス種別を指定すること。 IOHWAB_Q_ADC_ACCESS_HW_ONE_SINGLE：ハードウェアトリガにより1回のみ変換が実施される信号。変換完了をトリガに通知される。ADCドライバのハードウェアトリガ・シングルアクセス設定信号を対象とする。（単一変換方式のみ可能） IOHWAB_Q_ADC_ACCESS_HW_MULTI_SINGLE：ハードウェアトリガにより停止が指示されるまで何度も変換が実施される信号。変換完了をトリガ毎に通知される。ADCドライバのハードウェアトリガ・シングルアクセス設定信号を対象とする。（連続変換方式のみ対象） IOHWAB_Q_ADC_ACCESS_HW_ONE_CURSTREAM：ハードウェアトリガによりバッファフルになるまでデータを蓄積する信号。バッファフルの際にADCドライバステータス（A/D変換状況）をユーザーに通知する。Adc_GetStreamLastPointerもしくは Adc_ReadGroupを呼ぶことで変換が再開される。ADCドライバのハードウェアトリガ・ストリーミングアクセス（サイクルバッファ方式）設定信号を対象とする。（単一変換方式のみ対象） IOHWAB_Q_ADC_ACCESS_HW_ONE_LINSTREAM：ハードウェアトリガによりバッファフルになるまでデータを蓄積する信号。バッファフルの際に通知されSW-Cからの指示によるAdc_EnableHardwareTriggerを呼ぶことで変換が再開される。ADCドライバのハードウェアトリガ・ストリーミングアクセス（リニアバッファ方式）設定信号を対象とする。（単一変換方式のみ対象） IOHWAB_Q_ADC_ACCESS_SW_ONE_POLLING：ソフトウェアトリガにより1回のみ変換が実施される信号。周期処理にて変換完了を監視する。ADCドライバのソフトウェアトリガ・シングルアクセス設定信号を対象とする。（単一変換方式のみ対象） IOHWAB_Q_ADC_ACCESS_SW_MULTI_POLLING：ソフトウェアトリガにより停止が指示されるまで周期処理毎に何度でも変換が実施される信号。（IoHwAb_AdcでADCドライバにA/D値を読みに行くことをトリガにして、自動的に変換が開始される。）ADCドライバのソフトウェアトリガ・シングルアクセス設定信号を対象とする。（連続変換方式のみ対象） IOHWAB_Q_ADC_ACCESS_SW_ONE_SINGLE：ソフトウェアトリガにより1回のみ変換が実施される信号。変換完了をトリガに通知される。ADCドライバのソフトウェアトリガ・シングルアクセス設定信号を対象とする。（単一変換方式のみ対象） IOHWAB_Q_ADC_ACCESS_SW_MULTI_SINGLE：ソフトウェアトリガにより停止されるまで何度も変換が実施される信号。変換完了トリガ毎に通知される。ADCドライバのソフトウェアトリガ・シングルアクセス設定信号を対象とする。（連続変換方式のみ対象） IOHWAB_Q_ADC_ACCESS_SW_ONE_CURSTREAM：初回のみソフトウェアトリガ、2回目以降は循環バッファにデータが蓄積されるタイミングをトリガとする信号。循環バッファが満たされた時に通知される。ADCドライバのソフトウェアトリガ・ストリーミングアクセス（サイクルバッファ方式）設定信号を対象とする。（連続変換方式のみ対象） IOHWAB_Q_ADC_ACCESS_SW_ONE_LINSTREAM：初回のみソフトウェアトリガ、2回目以降は直列バッファにデータが蓄積されるタイミングをトリガとする信号。直列バッファが満たされた時に通知される。ADCドライバのソフトウェアトリガ・ストリーミングアクセス（リニアバッファ方式）設定信号を対象とする。（連続変換方式のみ対象）
        integer Channelid: 0..65535, scope=ECU, set at pre-compile, origin=QINeS  # - / 信号のチャネル番号。 DIOのチャネル番号を指定すること。 IOHWAB_Q_DIOCH_ENABLEがTRUEの時チャネル番号を設定する。
        enumeration Notification: {IOHWAB_Q_ICU_NOTIFICATION_ON, IOHWAB_Q_ICU_NOTIFICATION_OFF}, scope=ECU, set at pre-compile, origin=QINeS, default-value=IOHWAB_Q_ICU_NOTIFICATION_OFF  # - / GPTドライバからの通知要求を以下より選択すること。 IOHWAB_Q_GPT_NOTIFICATION_ON(0)：GPTドライバに通知を要求する IOHWAB_Q_GPT_NOTIFICATION_OFF(1)：GPTドライバに通知を要求しない ライト設定可能なもの（IOHWAB_Q_GPT_PERMISSION_SETのビットが立っているもの）のみ通知要求が可能である。
        enumeration Periodic: {IOHWAB_Q_ICU_PERIODIC_MODE_ON, IOHWAB_Q_ICU_PERIODIC_MODE_OFF}, scope=ECU, set at pre-compile, origin=QINeS, default-value=IOHWAB_Q_ICU_PERIODIC_MODE_OFF  # - / 周期処理対応のElementか直値読み対応のElementかの区分を設定すること。 IOHWAB_Q_DIO_PERIODIC_MODE_ON(0)：周期的に値を読み取る ※周期処理が可能なアクセス種別はチャネル単位アクセスのみ。 IOHWAB_Q_DIO_PERIODIC_MODE_OFF(1)：直接DIOドライバから値を読み取る
        enumeration Permission: {IOHWAB_Q_ICU_PERMISSION_GET, IOHWAB_Q_ICU_PERMISSION_SET, IOHWAB_Q_ICU_PERMISSION_ALL}, scope=ECU, set at pre-compile, origin=QINeS, default-value=IOHWAB_Q_ICU_PERMISSION_GET  # - / パーミッション属性を指定すること。 IOHWAB_Q_ADC_PERMISSION_GET(1)：信号のリード可 IOHWAB_Q_ADC_PERMISSION_SET(2)：信号のライト可 IOHWAB_Q_ADC_PERMISSION_ALL(3)：信号のリード・ライト可
        enumeration Processing: {IOHWAB_Q_ICU_PROCESSING_ONESHOT, IOHWAB_Q_ICU_PROCESSING_DIFF}, scope=ECU, set at pre-compile, origin=QINeS, default-value=IOHWAB_Q_ICU_PROCESSING_ONESHOT  # - / フィルタリング種別を指定すること。 IOHWAB_Q_ADC_PROCESSING_FUNCTION(2)：外部関数を通して値を確認 IOHWAB_Q_ADC_PROCESSING_ONSHOT(3)：フィルタリング処理をせずに読み込んだ値を返す IOHWAB_Q_ADC_PROCESSING_DIFF(4)：前回の値との許容誤差以上の変化があれば値が変わったとみなす IOHWAB_Q_ADC_PROCESSING_DIFFFUNCTION(6)：外部関数を通して値を確認・前回の値との許容誤差以上の変化があれば値が変わったとみなす
        container IoHwAbQIcuCallback  # - / このコンテナは、周期処理（IoHwAb_Q_IcuPeriodic）内でのRTEへの通知で使用するCallback関数を指定する。
          function name Dutycyclefunc: scope=ECU, set at pre-compile, origin=QINeS  # - / 信号計測によるデューティサイクル変化時のCallback関数を指定する。
          function name Edgefunc: scope=ECU, set at pre-compile, origin=QINeS  # - / エッジカウント変化時のCallback関数を指定する。
          function name Elapsedfunc: scope=ECU, set at pre-compile, origin=QINeS  # - / 信号計測による経過時間変化時のCallback関数を指定する。 信号計測チャネル信号有効宣言。
        container IoHwAbQIcuConfFunc [0..0]  # - / 未使用
          function name Coeff: scope=ECU, set at pre-compile, origin=QINeS  # - / フィルタ仕様へのアドレスを指定する。
          function name InitializeFilter: scope=ECU, set at pre-compile, origin=QINeS  # -
          function name PerformFilter: scope=ECU, set at pre-compile, origin=QINeS  # -
        container IoHwAbQIcuInitparam  # - / 本コンテナはICUへ設定する初期値を定義する。
          enumeration Activation: {ICU_Q_NO_EDGE, ICU_RISING_EDGE, ICU_FALLING_EDGE, ICU_BOTH_EDGES}, scope=ECU, set at pre-compile, origin=QINeS  # Definition of the type of activation of an ICU channel. ICU_RISING_EDGE:An appropriate action shall be executed when a rising edge occurs on the ICU input signal. ICU_FALLING_EDGE:An appropriate action shall be executed when a falling edge occurs on the ICU input signal. ICU_BOTH_EDGES:An appropriate action shall be executed when either a rising or falling edge occur on the ICU input signal. / 初期エッジ状態を以下より選択すること。 ICU_Q_NO_EDGE：エッジなし ICU_RISING_EDGE：立ち上がりエッジ ICU_FALLING_EDGE：立ち下がりエッジ ICU_BOTH_EDGES：立ち上がり・立ち下がりの両エッジ 上記設定値はICUドライバの定義値となる。
          container IoHwAbQIcuInitTimeStamp  # - / タイムスタンプ初期値情報。 タイムスタンプチャネル信号有効宣言（IOHWAB_Q_ICUTIMESTAMP_ENABLEとIOHWAB_Q_ICU_TIMESTAMP_SUPPORT）がTRUEの時のみこのコンテナは定義される。
            string Buffer: set at pre-compile, origin=QINeS  # - / タイムスタンプの値を格納するバッファのアドレスを指定する。
            integer IoHwAbIcuNumOfBuffer: 0..65535, scope=ECU, set at pre-compile, origin=QINeS  # - / タイムスタンプの値を格納するバッファの数を指定する。
            integer Notifyinterval: 0..65535, scope=ECU, set at pre-compile, origin=QINeS  # - / 通知の間隔を指定する。 NotifyIntervalに設定した数値分タイムスタンプが行われたとき、ICUドライバは通知を行う。
        container IoHwAbQIcuUpdateCondition  # - / このコンテナは、フィルタリング種別にIOHWAB_Q_ICU_PROCESSING_DIFFを設定した場合に、必要となる許容誤差の設定値を定義する。
          container IoHwAbQIcuCondDutyTime  # - / このコンテナは、信号計測によるデューティサイクル取得時の許容誤差範囲を定義する。
            integer Activemaxdiff: 0..65535, scope=ECU, set at pre-compile, origin=QINeS  # - / デューティサイクルの上方への許容誤差。
            integer Activemindiff: 0..65535, scope=ECU, set at pre-compile, origin=QINeS  # - / デューティサイクルの下方への許容誤差。
            integer Periodmaxdiff: 0..65535, scope=ECU, set at pre-compile, origin=QINeS  # - / 周期の上方への許容誤差。
            integer Periodmindiff: 0..65535, scope=ECU, set at pre-compile, origin=QINeS  # - / 周期の下方への許容誤差。
          container IoHwAbQIcuCondEdgenum  # - / このコンテナは、エッジカウント取得によるエッジカウント値取得時の許容誤差範囲を定義する。
            integer Edgenummaxdiff: 0..65535, scope=ECU, set at pre-compile, origin=QINeS  # - / 上方への許容誤差。
            integer Edgenummindiff: 0..65535, scope=ECU, set at pre-compile, origin=QINeS  # - / 下方への許容誤差。
          container IoHwAbQIcuCondElapsed  # - / このコンテナは、信号計測による経過時間取得時の許容誤差範囲を定義する。
            integer Elapsedmaxdiff: 0..65535, scope=ECU, set at pre-compile, origin=QINeS  # - / 上方への許容誤差。
            integer Elapsedmindiff: 0..65535, scope=ECU, set at pre-compile, origin=QINeS  # - / 下方への許容誤差。
    container IoHwAbQIcuDefinition  # -
      string IoHwAbIcuMutexEnter: set at pre-compile, origin=QINeS  # - / IoHwAb_Q_IcuPeriodicで割り込みを禁止する関数。 SchMから提供される排他制御関数を設定する。 排他制御が必要ない場合は設定の必要はなし。
      string IoHwAbIcuMutexExit: set at pre-compile, origin=QINeS  # - / IoHwAb_Q_IcuPeriodicで割り込みを許可する関数。 SchMから提供される排他制御関数を設定する。 排他制御が必要ない場合は設定の必要はなし。
      boolean IoHwAbQIcuDevErrorDetect: set at pre-compile, origin=QINeS, default-value=true  # Switches the Development Error Detection and Notification on or off. true: Enabled. false: Disabled. / Detモジュールを使用するスイッチ。 TRUE：使用する FALSE：使用しない
      boolean IoHwAbQIcuEdgeCountSupport: set at pre-compile, origin=QINeS  # Adds / removes all services related to the edge counting functionality as listed below, from the code: Icu_ResetEdgeCount(), Icu_EnableEdgeCount(), Icu_DisableEdgeCount(), Icu_GetEdgeNumbers(). true: The services listed above can be used. false: The services listed above can not be used. / ICUドライバのエッジカウント用APIサポートスイッチ。 TRUE：サポート FALSE：非サポート ※ICUドライバ側の設定に合わせて設定すること。
      boolean IoHwAbQIcuEdgeDetectSupport: set at pre-compile, origin=QINeS  # Adds / removes the services related to the edge detection functionality, from the code:Icu_EnableEdgeDetection() and Icu_DisableEdgeDetection(). true: These services can be used. false: These services can not be used. / ICUドライバのエッジ検出用APIサポートスイッチ。 TRUE：サポート FALSE：非サポート ※ICUドライバ側の設定に合わせて設定すること。
      boolean IoHwAbQIcuGetdutycyclevaluesApiSupport: set at pre-compile, origin=QINeS  # Adds / removes the service Icu_GetDutyCycleValues() from the code. true: Icu_GetDutyCycleValues() can be used. false: Icu_GetDutyCycleValues() can not be used. / ICUドライバのIcu_GetDutyCycleValues() APIサポートスイッチ。 TRUE：サポート FALSE：非サポート ※ICUドライバ側の設定に合わせて設定すること。
      boolean IoHwAbQIcuGetinputstateApiSupport: set at pre-compile, origin=QINeS  # Adds / removes the service Icu_GetInputState() from the code. true: Icu_GetInputState() can be used. false: Icu_GetInputState() can not be used. / ICUドライバのIcu_GetInputState() APIサポートスイッチ。 TRUE：サポート FALSE：非サポート ※ICUドライバ側の設定に合わせて設定すること。
      boolean IoHwAbQIcuGettimeelapsedApiSupport: set at pre-compile, origin=QINeS  # Adds / removes the service Icu_GetTimeElapsed() from the code. true: Icu_GetTimeElapsed() can be used. false: Icu_GetTimeElapsed() can not be used. / ICUドライバのIcu_GetTimeElapsed() APIサポートスイッチ。 TRUE：サポート FALSE：非サポート ※ICUドライバ側の設定に合わせて設定すること。
      string IoHwAbQIcuMcal2Io: set at pre-compile, origin=QINeS  # - / MCALの単位をユーザの単位に変換するマクロ。
      string IoHwAbQIcuMcalch2IoHwCh: set at pre-compile, origin=QINeS  # - / ICUドライバが管理しているチャネルIDをIoHwAb_Icuが管理するElement IDに変換するためのマクロ。 システム毎に変換処理を用意する必要がある。
      integer IoHwAbQIcuNumOfChannelId: 0..65535, set at pre-compile, origin=QINeS  # - / Elementに設定されるICUの全チャネル数。
      integer IoHwAbQIcuNumOfEdgeCounter: 0..65536, set at pre-compile, origin=QINeS  # - / エッジカウントチャネル定義数。
      integer IoHwAbQIcuNumOfSignalEdgeDetect: 0..65536, set at pre-compile, origin=QINeS  # - / エッジ検出チャネル定義数。
      integer IoHwAbQIcuNumOfSignalMeasurement: 0..65536, set at pre-compile, origin=QINeS  # - / 信号計測チャネル定義数。
      integer IoHwAbQIcuNumOfTimeStamp: 0..65536, set at pre-compile, origin=QINeS  # - / タイムスタンプチャネル定義数。
      boolean IoHwAbQIcuSignalMeasurementSupport: set at pre-compile, origin=QINeS  # Configures the property that could be measured in case the mode is "IcuSignalMeasurement". This property can not be changed during runtime. Implementation Type: Icu_SignalMeasurementPropertyType / ICUドライバの信号計測用APIサポートスイッチ。 TRUE：サポート FALSE：非サポート ※ICUドライバ側の設定に合わせて設定すること。
      boolean IoHwAbQIcuTimeStampSupport: set at pre-compile, origin=QINeS  # - / ICUドライバのタイムスタンプ用APIサポートスイッチ。 TRUE：サポート FALSE：非サポート ※ICUドライバ側の設定に合わせて設定すること。
    container IoHwAbQIcuLastData [0..65535]  # - / IoHwAb_Icuでは同じチャネルIDを使用するコンフィグレーションが設定されたElementがある場合、ICUドライバから読み込んだ値がクリアされてしまうため、本コンテナによりバッファを用意し値を保持している。 同じチャネルIDが使われているチャネル数分、本コンテナの情報を定義すること。
      integer IoHwAb_IcuNumOfChtoCfgData: 0..65535, set at pre-compile, origin=QINeS  # - / 同じチャネルIDを使用するコンフィグレーションが設定されたElementの数。
      integer pIoHwAb_IcuNumOfData [1..*]: 0..65535, set at pre-compile, origin=QINeS  # - / 同じチャネルを使用するコンフィグレーションが設定されたElementのIDを定義している配列のアドレスを指定する。 IoHwAb_Q_IcuIdType型配列の先頭アドレスを設定すること。
    container IoHwAbQIcuNotifyConfig [0..65535]  # - / このコンテナは、ICUドライバからの通知処理で使用するCallback関数を定義すること。
      enumeration Access: {IOHWAB_Q_ICU_TYPE_EDGE_COUNTER, IOHWAB_Q_ICU_TYPE_EDGE_DETECT, IOHWAB_Q_ICU_TYPE_SM_INPUT_STATE, IOHWAB_Q_ICU_TYPE_SM_TIME_ELAPSED, IOHWAB_Q_ICU_TYPE_SM_DUTY_CYCLE, IOHWAB_Q_ICU_TYPE_TIMESTAMP}, set at pre-compile, origin=QINeS  # - / アクセス種別を指定すること。 IOHWAB_Q_ADC_ACCESS_HW_ONE_SINGLE：ハードウェアトリガにより1回のみ変換が実施される信号。変換完了をトリガに通知される。ADCドライバのハードウェアトリガ・シングルアクセス設定信号を対象とする。（単一変換方式のみ可能） IOHWAB_Q_ADC_ACCESS_HW_MULTI_SINGLE：ハードウェアトリガにより停止が指示されるまで何度も変換が実施される信号。変換完了をトリガ毎に通知される。ADCドライバのハードウェアトリガ・シングルアクセス設定信号を対象とする。（連続変換方式のみ対象） IOHWAB_Q_ADC_ACCESS_HW_ONE_CURSTREAM：ハードウェアトリガによりバッファフルになるまでデータを蓄積する信号。バッファフルの際にADCドライバステータス（A/D変換状況）をユーザーに通知する。Adc_GetStreamLastPointerもしくは Adc_ReadGroupを呼ぶことで変換が再開される。ADCドライバのハードウェアトリガ・ストリーミングアクセス（サイクルバッファ方式）設定信号を対象とする。（単一変換方式のみ対象） IOHWAB_Q_ADC_ACCESS_HW_ONE_LINSTREAM：ハードウェアトリガによりバッファフルになるまでデータを蓄積する信号。バッファフルの際に通知されSW-Cからの指示によるAdc_EnableHardwareTriggerを呼ぶことで変換が再開される。ADCドライバのハードウェアトリガ・ストリーミングアクセス（リニアバッファ方式）設定信号を対象とする。（単一変換方式のみ対象） IOHWAB_Q_ADC_ACCESS_SW_ONE_POLLING：ソフトウェアトリガにより1回のみ変換が実施される信号。周期処理にて変換完了を監視する。ADCドライバのソフトウェアトリガ・シングルアクセス設定信号を対象とする。（単一変換方式のみ対象） IOHWAB_Q_ADC_ACCESS_SW_MULTI_POLLING：ソフトウェアトリガにより停止が指示されるまで周期処理毎に何度でも変換が実施される信号。（IoHwAb_AdcでADCドライバにA/D値を読みに行くことをトリガにして、自動的に変換が開始される。）ADCドライバのソフトウェアトリガ・シングルアクセス設定信号を対象とする。（連続変換方式のみ対象） IOHWAB_Q_ADC_ACCESS_SW_ONE_SINGLE：ソフトウェアトリガにより1回のみ変換が実施される信号。変換完了をトリガに通知される。ADCドライバのソフトウェアトリガ・シングルアクセス設定信号を対象とする。（単一変換方式のみ対象） IOHWAB_Q_ADC_ACCESS_SW_MULTI_SINGLE：ソフトウェアトリガにより停止されるまで何度も変換が実施される信号。変換完了トリガ毎に通知される。ADCドライバのソフトウェアトリガ・シングルアクセス設定信号を対象とする。（連続変換方式のみ対象） IOHWAB_Q_ADC_ACCESS_SW_ONE_CURSTREAM：初回のみソフトウェアトリガ、2回目以降は循環バッファにデータが蓄積されるタイミングをトリガとする信号。循環バッファが満たされた時に通知される。ADCドライバのソフトウェアトリガ・ストリーミングアクセス（サイクルバッファ方式）設定信号を対象とする。（連続変換方式のみ対象） IOHWAB_Q_ADC_ACCESS_SW_ONE_LINSTREAM：初回のみソフトウェアトリガ、2回目以降は直列バッファにデータが蓄積されるタイミングをトリガとする信号。直列バッファが満たされた時に通知される。ADCドライバのソフトウェアトリガ・ストリーミングアクセス（リニアバッファ方式）設定信号を対象とする。（連続変換方式のみ対象）
      container IoHwAbIcuNotifyCallback  # - / このコンテナはICUドライバからの通知に使用するCallback関数の設定を定義する。 ICUドライバからの通知をRTEへ通知する。 RTEで提供されるCallback関数を設定すること。
        function name Edgecntfunc: set at pre-compile, origin=QINeS  # - / エッジチャネル信号有効宣言がTRUEの時、ICUドライバからの通知を行うCallback関数。 使用しない場合はNULLを設定すること。
        function name Inputstatefunc: set at pre-compile, origin=QINeS  # - / エッジ検出信号有効宣言がTRUEの時ICUドライバからの通知を行うCallback関数。 使用しない場合はNULLを設定すること。
        function name Measuementfunc: set at pre-compile, origin=QINeS  # - / 信号計測チャネル信号有効宣言がTRUEの時ICUドライバからの通知を行うCallback関数。 使用しない場合はNULLを設定すること。
        function name Timestampfunc: set at pre-compile, origin=QINeS  # - / タイムスタンプチャネル信号有効宣言がTRUEの時ICUドライバからの通知を行うCallback関数。 使用しない場合はNULLを設定すること。
    container IoHwAbQPwmConfigData  # Generic configuration parameters of the IoHwAb Pwm module. / このコンテナはIoHwAb_Pwmのコンフィグレーションパラメータを設定する。
      integer IoHwAbPwmNumOfConfigSet: 0..256, scope=ECU, set at pre-compile, origin=QINeS, symbolic-name-value=true  # - / IoHwAb_Pwmで、コンフィグレーションされるIoHwAb_Q_PwmConfSetの数（Elementの数）。
      container IoHwAbQPwmConfigSet [0..256]  # Configuration of the IoHwAb Pwm Config. / Element管理用のコンテナのアドレスを指定する。 IoHwAbPwmConfigSetの先頭アドレスを設定する。
        enumeration Access: {IOHWAB_Q_PWM_ALLOW_CYCLE, IOHWAB_Q_PWM_ALLOW_PERIOD, IOHWAB_Q_PWM_ALLOW_CYCLE_PERIOD, IOHWAB_Q_PWM_ALLOW_NONE}, scope=ECU, set at pre-compile, origin=QINeS, default-value=IOHWAB_Q_PWM_ALLOW_CYCLE  # - / アクセス種別を指定すること。 IOHWAB_Q_ADC_ACCESS_HW_ONE_SINGLE：ハードウェアトリガにより1回のみ変換が実施される信号。変換完了をトリガに通知される。ADCドライバのハードウェアトリガ・シングルアクセス設定信号を対象とする。（単一変換方式のみ可能） IOHWAB_Q_ADC_ACCESS_HW_MULTI_SINGLE：ハードウェアトリガにより停止が指示されるまで何度も変換が実施される信号。変換完了をトリガ毎に通知される。ADCドライバのハードウェアトリガ・シングルアクセス設定信号を対象とする。（連続変換方式のみ対象） IOHWAB_Q_ADC_ACCESS_HW_ONE_CURSTREAM：ハードウェアトリガによりバッファフルになるまでデータを蓄積する信号。バッファフルの際にADCドライバステータス（A/D変換状況）をユーザーに通知する。Adc_GetStreamLastPointerもしくは Adc_ReadGroupを呼ぶことで変換が再開される。ADCドライバのハードウェアトリガ・ストリーミングアクセス（サイクルバッファ方式）設定信号を対象とする。（単一変換方式のみ対象） IOHWAB_Q_ADC_ACCESS_HW_ONE_LINSTREAM：ハードウェアトリガによりバッファフルになるまでデータを蓄積する信号。バッファフルの際に通知されSW-Cからの指示によるAdc_EnableHardwareTriggerを呼ぶことで変換が再開される。ADCドライバのハードウェアトリガ・ストリーミングアクセス（リニアバッファ方式）設定信号を対象とする。（単一変換方式のみ対象） IOHWAB_Q_ADC_ACCESS_SW_ONE_POLLING：ソフトウェアトリガにより1回のみ変換が実施される信号。周期処理にて変換完了を監視する。ADCドライバのソフトウェアトリガ・シングルアクセス設定信号を対象とする。（単一変換方式のみ対象） IOHWAB_Q_ADC_ACCESS_SW_MULTI_POLLING：ソフトウェアトリガにより停止が指示されるまで周期処理毎に何度でも変換が実施される信号。（IoHwAb_AdcでADCドライバにA/D値を読みに行くことをトリガにして、自動的に変換が開始される。）ADCドライバのソフトウェアトリガ・シングルアクセス設定信号を対象とする。（連続変換方式のみ対象） IOHWAB_Q_ADC_ACCESS_SW_ONE_SINGLE：ソフトウェアトリガにより1回のみ変換が実施される信号。変換完了をトリガに通知される。ADCドライバのソフトウェアトリガ・シングルアクセス設定信号を対象とする。（単一変換方式のみ対象） IOHWAB_Q_ADC_ACCESS_SW_MULTI_SINGLE：ソフトウェアトリガにより停止されるまで何度も変換が実施される信号。変換完了トリガ毎に通知される。ADCドライバのソフトウェアトリガ・シングルアクセス設定信号を対象とする。（連続変換方式のみ対象） IOHWAB_Q_ADC_ACCESS_SW_ONE_CURSTREAM：初回のみソフトウェアトリガ、2回目以降は循環バッファにデータが蓄積されるタイミングをトリガとする信号。循環バッファが満たされた時に通知される。ADCドライバのソフトウェアトリガ・ストリーミングアクセス（サイクルバッファ方式）設定信号を対象とする。（連続変換方式のみ対象） IOHWAB_Q_ADC_ACCESS_SW_ONE_LINSTREAM：初回のみソフトウェアトリガ、2回目以降は直列バッファにデータが蓄積されるタイミングをトリガとする信号。直列バッファが満たされた時に通知される。ADCドライバのソフトウェアトリガ・ストリーミングアクセス（リニアバッファ方式）設定信号を対象とする。（連続変換方式のみ対象）
        integer Channelid: 0..255, scope=ECU, set at pre-compile, origin=QINeS  # - / 信号のチャネル番号。 DIOのチャネル番号を指定すること。 IOHWAB_Q_DIOCH_ENABLEがTRUEの時チャネル番号を設定する。
        enumeration Notification: {IOHWAB_Q_PWM_NOTIFICATION_ON, IOHWAB_Q_PWM_NOTIFICATION_OFF}, scope=ECU, set at pre-compile, origin=QINeS, default-value=IOHWAB_Q_PWM_NOTIFICATION_OFF  # - / GPTドライバからの通知要求を以下より選択すること。 IOHWAB_Q_GPT_NOTIFICATION_ON(0)：GPTドライバに通知を要求する IOHWAB_Q_GPT_NOTIFICATION_OFF(1)：GPTドライバに通知を要求しない ライト設定可能なもの（IOHWAB_Q_GPT_PERMISSION_SETのビットが立っているもの）のみ通知要求が可能である。
        enumeration NotificationType: {PWM_NO_EDGE, PWM_RISING_EDGE, PWM_FALLING_EDGE, PWM_BOTH_EDGES}, scope=ECU, set at pre-compile, origin=QINeS  # Definition of the type of edge notification of a PWM channel. PWM_RISING_EDGE:Notification will be called when a rising edge occurs on the PWM output signal. PWM_FALLING_EDGE:Notification will be called when a falling edge occurs on the PWM output signal. PWM_BOTH_EDGES:Notification will be called when either a rising edge or falling edge occur on the PWM output signal. / PWMからの通知を受け取るエッジの設定。 PWM_NO_EDGE(0)：エッジなし PWM_RISING_EDGE(1)：立ち上がりエッジ PWM_FALLING_EDGE(2)：立ち下がりエッジ PWM_BOTH_EDGES(3)：立ち上がり・立ち下がりの両エッジ 上記設定値はPWMドライバの定義値となる。ライト設定可能なもの（ IOHWAB_Q_PWM_PERMISSION_SETのビットが立っているもの）かつ IOHWAB_Q_PWM_NOTIFICATION_ONの時のみ、通知を受け取るエッジの設定が有効である。
        enumeration Permission: {IOHWAB_Q_PWM_PERMISSION_GET, IOHWAB_Q_PWM_PERMISSION_SET, IOHWAB_Q_PWM_PERMISSION_ALL}, scope=ECU, set at pre-compile, origin=QINeS, default-value=IOHWAB_Q_PWM_PERMISSION_GET  # - / パーミッション属性を指定すること。 IOHWAB_Q_ADC_PERMISSION_GET(1)：信号のリード可 IOHWAB_Q_ADC_PERMISSION_SET(2)：信号のライト可 IOHWAB_Q_ADC_PERMISSION_ALL(3)：信号のリード・ライト可
        container Setting  # - / PWMへの初期設定値のコンテナ。ライト設定可能なもの（IOHWAB_Q_PWM_PERMISSION_SETのビットが立っているもの）のみ本コンテナを使用する。
          integer Cycle: 0..32768, scope=ECU, set at pre-compile, origin=QINeS  # - / PWMチャネルのデューティサイクル値。
          integer Period: 0..65535, scope=ECU, set at pre-compile, origin=QINeS  # - / PWMチャネルの周期値。（レンジはマクロ依存である。マクロIOHWAB_Q_PWM2MCAL）
    container IoHwAbQPwmDefinition  # -
      string IoHwAbQPwm2Mcal: set at pre-compile, origin=QINeS  # - / ユーザーの指定した周期値をPWMドライバの単位に変換するマクロ。 システム毎に変換処理を用意する必要がある。 ユーザーの使用する単位をPWMドライバの単位に変換する変換式を設定する。
      boolean IoHwAbQPwmDevErrorDetect: set at pre-compile, origin=QINeS, default-value=true  # Switch for enabling the development error detection. / Detモジュールを使用するスイッチ。 TRUE：使用する FALSE：使用しない
      boolean IoHwAbQPwmGetOutputStateApiSupport: set at pre-compile, origin=QINeS  # The function Pwm_GetOutputState shall be configurable On/Off by the configuration parameter: PwmGetOutputState / PWMドライバのAPI（Pwm_GetOutputState）サポートスイッチ。 TRUE：サポート FALSE：非サポート ※PWMドライバ側の設定に合わせて設定する。
      string IoHwAbQPwmMcalCh2IohwCh: set at pre-compile, origin=QINeS  # - / PWMドライバが管理しているチャネルIDをIoHwAb_Pwmが管理するElement IDに変換するためのマクロ。 システム毎に変換処理を用意する必要がある。
      boolean IoHwAbQPwmNotifySupport: set at pre-compile, origin=QINeS  # - / PWMドライバの通知機能用APIサポートスイッチ。 TRUE：サポート FALSE：非サポート ※PWMドライバ側の設定に合わせて設定する。
      integer IoHwAbQPwmNumOfCycle: 0..256, set at pre-compile, origin=QINeS  # - / デューティサイクル変更可能チャネルの定義数。
      integer IoHwAbQPwmNumOfCyclePeriod: 0..256, set at pre-compile, origin=QINeS  # - / デューティサイクル・周期変更可能チャネルの定義数。
      integer IoHwAbQPwmNumOfNone: 0..256, set at pre-compile, origin=QINeS  # - / 変更不可チャネルの定義数。
      integer IoHwAbQPwmNumOfPeriod: 0..256, set at pre-compile, origin=QINeS  # - / 周期変更可能チャネルの定義数。
      boolean IoHwAbQPwmSetDutyCycleApiSupport: set at pre-compile, origin=QINeS  # The function Pwm_SetDutyCycle shall be configurable On/Off by the configuration parameter: PwmSetDutyCycle / PWMドライバのAPI（Pwm_SetDutyCycle）サポートスイッチ。 TRUE：サポート FALSE：非サポート
      boolean IoHwAbQPwmSetOutputToidleApiSupport: set at pre-compile, origin=QINeS  # The function Pwm_SetOutputToIdle shall be configurable On/Off by the configuration parameter: PwmSetOutputToIdle / PWMドライバのAPI（Pwm_SetOutputToIdle）サポートスイッチ。 TRUE：サポート FALSE：非サポート ※PWMドライバ側の設定に合わせて設定する。
      boolean IoHwAbQPwmSetPeriodAndDutyApiSupport: set at pre-compile, origin=QINeS  # The function Pwm_SetPeriodAndDuty shall be configurable On/Off by the configuration parameter: PwmSetPeriodAndDuty / PWMドライバのAPI（Pwm_SetPeriodAndDuty）サポートスイッチ。 TRUE：サポート FALSE：非サポート ※PWMドライバ側の設定に合わせて設定すること。
      integer IohwabQPwmNumOfChannelId: 0..256, set at pre-compile, origin=QINeS  # - / PWMの全チャネル数。
    container IoHwAbQPwmNotifyConfig [0..255]  # Generic configuration parameters of the IoHwAb Pwm module. / このコンテナはIoHwAb Pwmのコンフィグレーションパラメータを設定する。
      container Notifycallback  # - / このコンテナはPWMドライバからの通知に使用するCallback関数の設定を定義する。PWMドライバからの通知をRTEへ通知する。RTEで提供されるCallback関数を設定すること。
        function name Edgefunc: set at pre-compile, origin=QINeS  # - / エッジカウント変化時のCallback関数を指定する。
    container IoHwAbQRteIoHwAbAdc [0..1]  # - / RteからのAdc初期化処理。
      container IoHwAbQAdcPeriodic [1..*]  # - / ADCドライバ用に定義されているElementを開始IDから終端IDまでを周期処理をする。 周期処理では、Elementに設定されているコンフィグレーションに従いA/D変換を行う。 RTEへの通知設定がされている場合は、A/D変換状態をRTEへ通知を行う。
        integer PeriodicEnd: 0..65535, set at pre-compile, origin=QINeS  # - / エレメントの終了ID。 MAX=65535 MIN=0
        integer PeriodicStart: 0..65535, set at pre-compile, origin=QINeS  # - / エレメントの開始ID。 MAX=65535 MIN=0
    container IoHwAbQRteIoHwAbDio [0..1]  # - / RteからのDio初期化処理。
      container IoHwAbQDioPeriodic [1..*]  # - / コンフィグレーションのDIOドライバ用に定義されているElementを開始IDから終端IDまで周期処理をする。 周期処理では、Elementに設定されているコンフィグレーションに従いリード処理を行う。 RTEへの通知設定がONに設定されている場合は、周期処理中に取得値の変化があった場合にRTEへ通知を行う。
        integer PeriodicEnd: 0..65535, set at pre-compile, origin=QINeS  # - / エレメントの終了ID。 MAX=65535 MIN=0
        integer PeriodicStart: 0..65535, set at pre-compile, origin=QINeS  # - / エレメントの開始ID。 MAX=65535 MIN=0
    container IoHwAbQRteIoHwAbIcu [0..1]  # - / RteからのIcu初期化処理。
      container IoHwAbQIcuPeriodic [1..*]  # - / ICUドライバ用に定義されているElementを開始IDから終端IDまでを周期処理をする。 周期処理では、Elementに設定されているコンフィグレーションに従いリード処理を行う。 RTEへの通知設定がONに設定されている場合は、周期処理中に取得値の変化があった場合にRTEへ通知を行う。
        integer PeriodicEnd: 0..65535, set at pre-compile, origin=QINeS  # - / エレメントの終了ID。 MAX=65535 MIN=0
        integer PeriodicStart: 0..65535, set at pre-compile, origin=QINeS  # - / エレメントの開始ID。 MAX=65535 MIN=0

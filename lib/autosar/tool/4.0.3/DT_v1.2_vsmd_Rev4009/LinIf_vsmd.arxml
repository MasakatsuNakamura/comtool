AUTOSAR XML (schema 4-0-3)
package /QINeS
  ecuc definition collection AUTOSARParameterDefinition: module=LinIf
  module definition LinIf [0..1]: refined-module-def=LinIf, variants link-time/post-build/pre-compile  # Configuration of the LinIf (LIN Interface) module. / LinIfモジュールのコンフィグレーション。
    container LinIfGeneral  # This container contains the general parameters of LIN Interface module. / LINインタフェースのジェネラルパラメータ。
      boolean LinIfCancelTransmitSupported: set at pre-compile  # Global Pre-Compile Switch to reliably prevent the generation of the dummy LinIf_CancelTransmit API. / TRUE：LinIf_CancelTransmit関数を有効にする FALSE：LinIf_CancelTransmit関数を無効にする
      boolean LinIfDevErrorDetect: set at pre-compile  # Switches the Development Error Detection and Notification ON or OFF. / TRUE：開発時エラーを有効にする FALSE：開発時エラーを無効にする
      boolean LinIfMultipleDriversSupported: set at pre-compile  # States if multiple drivers are included in the LIN Interface or not. The reason for this parameter is to reduce the size of LIN Interface if multiple drivers are not used. / TRUE：複数のドライバをサポートする FALSE：複数のドライバをサポートしない
      boolean LinIfMultipleTrcvDriverSupported: set at pre-compile  # States if multiple transceiver drivers are included in the LIN Interface or not. The reason for this parameter is to reduce the size of LIN Interface if multiple transceiver drivers are not used. / TRUE：複数のLinTrcvをサポートする FALSE：複数のLinTrcvをサポートしない
      boolean LinIfNcOptionalRequestSupported: set at pre-compile  # States if the node configuration commands Assign NAD and Conditional Change NAD are supported. / TRUE：Assign NADとConditional Change NADをサポートする FALSE：Assign NADとConditional Change NADをサポートしない
      string LinIfPublicCddHeaderFile [0..0]: scope=ECU, set at pre-compile, max-length=32, min-length=1  # Defines header files for callback functions which shall be included in case of CDDs. Range of characters is 1.. 32. / 未使用
      boolean LinIfQTransceiverDrvConfigEnable: set at pre-compile, origin=QINeS  # States if the TP is included in the LIN Interface or not. The reason for this parameter is to reduce the size of LIN Interface if the TP is not used. / TRUE：LinIfTransceiverDrvConfigを有効にする FALSE：LinIfTransceiverDrvConfigを無効にする
      boolean LinIfTpSupported: set at pre-compile  # States if the TP is included in the LIN Interface or not. The reason for this parameter is to reduce the size of LIN Interface if the TP is not used. / TRUE：トランスポートプロトコルをサポートする FALSE：トランスポートプロトコルをサポートしない
      boolean LinIfTrcvDriverSupported: set at pre-compile  # States if transceiver drivers are included in the LIN Interface or not. The reason for this parameter is to reduce the size of LIN Interface if transceiver drivers are not used. / TRUE：LinTrcvをサポートする FALSE：LinTrcvをサポートしない
      boolean LinIfVersionInfoApi: set at pre-compile  # Switches the LinIf_GetVersionInfo function ON or OFF. / TRUE：LinIf_GetVersionInfoを有効にする FALSE：LinIf_GetVersionInfoを無効にする
    container LinIfGlobalConfig [1..*]: multiple-configuration-container=true  # This container contains the global configuration parameter of the LinIf. / LinIfの全体的な設定パラメータが含まれているコンテナである。 | It is a MultipleConfigurationContainer, i.e. this container and its sub-containers exit once per configuration set.
      integer LinIfTimeBase: 1..255, set at link in variant link-time / post-build in variant post-build / pre-compile in variant pre-compile  # The delay between processing two frames is a multiple of the LIN Interface time-base in seconds. / 周期処理の間隔をTick単位で指定すること。設定されたLinIfClusterTimeBaseの最大公約数を指定する。 (1..255)
      container LinIfChannel [0..*]  # Describes each LIN channel the LinIf is connected to. / LinIfモジュールが制御するチャネル情報。
        integer LinIfChannelId: 0..255, set at link in variant link-time+post-build / pre-compile in variant pre-compile, symbolic-name-value=true  # This parameter holds the unique channel index value. The value shall be the same as the ComMChannelId of the ComMChannel referenced by LinIfComMNetworkHandleRef. / チャネル番号を一意の値で指定すること。(0..255) ComMモジュールのComMCHannelIdと同じ値に設定すること。 | Implementation Type: NetworkHandleType
        enumeration LinIfGotoSleepConfirmationUL [0..0]: {LINIF_CDD, LINIF_LIN_SM}, scope=ECU, set at link in variant link-time / post-build in variant post-build / pre-compile in variant pre-compile  # This parameter defines the upper layer (UL) module to which the confirmation of the goto-sleep command shall be sent. / 未使用
        enumeration LinIfScheduleRequestConfirmationUL [0..0]: {LINIF_CDD, LINIF_LIN_SM}, scope=ECU, set at link in variant link-time / post-build in variant post-build / pre-compile in variant pre-compile  # This parameter defines the upper layer (UL) module to which the confirmation of the successfully performed schedule table change. / 未使用
        enumeration LinIfStartupState: {LINIF_NORMAL, LINIF_SLEEP}, set at link in variant link-time+post-build / pre-compile in variant pre-compile  # Defines the state of each LIN channel after startup / 初期化後のLINチャネルの状態を以下より指定すること。 NORMAL(0)：初期化後にCHANNEL_OPERATIONALとなる SLEEP(1)：初期化後にCHANNEL_SLEEPとなる
        enumeration LinIfWakeupConfirmationUL [0..0]: {LINIF_CDD, LINIF_LIN_SM}, scope=ECU, set at link in variant link-time / post-build in variant post-build / pre-compile in variant pre-compile  # This parameter defines the upper layer (UL) module to which the confirmation of the wake-up shall be sent. / 未使用
        symbolic name reference LinIfChannelRef: set at link in variant link-time+post-build / pre-compile in variant pre-compile, destination=LinChannel  # Reference to the used channel in Lin. / チャネルが紐付くLINチャネルへの参照データ。IDを指定すること。(0..255) | Replaces LINIF_CHANNEL_INDEX
        symbolic name reference LinIfComMNetworkHandleRef: scope=ECU, set at link in variant link-time+post-build / pre-compile in variant pre-compile, destination=ComMChannel  # Unique handle to identify one certain LIN network. Reference to one of the network handles configured for the ComM. / チャネルが紐付くComMで設定されたネットワークハンドルへの参照データ。
        container LinIfFrame [0..*]  # Generic container for all types of LIN frames. The shortName of this container is used as LinIfFrameName. / チャネルが扱うフレーム情報。
          enumeration LinIfChecksumType: {LINIF_CLASSIC, LINIF_ENHANCED}, set at link in variant link-time / post-build in variant post-build / pre-compile in variant pre-compile  # Type of checksum that the frame is using. / フレームのチェックサムの種類を指定すること。 CLASSIC(0)：Classicを選択する ENHANCED(1)：Enhancedを選択する
          enumeration LinIfFrameType: {LINIF_ASSIGN, LINIF_ASSIGN_FRAME_ID_RANGE, LINIF_ASSIGN_NAD, LINIF_CONDITIONAL, LINIF_EVENT_TRIGGERED, LINIF_FREE, LINIF_MRF, LINIF_SAVE_CONFIGURATION, LINIF_SPORADIC, LINIF_SRF, LINIF_UNASSIGN, LINIF_UNCONDITIONAL}, set at link in variant link-time / post-build in variant post-build / pre-compile in variant pre-compile  # Type of frame that is described (e.g. sporadic frame). / フレームの種類を以下から指定すること。 ASSIGN(0) ASSIGN_FRAME_ID_RANGE(1) ASSIGN_NAD(2) CONDITIONAL(3) EVENT_TRIGGERED(4) FREE(5) MRF(6) SAVE_CONFIGURATION(7) SPORADIC(8) SRF(9) UNASSIGN(10) UNCONDITIONAL(11) UNCONDITIONALフレーム以外はMRF、SRF、UNCONDITIONAL フレーム以外は基本的 なLin 通信、診断機能には必須では無いため未サポート。 | The sporadic slot is not found among the frame types. A sporadic slot is a set of sporadic frames.
          integer LinIfLength: 1..8, set at link in variant link-time / post-build in variant post-build / pre-compile in variant pre-compile  # Length of the LIN SDU in bytes. / バイト単位でのSDUの長さを指定すること。(1..8)
          integer LinIfPid: 0..63, set at link in variant link-time / post-build in variant post-build / pre-compile in variant pre-compile  # Protected ID of the LIN frame. There is no reason to calculate the Parity in run-time. / LINフレームのパリティの計算結果を入れてください。また、実行時にパリティを計算は不要である。(0..255)
          enumeration LinIfTypeOfDirection: {LINIF_Q_INTERNAL_PDU, LINIF_Q_RX_PDU, LINIF_Q_SLAVE_TO_SLAVE_PDU, LINIF_Q_TX_PDU}, set at link in variant link-time / post-build in variant post-build / pre-compile in variant pre-compile
          container LinIfFixedFrameSdu [0..0]  # In case this is a fixed frame this is the SDU (response). / 未使用 | This container represent an eight byte array. The Byte order shall be MSB first.
            container LinIfFixedFrameSduByte [8..8]  # This container represents a byte within the 8 byte array. / 未使用
              integer LinIfFixedFrameSduBytePos: 0..7, set at link in variant link-time / post-build in variant post-build / pre-compile in variant pre-compile  # Index of the Byte in the SDU (response) 8 byte array. / 未使用
              integer LinIfFixedFrameSduByteVal: 0..255, set at link in variant link-time / post-build in variant post-build / pre-compile in variant pre-compile  # Byte value in the SDU (response) 8-byte array. / 未使用
          choice container LinIfPduDirection  # Direction of the frame / フレームが紐付くPDU情報への参照データ。
            container LinIfInternalPdu [0..1]  # Represents a Diagnostic or Configuration frame : no Message ID (no PduId). / 未使用
              integer LinIfInternalDummy: 0..65535, set at link in variant link-time / post-build in variant post-build / pre-compile in variant pre-compile, origin=QINeS, default-value=0
            container LinIfRxPdu [0..1]  # represents a received PDU/frame / 受信PDU情報。
              function name LinIfRxIndicationUL [0..1]: scope=ECU, set at link in variant link-time / post-build in variant post-build / pre-compile in variant pre-compile  # This parameter defines the name of the <User_RxIndication>. This parameter depends on the parameter LinIfUserRxIndicationUL. / 受信完了時に呼ばれるコールバック関数を指定すること。 | If LinIfUserRxIndicationUL equals PDUR, the name of the <User_RxIndication> is fixed. If LinIfUserRxIndicationUL equals CDD, the name of the <User_RxIndication> is selectable.
              enumeration LinIfUserRxIndicationUL [0..0]: {LINIF_CDD, LINIF_PDUR}, set at link in variant link-time / post-build in variant post-build / pre-compile in variant pre-compile  # This parameter defines the upper layer (UL) module to which the indication of the successfully received LINRXPDUID has to be routed via <User_RxIndication>. / 未使用 | This <User_RxIndication> has to be invoked when the indication of the configured LINRXPDUID will be received by a Rx indication event from the LIN Driver module.
              reference LinIfRxPduRef: set at link in variant link-time / post-build in variant post-build / pre-compile in variant pre-compile, destination=Pdu  # Reference to the PDU that is received in this frame. / 上位レイヤに受信完了を通知する際のPduID。上位レイヤで定義しているPduIDを指定すること。(0..255)
            container LinIfSlaveToSlavePdu [0..1]  # represents a slave-to-slave PDU/frame. Master does only send the header but doesn't receive the response. / 未使用 | Added for completeness
              integer LinIfSlaveToSlaveDummy: 0..65535, set at link in variant link-time / post-build in variant post-build / pre-compile in variant pre-compile, origin=QINeS, default-value=0  # - / 未使用
            container LinIfTxPdu [0..1]  # represents a transmitted PDU/frame / 送信PDU情報。
              function name LinIfTxConfirmationUL [0..1]: scope=ECU, set at link in variant link-time / post-build in variant post-build / pre-compile in variant pre-compile  # This parameter defines the name of the <User_TxConfirmation>. This parameter depends on the parameter LinIfUserTxUL. / 送信完了時に呼ばれるコールバック関数を指定すること。 | If LinIfUserTxUL equals PDUR, the name of the <User_TxConfirmation> is fixed. If LinIfUserTxUL equals CDD, the name of the <User_TxConfirmation> is selectable.
              integer LinIfTxPduId: 0..255, set at link in variant link-time / post-build in variant post-build / pre-compile in variant pre-compile, symbolic-name-value=true  # Identifier of the Pdu for the upper layer. / 上位レイヤに送信完了を通知する際のPduID。上位レイヤで定義しているPduIDを指定すること。(0..255)
              function name LinIfTxTriggerTransmitUL [0..1]: scope=ECU, set at link in variant link-time / post-build in variant post-build / pre-compile in variant pre-compile  # This parameter defines the name of the <User_TriggerTransmit>. This parameter depends on the parameter LinIfUserTxUL. If LinIfUserTxUL equals PDUR, the name of the <User_TriggerTransmit> is fixed. / 送信要求があったときに呼ばれるコールバック関数を指定すること。 | If LinIfUserTxUL equals CDD, the name of the <User_TriggerTransmit> is selectable.
              enumeration LinIfUserTxUL [0..0]: {LINIF_CDD, LINIF_PDUR}, scope=ECU, set at link in variant link-time / post-build in variant post-build / pre-compile in variant pre-compile  # This parameter defines the upper layer (UL) module to which the trigger of the transmitted LinTxPdu (via the <User_TriggerTransmit>) or the confirmation of the successfully transmitted LinTxPdu has to be routed (via the <User_TxConfirmation>). / 未使用
              reference LinIfTxPduRef: set at link in variant link-time / post-build in variant post-build / pre-compile in variant pre-compile, destination=Pdu  # Reference to the PDU that is transmitted in this frame. / 上位レイヤに送信開始を通知する際のPduID。上位レイヤで定義しているPduIDを指定すること。(0..255)
          container LinIfSubstitutionFrames [0..0]  # List of unconditional Frames that can be sent in a sporadic Frame slot. / 未使用
            integer LinIfFramePriority: 0..255, set at link in variant link-time / post-build in variant post-build / pre-compile in variant pre-compile  # Priority of an unconditional frame if used as a sporadic frame. / 未使用
            reference LinIfSubstitutionFrameRef: set at link in variant link-time / post-build in variant post-build / pre-compile in variant pre-compile, destination=LinIfFrame  # Reference to an unconditional Frame that can be sent in a sporadic Frame slot. / 未使用
        container LinIfMaster  # Each Master can only be connected to one physical channel. This could be compared to the Node parameter in a LDF file. / LINマスター動作情報。
          integer LinIfClusterTimeBase: 1..255, set at link in variant link-time / post-build in variant post-build / pre-compile in variant pre-compile  # Defines a time-base for one LIN cluster in seconds (normally 0.002, 0.005 or 0.010s). / Tick単位でLINクラスタの処理の間隔(=time-base)を指定すること。 (1..255)
          integer LinIfJitter [0..0]: 0..255, set at pre-compile  # The jitter specifies the differences between the maximum and minimum delay from time base tick to the header sending start point in seconds. / 未使用
        container LinIfScheduleTable [1..*]  # Describes a schedule table. Each LinIfChannel may have several schedule tables. Each schedule table can only be connected to one channel. / スケジュールテーブル情報。
          enumeration LinIfResumePosition: {LINIF_START_FROM_BEGINNING, LINIF_CONTINUE_AT_IT_POINT}, set at link in variant link-time / post-build in variant post-build / pre-compile in variant pre-compile  # Defines, where a schedule table shall be proceeded in case if it has been interrupted by a RUN-ONCE table. / スケジュールテーブルによって割り込みが発生したあと、どのように復帰するのか設定する。 START_FROM_BEGINNING：スケジュールテーブルの初めから開始する CONTINUE_AT_IT_POINT：割り込みがあった地点から復帰する
          enumeration LinIfRunMode: {LINIF_RUN_CONTINUOUS, LINIF_RUN_ONCE}, set at link in variant link-time / post-build in variant post-build / pre-compile in variant pre-compile  # The schedule table can be executed in two different modes. / スケジュールのモードを次の2つから指定すること。 RUN_CONTINUOUS： 継続して実行される RUN_ONCE：一度だけ実行される
          enumeration LinIfScheduleMode: {LINTP_APPLICATIVE_SCHEDULE, LINTP_DIAG_REQUEST, LINTP_DIAG_RESPONSE}, set at link in variant link-time / post-build in variant post-build / pre-compile in variant pre-compile  # The schedule table can be executed in three different modes. / 未使用
          integer LinIfScheduleTableIndex: 0..255, set at link in variant link-time / post-build in variant post-build / pre-compile in variant pre-compile, symbolic-name-value=true  # This is the unique index used by upper layers to identify a schedule. Note that the NULL_SCHEDULE for each channel has index 0. / 上位層によってスケジュールテーブルを識別するためのインデックスである。(0..255) NULL_SCHEDULEが指定された場合は0が指定されることに注意すること。
          string LinIfScheduleTableName [0..0]: set at link in variant link-time / post-build in variant post-build / pre-compile in variant pre-compile  # Optional schedule name used to cross-reference with a LDF. This parameter shall always be accompanied by LIN_IF_SCHEDULE_INDEX. / 未使用
          container LinIfEntry [0..*]  # Describes an entry in the schedule table (also known as Frame Slot). / スケジュールテーブルが紐付くエントリ情報。
            integer LinIfDelay: 0..255, set at link in variant link-time / post-build in variant post-build / pre-compile in variant pre-compile  # Delay to next entry in schedule table in seconds. / 次のエントリまでの間隔をTick単位で指定すること。(0..255)
            integer LinIfEntryIndex: 0..255, set at link in variant link-time / post-build in variant post-build / pre-compile in variant pre-compile  # Position of the Frame Entry in the Schedule Table. The first entry index in the schedule table is 0. / スケジュールテーブル中のフレームのエントリを指定すること。最初のエントリは0となる。
            reference LinIfCollisionResolvingRef [0..0]: set at link in variant link-time / post-build in variant post-build / pre-compile in variant pre-compile, destination=LinIfScheduleTable  # Reference to the schedule table, which resolves the collision. / 未使用
            reference LinIfFrameRef [1..*]: set at link in variant link-time / post-build in variant post-build / pre-compile in variant pre-compile, destination=LinIfFrame  # Reference to the frames that belong to this schedule table entry. / エントリが扱うフレーム情報への参照データ。
        container LinIfSlave [0..0]  # The Node attributes of the Slaves are provided with these parameter. The ShortName of this container is used as LinIfNodeName. / 未使用
          integer LinIfConfiguredNad: 0..255, set at link in variant link-time+post-build / pre-compile in variant pre-compile  # Definition of the initial node address / 未使用
          integer LinIfFunctionId: 0..255, set at link in variant link-time+post-build / pre-compile in variant pre-compile  # LIN function ID / 未使用
          string LinIfProtocolVersion: set at link in variant link-time+post-build / pre-compile in variant pre-compile  # Defines the LIN Protocol version which is used by the slave. / 未使用
          integer LinIfSupplierId: 0..65535, set at link in variant link-time+post-build / pre-compile in variant pre-compile  # LIN Supplier ID / 未使用
          integer LinIfVariant: 0..255, set at link in variant link-time+post-build / pre-compile in variant pre-compile  # Specifies the Variant ID / 未使用
        container LinIfTransceiverDrvConfig [0..1]  # This container contains the configuration (parameters) of all addressed LIN transceivers by each underlying LIN Transceiver Driver. / チャネルが紐付くLINトランシーバドライバ情報。
          boolean LinIfTrcvWakeupNotification [0..0]: scope=ECU, set at link in variant link-time+post-build / pre-compile in variant pre-compile, default-value=false  # Selects whether wakeup indication notification is supported. / 未使用 | True: Enabled False: Disabled
          symbolic name reference LinIfTrcvIdRef: scope=ECU, set at link in variant link-time+post-build / pre-compile in variant pre-compile, destination=LinTrcvChannel  # Logical handle of the underlying LIN transceiver to be served by the LIN Interface. / LINトランシーバドライバ情報への参照データ。IDを指定すること。(0..255)

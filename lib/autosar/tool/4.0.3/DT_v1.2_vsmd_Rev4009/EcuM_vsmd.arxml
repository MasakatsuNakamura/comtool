AUTOSAR XML (schema 4-0-3)
package /QINeS
  ecuc definition collection AUTOSARParameterDefinition: module=EcuM
  module definition EcuM [0..1]: refined-module-def=EcuM, variants post-build  # Configuration of the EcuM (ECU State Manager) module. / EcuMモジュールのコンフィグレーション。
    container EcuMConfiguration: multiple-configuration-container=true  # This container contains the configuration (parameters) of the ECU State Manager. / 本モジュールのコンフィグレーション（パラメータ）が含まれている。
      container EcuMCommonConfiguration  # This container contains the common configuration (parameters) of the ECU State Manager. / 本モジュールの一般的なコンフィグレーション（パラメータ）が含まれている。
        integer EcuMConfigConsistencyHash: 0..4294967295, set at link  # A hash value generated across all pre-compile and link-time parameters of all BSW modules. This hash value is compared against a field in the EcuM_ConfigType and hence allows checking the consistency of the entire configuration. / すべてのBSWモジュールのすべてのプリコンパイル時、及び、リンク時パラメータから算出したハッシュ値。 このハッシュ値はEcuM_ConfigTypeのフィールドと比較され、全体構成の整合性をチェックすることができる。
        reference EcuMDefaultAppMode: set at post-build, destination=OsAppMode  # The default application mode loaded when the ECU comes out of reset. / OS起動時のデフォルトのアプリケーションモード。
        reference EcuMOSResource: set at pre-compile, destination=OsResource  # This parameter is a reference to a OS ressource which is used to bring the ECU into sleep mode. / このパラメータは、ECUをスリープモードへ移行させるために使用されるOsResourceへの参照である。 マルチコアの場合、各コアは、独自のOsResourceを持たなければならない。 | In case of multi core each core shall have an own OsResource.
        container EcuMDefaultShutdownTarget  # This container describes the default shutdown target to be selected by EcuM. The actual shutdown target may be overridden by the EcuM_SelectShutdownTarget service. / デフォルトのシャットダウンターゲットを設定する。 シャットダウンターゲットはEcuM_SelectShutdownTarget関数によって上書きされることがある。
          enumeration EcuMDefaultState: {ECUM_STATE_OFF, ECUM_STATE_RESET, ECUM_STATE_SLEEP}, set at post-build  # This parameter describes the state part of the default shutdown target selected when the ECU comes out of reset. If EcuMStateSleep is selected, the parameter EcuMDefaultSleepModeRef selects the specific sleep mode. / ECU起動後のデフォルトシャットダウンターゲットを指定する。 ECUM_STATE_SLEEPが指定された場合、EcuMDefaultSleepModeRefで指定するスリープモードとする。 ECUM_STATE_OFF、ECUM_STATE_RESET、ECUM_STATE_SLEEPのいずれかの値を設定する。
          symbolic name reference EcuMDefaultResetModeRef [0..1]: set at post-build, destination=EcuMResetMode  # If EcuMDefaultShutdownTarget is EcuMStateReset, this parameter selects the default reset mode. Otherwise this parameter may be ignored. / ECUM_STATE_RESET が選択された時のモードの領域へのアドレスを設定する。 本モジュールではECUM_STATE_RESETの場合に複数のモードを想定しておらず、必ずモードに0が設定されていることを期待している。
          symbolic name reference EcuMDefaultSleepModeRef [0..1]: set at post-build, destination=EcuMSleepMode  # If EcuMDefaultShutdownTarget is EcuMStateSleep, this parameter selects the default sleep mode. Otherwise this parameter may be ignored. / ECUM_STATE_SLEEP が選択された時のスリープモードの領域へのへのアドレスを設定する。
        container EcuMDemEventParameterRefs [0..0]  # Container for the references to DemEventParameter elements which shall be invoked using the API Dem_ReportErrorStatus in case the corresponding error occurs. The EventId is taken from the referenced DemEventParameter's DemEventId value. / 未使用。 | The standardized errors are provided in this container and can be extended by vendor specific error references.
          symbolic name reference ECUM_E_ALL_RUN_REQUESTS_KILLED [0..1]: set at pre-compile, destination=DemEventParameter  # Reference to the DemEventParameter which shall be issued when the error "ECUM_E_ALL_RUN_REQUESTS_KILLED" has occured. / Demモジュールに通知される実行時エラー。(EcuM_KillAllRUNRequestsが実行された場合) | Only applicable if EcuMFixed is implemented.
          symbolic name reference ECUM_E_CONFIGURATION_DATA_INCONSISTENT [0..1]: set at pre-compile, destination=DemEventParameter  # Reference to the DemEventParameter which shall be issued when the error "ECUM_E_CONFIGURATION_DATA_INCONSISTENT" has occured. / Demモジュールに通知される実行時エラー。(コンフィグファイルが存在しない場合)
          symbolic name reference ECUM_E_IMPROPER_CALLER [0..1]: set at pre-compile, destination=DemEventParameter  # Reference to the DemEventParameter which shall be issued when the error "ECUM_E_IMPROPER_CALLER" has occured. / ECUM_E_IMPROPER_CALLERのエラーが発生した際に引き渡さなければばならないDemEventParameterを設定する。 | Only applicable if EcuMFlex is implemented.
          symbolic name reference ECUM_E_RAM_CHECK_FAILED [0..1]: set at pre-compile, destination=DemEventParameter  # Reference to the DemEventParameter which shall be issued when the error "ECUM_E_RAM_CHECK_FAILED" has occured. / Demモジュールに通知される実行時エラー。(RAMチェックエラーが発生した場合)
        container EcuMDriverInitListOne [0..1]  # Container for Init Block I. / 初期化ブロックIのコンテナ。 このコンテナは初期化されるモジュールIDのリストを保持している。 リスト内の各モジュールは、リスト順に初期化のために呼び出される。 OSが起動する前に、このリスト内のすべてのモジュールは初期化されるので、これらのモジュールでは、OSの機能を利用できない。 | This container holds a list of module IDs that will be initialised. Each module in the list will be called for initialisation in the list order. All modules in this list are initilialised before the OS is started and so these modules require no OS support.
          container EcuMDriverInitItem [1..256]  # These containers describe the entries in a driver init list. / これらのコンテナは、ドライバの初期化リストのエントリを記述する。
            string EcuMModuleID: set at pre-compile  # Short name of the module to be initialized, e.g. Mcu, Gpt etc. / 初期化するモジュールのショートネームを指定する。（例、MCU,GPTなど）
            string EcuMModuleService [0..1]: set at pre-compile  # The service to be called to initialize that module, e.g. Init, PreInit, Start etc. / Init,PreInit,Startなどのモジュールを初期化する際に呼び出されるサービス名を指定する。 指定されたサービスがInitで、パラメータEcuMModuleConfigurationRefが設定されている場合、初期化コンテナ(＜Module＞_ConfigType)へのポインタと、複数のインスタンスを持つ場合、モジュールのインスタンスを識別するuint8型の値(＜MSN＞_CtrlIdx)が引き渡される。 | If the service is Init and the parameter EcuMModuleConfigurationRef has been set for that module, the corresponding pointer to the init structure (<Module>_ConfigType) and in case of multiple instantiation an uint8 value to identify the instance of the module(<MSN>_CtrlIdx) shall be passed as arguments.
            enumeration EcuMModuleParameter: {NULL_PTR, POSTBUILD_PTR, VOID, OTHER}, set at post-build  # Definition of the function prototype and the parameter passed to the function. / 関数プロトタイプの定義と関数に渡されるパラメータ。
            string EcuMQModuleParamStr [0..1]: set at pre-compile, origin=QINeS  # -
        container EcuMDriverInitListZero [0..1]  # Container for Init Block 0. / 初期化ブロック0のコンテナ。 このコンテナは初期化されるモジュールIDのリストを保持する。 リスト内の各モジュールはリスト順に初期化のために呼び出される。 ポストビルド構成がロードされる前にこのリスト内のすべてのモジュールは初期化され、OSが初期化される。 したがって、これらのモジュールはポストビルド構成を使用することはできない。 | This container holds a list of module IDs that will be initialised. Each module in the list will be called for initialisation in the list order. All modules in this list are initilialised before the post-build configuration has been loaded and the OS is initialized. Therefore, these modules may not use post-build configuration.
          container EcuMDriverInitItem [1..256]  # These containers describe the entries in a driver init list. / これらのコンテナは、ドライバの初期化リストのエントリを記述する。
            string EcuMModuleID: set at pre-compile  # Short name of the module to be initialized, e.g. Mcu, Gpt etc. / 初期化するモジュールのショートネームを指定する。（例、MCU,GPTなど）
            string EcuMModuleService [0..1]: set at pre-compile  # The service to be called to initialize that module, e.g. Init, PreInit, Start etc. / Init,PreInit,Startなどのモジュールを初期化する際に呼び出されるサービス名を指定する。 指定されたサービスがInitで、パラメータEcuMModuleConfigurationRefが設定されている場合、初期化コンテナ(＜Module＞_ConfigType)へのポインタと、複数のインスタンスを持つ場合、モジュールのインスタンスを識別するuint8型の値(＜MSN＞_CtrlIdx)が引き渡される。 | If the service is Init and the parameter EcuMModuleConfigurationRef has been set for that module, the corresponding pointer to the init structure (<Module>_ConfigType) and in case of multiple instantiation an uint8 value to identify the instance of the module(<MSN>_CtrlIdx) shall be passed as arguments.
            enumeration EcuMModuleParameter: {NULL_PTR, POSTBUILD_PTR, VOID, OTHER}, set at post-build  # Definition of the function prototype and the parameter passed to the function. / 関数プロトタイプの定義と関数に渡されるパラメータ。
            string EcuMQModuleParamStr [0..1]: set at pre-compile, origin=QINeS  # -
        container EcuMDriverRestartList [0..1]  # List of module IDs. / モジュールIDのリスト。 | EcuM2719: A configuration tool shall fill the callout EcuM_AL_DriverRestart with initialization calls to the listed drivers in the order in which they occur in the list. EcuM2720: Entries in this list must appear in the same order as in the combined list of EcuM_DriverInitListOne and EcuM_DriverInitListTwo. This list may be a real subset though. In all other cases, the generation tool shall report an error. The included container has the same structure as EcuM_DriverInitItem
          container EcuMDriverInitItem [1..256]  # These containers describe the entries in a driver init list. / これらのコンテナは、ドライバの初期化リストのエントリを記述する。
            string EcuMModuleID: set at pre-compile  # Short name of the module to be initialized, e.g. Mcu, Gpt etc. / 初期化するモジュールのショートネームを指定する。（例、MCU,GPTなど）
            string EcuMModuleService [0..1]: set at pre-compile  # The service to be called to initialize that module, e.g. Init, PreInit, Start etc. / Init,PreInit,Startなどのモジュールを初期化する際に呼び出されるサービス名を指定する。 指定されたサービスがInitで、パラメータEcuMModuleConfigurationRefが設定されている場合、初期化コンテナ(＜Module＞_ConfigType)へのポインタと、複数のインスタンスを持つ場合、モジュールのインスタンスを識別するuint8型の値(＜MSN＞_CtrlIdx)が引き渡される。 | If the service is Init and the parameter EcuMModuleConfigurationRef has been set for that module, the corresponding pointer to the init structure (<Module>_ConfigType) and in case of multiple instantiation an uint8 value to identify the instance of the module(<MSN>_CtrlIdx) shall be passed as arguments.
            enumeration EcuMModuleParameter: {NULL_PTR, POSTBUILD_PTR, VOID, OTHER}, set at post-build  # Definition of the function prototype and the parameter passed to the function. / 関数プロトタイプの定義と関数に渡されるパラメータ。
            string EcuMQModuleParamStr [0..1]: set at pre-compile, origin=QINeS  # -
        container EcuMSleepMode [1..256]  # These containers describe the configured sleep modes. / 本モジュールで取り扱うスリープモードの情報を格納するコンテナ。 | The names of these containers specify the symbolic names of the different sleep modes.
          integer EcuMSleepModeId: 0..255, scope=ECU, set at pre-compile, symbolic-name-value=true  # This ID identifies this sleep mode in services like EcuM_SelectShutdownTarget. / スリープモードを識別するID(0..255)を設定する。
          boolean EcuMSleepModeSuspend: set at pre-compile  # Flag, which is set true, if the CPU is suspended, halted, or powered off in the sleep mode. If the CPU keeps running in this sleep mode, then this flag must be set to false. / TRUE：スリープモードがHALTモードなどCPUを一時停止するモード FALSE：CPUを稼働し続けるモード
          symbolic name reference EcuMSleepModeMcuModeRef: set at pre-compile, destination=McuModeSettingConf  # This parameter is a reference to the corresponding MCU mode for this sleep mode. / スリープモードに対応するMCUモードを設定する。 スリープへの遷移時にはこのモードに対応するMCUモードに切り替わる。
          symbolic name reference EcuMWakeupSourceMask [1..32]: set at pre-compile, destination=EcuMWakeupSource  # These parameters are references to the wakeup sources that shall be enabled for this sleep mode. / スリープモードで有効にされるウェイクアップソースへのアドレスを設定する。
        container EcuMWakeupSource [1..32]  # These containers describe the configured wakeup sources. / スリープモードに対応するウェイクアップソースの情報を格納するコンテナ。
          float EcuMValidationTimeout: 0..Inf, set at pre-compile  # The validation timeout (period for which the ECU State Manager will wait for the validation of a wakeup event) can be defined for each wakeup source independently. The timeout is specified in seconds. / 本モジュールがウェイクアップイベントの検証を待つ時間をミリ秒単位で設定する。 | When the timeout is not instantiated, there is no validation routine and the ECU Manager shall not validate the wakeup source.
          integer EcuMWakeupSourceId: 0..31, scope=ECU, set at pre-compile, symbolic-name-value=true  # This parameter defines the identifier of this wakeup source. / ウェイクアップソースを識別するIDを設定する。 ウェイクアップソースに指定した0-31のbit位置と同じ値になる。
          boolean EcuMWakeupSourcePolling: set at pre-compile  # This parameter describes if the wakeup source needs polling. / TRUE：ウェイクアップソースがポーリングを必要とする FALSE：ウェイクアップソースがポーリングを必要としない
          symbolic name reference EcuMComMChannelRef [0..1]: set at pre-compile, destination=ComMChannel  # This parameter is a reference to a Network (channel) defined in the Communication Manager. No reference indicates that the wakeup source is not a communication channel. / ComMで定義されたネットワーク（チャンネル）へのアドレスを設定する。 ComMが有効な時のみ設定が必要である。
          symbolic name reference EcuMResetReasonRef: set at pre-compile, destination=McuResetReasonConf  # This parameter describes the mapping of reset reasons detected by the MCU driver into wakeup sources. / シャットダウンターゲットがリセット時にMCUへ指定するリセットモードを設定する。
      container EcuMFixedConfiguration [0..1]  # This container contains the configuration (parameters) of the EcuMFixed. / 本モジュールのコンフィグレーション（パラメータ）でfixed版特有のものが含まれている。 | Only applicable if EcuMFixed is implemented.
        float EcuMNvramReadallTimeout: 0..Inf, set at post-build  # Period given in seconds for which the ECU State Manager will wait until it considers a ReadAll job of the NVRAM Manager as failed. / NvMのReadAll jobが失敗したと判断するまでの時間をミリ秒単位で設定する。 NvMが有効な時のみ設定が必要である。
        float EcuMNvramWriteallTimeout: 0..Inf, set at post-build  # Period given in seconds for which the ECU State Manager will wait until it considers a WriteAll job of the NVRAM Manager as failed. / NvMのWriteAll jobが失敗したと判断するまでの時間をミリ秒単位で設定する。 NvMが有効な時のみ設定が必要である。
        float EcuMRunMinimumDuration: 0..Inf, set at post-build  # Duration given in seconds for which the ECU State Manager will / RUN要求がない場合でも本モジュールがRUN IIステートにいる時間をミリ秒単位で設定する。 この時間は少なくともSW-CがRUNを要求するまでの時間より長い必要がある。 | stay in RUN state even when no one requests RUN. This duration should be long at least as long as a SW-Cs needs to request RUN.
        symbolic name reference EcuMComMCommunicationAllowedList [0..256]: set at pre-compile, destination=ComMChannel  # These parameters contain references to the ComMChannels for which EcuM has to call ComM_CommunicationAllowed. / ComM_CommunicationAllowedを呼び出すために保持しているComMチャネルの情報への参照を格納する領域へのアドレスを設定する。 ComMが有効な時のみ設定が必要である。
        choice reference EcuMFixedModuleConfigurationRef [0..*]: set at post-build, destination=[AdcConfigSet, CanConfigSet, CanIfInitCfg, CanNmGlobalConfig, CanSMConfiguration, CanTpConfig, CanTrcvConfigSet, ComConfig, ComMConfigSet, DbgMultipleConfigurationContainer, DcmConfigSet, DemConfigSet, DioConfig, DltMultipleConfigurationContainer, EepInitConfiguration, EthConfigSet, EthIfConfigSet, EthTrcvConfigSet, FiMConfigSet, FlsConfigSet, FlsTstConfigSet, FrArTpMultipleConfig, FrIfConfig, FrMultipleConfiguration, FrNmChannelConfig, FrSMConfig, FrTpMultipleConfig, GptChannelConfigSet, IcuConfigSet, IpduMConfig, J1939TpConfiguration, LinGlobalConfig, LinIfGlobalConfig, LinSMConfigSet, LinTpGlobalConfig, McuModuleConfiguration, PduRRoutingTables, PortConfigSet, PwmChannelConfigSet, RtePostBuildVariantConfiguration, SoAdDoIpConfig, SpiDriver, UdpNmGlobalConfig, WdgMConfigSet, WdgSettingsConfig, XcpConfig]  # These parameters contain references to the init structure of the corresponding BSW module. / BSWモジュールのコンフィグレーションを格納する領域へのアドレスを設定する。
        symbolic name reference EcuMNormalMcuModeRef: set at pre-compile, destination=McuModeSettingConf  # This parameter is a reference to the normal MCU mode to be restored after a sleep. / スリープからの復帰後に設定するMCUモードを設定する。
        container EcuMDriverInitListThree [0..1]  # Container for Init Block III. / 初期化ブロックIII用のコンテナ。 このコンテナは初期化されるモジュールIDのリストを保持する。 リスト内の各モジュールは、リスト順に初期化のために呼び出される。 OSが起動した後にこのリスト内のすべてのモジュールは初期化されているので、これらのモジュールはOSのサポートを使用することができる。 これらのモジュールはNVRAM READALLジョブの提供するデータを使用できる。 | This container holds a list of module IDs that will be initialised. Each module in the list will be called for initialisation in the list order. All modules in this list are initilialised after the OS is started and so these modules may use OS support. These modules may also rely on the Nvram ReadAll job to have provided all data.
          container EcuMDriverInitItem [1..256]  # These containers describe the entries in a driver init list. / これらのコンテナは、ドライバの初期化リストのエントリを記述する。
            string EcuMModuleID: set at pre-compile  # Short name of the module to be initialized, e.g. Mcu, Gpt etc. / 初期化するモジュールのショートネームを指定する。（例、MCU,GPTなど）
            string EcuMModuleService [0..1]: set at pre-compile  # The service to be called to initialize that module, e.g. Init, PreInit, Start etc. / Init,PreInit,Startなどのモジュールを初期化する際に呼び出されるサービス名を指定する。 指定されたサービスがInitで、パラメータEcuMModuleConfigurationRefが設定されている場合、初期化コンテナ(＜Module＞_ConfigType)へのポインタと、複数のインスタンスを持つ場合、モジュールのインスタンスを識別するuint8型の値(＜MSN＞_CtrlIdx)が引き渡される。 | If the service is Init and the parameter EcuMModuleConfigurationRef has been set for that module, the corresponding pointer to the init structure (<Module>_ConfigType) and in case of multiple instantiation an uint8 value to identify the instance of the module(<MSN>_CtrlIdx) shall be passed as arguments.
            enumeration EcuMModuleParameter: {NULL_PTR, POSTBUILD_PTR, VOID, OTHER}, set at post-build  # Definition of the function prototype and the parameter passed to the function. / 関数プロトタイプの定義と関数に渡されるパラメータ。
            string EcuMQModuleParamStr [0..1]: set at pre-compile, origin=QINeS  # -
        container EcuMDriverInitListTwo [0..1]  # Container for Init Block II. / 初期化ブロックII用のコンテナ。 このコンテナは初期化されるモジュールIDのリストを保持する。 リスト内の各モジュールは、リスト順に初期化のために呼び出される。 OSが起動した後にこのリスト内のすべてのモジュールは初期化されているので、これらのモジュールはOSのサポートを使用することができる。 これらのモジュールはNVRAM READALLジョブの提供するデータを使用できない。 | This container holds a list of module IDs that will be initialised. Each module in the list will be called for initialisation in the list order. All modules in this list are initilialised after the OS is started and so these modules may use OS support. These modules may not rely on the Nvram ReadAll job to have provided all data.
          container EcuMDriverInitItem [1..256]  # These containers describe the entries in a driver init list. / これらのコンテナは、ドライバの初期化リストのエントリを記述する。
            string EcuMModuleID: set at pre-compile  # Short name of the module to be initialized, e.g. Mcu, Gpt etc. / 初期化するモジュールのショートネームを指定する。（例、MCU,GPTなど）
            string EcuMModuleService [0..1]: set at pre-compile  # The service to be called to initialize that module, e.g. Init, PreInit, Start etc. / Init,PreInit,Startなどのモジュールを初期化する際に呼び出されるサービス名を指定する。 指定されたサービスがInitで、パラメータEcuMModuleConfigurationRefが設定されている場合、初期化コンテナ(＜Module＞_ConfigType)へのポインタと、複数のインスタンスを持つ場合、モジュールのインスタンスを識別するuint8型の値(＜MSN＞_CtrlIdx)が引き渡される。 | If the service is Init and the parameter EcuMModuleConfigurationRef has been set for that module, the corresponding pointer to the init structure (<Module>_ConfigType) and in case of multiple instantiation an uint8 value to identify the instance of the module(<MSN>_CtrlIdx) shall be passed as arguments.
            enumeration EcuMModuleParameter: {NULL_PTR, POSTBUILD_PTR, VOID, OTHER}, set at post-build  # Definition of the function prototype and the parameter passed to the function. / 関数プロトタイプの定義と関数に渡されるパラメータ。
            string EcuMQModuleParamStr [0..1]: set at pre-compile, origin=QINeS  # -
        container EcuMFixedUserConfig [1..*]  # These containers describe the identifiers that are needed to refer to a software component or another appropriate entity in the system which is designated to request the RUN state. Application requestors refer to entities above RTE, system requestors to entities below RTE (e.g. Communication Manager). / SW-Cを識別するためのSW-C固有の番号を格納する領域へのアドレス。
          integer EcuMFixedUser: 0..255, set at pre-compile, symbolic-name-value=true  # Parameter used to identify one user. / 本モジュールで管理対象となるSW-C固有の番号を設定する。
        container EcuMTTII [1..*]  # These containers describe the structures and the following configuration items describe its elements. These structures are concatenated to build a list as indicated by Figure 27 - Configuration Container Diagram. / TTIIの情報を格納するコンテナである。 | The list must contain at least one element when ECUM_TTII_ENABLED is set to true.
          integer EcuMDivisor: 0..4294967295, set at pre-compile  # This parameter defines the divisor preload value. / TTIIプロトコルで次に実行されるスリープモードが選択されるまでの回数を設定する。
          symbolic name reference EcuMSleepModeRef: set at pre-compile, destination=EcuMSleepMode  # This configuration parameter is a reference to a configured sleep mode that is used for TTII. / TTIIが使用されるスリープモードへのアドレスを設定する。
          symbolic name reference EcuMSuccessorRef: set at pre-compile, destination=EcuMSleepMode  # This parameter is a reference to the next sleep mode in the TTII protocol. / TTIIプロトコルの次に実行されるスリープモードへのアドレスを設定する。
      container EcuMFlexConfiguration [0..1]  # This container contains the configuration (parameters) of the EcuMFlex. / 本モジュールの一般的なコンフィグレーション（パラメータ）が含まれている。 | Only applicable if EcuMFlex is implemented.
        choice reference EcuMFlexModuleConfigurationRef [0..*]: set at post-build, destination=[AdcConfigSet, CanConfigSet, DemConfigSet, FlsConfigSet, GptChannelConfigSet, IcuConfigSet, LinGlobalConfig, McuModuleConfiguration, PortConfigSet, PwmChannelConfigSet, SpiDriver, WdgMConfigSet, WdgSettingsConfig]  # These parameters contain references to the init structure of the corresponding BSW module. / BSWモジュールのコンフィグレーションを格納する領域へのアドレスを設定する。
        symbolic name reference EcuMNormalMcuModeRef: set at pre-compile, destination=McuModeSettingConf  # This parameter is a reference to the normal MCU mode to be restored after a sleep. / スリープからの復帰後に設定するMCUモードを設定する。
        reference EcuMPartitionRef [0..*]: set at post-build, destination=EcucPartition  # Reference denotes the partition a EcuM shall run inside. / 参照はEcuMが内部で実行しなければならないパーティションを示している。
        container EcuMAlarmClock [0..256]  # These containers describe the configured alarm clocks. / 本モジュールで取り扱うalarm clocksの情報を格納するコンテナ。 | The name of these conatiners allows giving a symbolic name to one alarm clock.
          integer EcuMAlarmClockId: 0..255, set at pre-compile, symbolic-name-value=true  # This ID identifies this alarmclock. / alarmclockを識別するIDを設定する。(0..255)
          float EcuMAlarmClockTimeOut: 0..4294967295, set at pre-compile  # This parameter allows to define a timout for this alarm clock. / alarmclockのタイムアウト値を設定する。
          symbolic name reference EcuMAlarmClockUser: set at pre-compile, destination=EcuMFlexUserConfig  # This parameter allows an alarm to be assigned to a user. / ユーザに割り当てることがきるアラームを設定する。
        container EcuMFlexUserConfig [0..256]  # These containers describe the identifiers that are needed to refer to a software component or another appropriate entity in the system which uses the EcuMFlex Interfaces. / SW-Cを識別するためのEcuMFlex Interfacesで使用されるSW-C固有の番号を格納するコンテナ。
          integer EcuMFlexUser: 0..255, set at pre-compile, symbolic-name-value=true  # Parameter used to identify one user. / ユーザを識別するためのパラメータを設定する。
          reference EcuMFlexEcucPartitionRef [0..1]: set at pre-compile, destination=EcucPartition  # Denotes in which "EcucPartition" the user of the EcuM is executed. / EcuMのユーザが実行されるEcucPartitionを意味している。
        container EcuMGoDownAllowedUsers [0..1]  # This container describes the collection of allowed users which are allowed to call the EcuM_GoDown API. / 本モジュールで取り扱うEcuM_GoDown APIの呼び出しを許可されたユーザの情報を格納するコンテナ。
          symbolic name reference EcuMGoDownAllowedUserRef [1..*]: set at pre-compile, destination=EcuMFlexUserConfig  # These parameters describe the references to the users which are allowed to call the EcuM_GoDown API. / EcuM_GoDown APIの呼び出しを許可されたユーザを設定する。
        container EcuMResetMode [0..256]  # These containers describe the configured reset modes. / 本モジュールで取り扱うリセットモードの情報を格納するコンテナ。 | The name of these containers allows one of the following symbolic names to be given to the different reset modes: - ECUM_RESET_MCU - ECUM_RESET_WDGM - ECUM_RESET_IO.
          integer EcuMResetModeId: 0..255, set at pre-compile, symbolic-name-value=true  # This ID identifies this reset mode in services like EcuM_SelectShutdownTarget. / EcuM_SelectShutdownTargetなどのサービスのリセットモードを識別するIDを設定すること。
        container EcuMSetClockAllowedUsers [0..1]  # This container describes the collection of allowed users which are allowed to call the EcuM_SetClock API. / 本モジュールで取り扱うEcuM_SetClock APIの呼び出しを許可されたユーザの情報を格納するコンテナ。
          symbolic name reference EcuMSetClockAllowedUserRef [1..*]: set at pre-compile, destination=EcuMFlexUserConfig  # These parameters describe the references to the users which are allowed to call the EcuM_SetClock API. / EcuM_SetClock APIの呼び出しを許可されたユーザを設定する。
        container EcuMShutdownCause [0..256]  # These containers describe the configured shut down or reset causes. / 本モジュールで取り扱うシャットダウンまたはリセットの要因を格納するコンテナ。 | The name of these containers allows to give one of the following symbolic names to the diffenrent shut down causes: - ECUM_CAUSE_ECU_STATE - ECU state machine entered a state for shutdown, - ECUM_CAUSE_WDGM - WdgM detected failure, - ECUM_CAUSE_DCM - Dcm requests shutdown (split into UDS services?), - and values from configuration.
          integer EcuMShutdownCauseId: 0..255, set at pre-compile, symbolic-name-value=true  # This ID identifies this shut down cause. / シャットダウンの要因を識別するIDを設定する。
        container EcuMShutdownTarget [0..256]  # These containers describe the configured shut down targets. / このコンテナはEcuMによって選択されるデフォルトの停止目標を説明する。 | The name of these containers allows to give symbolic names to the different shut down targets.
          integer EcuMShutdownTargetId: 0..255, set at pre-compile, symbolic-name-value=true  # This ID identifies this shut down target in services like EcuM_SelectShutdownTarget. / EcuM_SelectShutdownTargetなどのサービスのシャットダウンターゲットを識別するIDを設定すること。
      container EcuMQINeSConfiguration [0..1]  # - / QINeS追加項目。
        container EcuMEcuMQEventInfo [0..255]  # - / イベント情報。
          integer EcuMQCoreId: 0..65535, scope=ECU, set at post-build, origin=QINeS  # - / 対象のコアID。
          integer EcuMQEventMask: 0..65535, scope=ECU, set at post-build, origin=QINeS  # - / ウェイトイベント使用時のマスク。
          integer EcuMQIocId: 0..65535, scope=ECU, set at post-build, origin=QINeS
          integer EcuMQEventTaskId: 0..65535, scope=ECU, set at post-build, origin=QINeS  # - / ウェイトイベント使用時のタスクID。
    container EcuMFixedGeneral [0..1]  # This container holds the general, pre-compile configuration parameters for the EcuMFixed. / このコンテナはEcuMFixedのための、ジェネラルプリコンパイルの設定パラメータを保持する。 EcuMFixedが実装されている場合のみ適用される。 | Only applicable if EcuMFixed is implemented.
      boolean EcuMIncludeComM: set at pre-compile  # This configuration parameter defines whether the communication manager is supported by EcuM. This feature is presented for development purpose to compile out the communication manager in the early debugging phase. / この設定パラメータは通信マネージャがEcuMでサポートされているかどうかを定義する。 この機能は、初期のデバッグ段階で通信マネージャをコンパイルから外す開発目的のために提示されている。
      boolean EcuMIncludeNvM [0..0]: set at pre-compile  # This configuration parameter defines whether the non volatile memory manager is supported by EcuM. This feature is presented for development purpose to compile out the volatile memory manager in the early debugging phase. / 未使用
      boolean EcuMIncludeNvramMgr [0..0]: set at pre-compile  # If NVRAM manager is enabled but both flash and EEPROM driver are missing, then an error shall be flagged by the configuration tool / 未使用
      boolean EcuMTTIIEnabled: set at pre-compile  # Boolean switch to enable / disable TTII / TTIIが有効/無効のスイッチ。 TRUE：有効 FALSE：無効
      symbolic name reference EcuMTTIIWakeupSourceRef: set at pre-compile, destination=EcuMWakeupSource  # This configuration parameter references the initial sleep mode to be used by TTII when TTII is activated after a RUN mode. / この設定パラメータはTTIIがRUNモードの後に活性化されるとTTIIによって使用される最初のスリープ・モードを参照する。 | EcuM2785: Whenever RUN mode is reached, the TTII protocol shall be reset to use the wakeup source referenced by this parameter. This configuration parameter is a human readable name for a TTII wakeup source which is only needed by the configuration tool. For imlementation on the ECU, this parameter may be dropped and replaced by a generated list index of EcuM_TTII.
    container EcuMFlexGeneral [0..1]  # This container holds the general, pre-compile configuration parameters for the EcuMFlex. / このコンテナはEcuMFlexのための、ジェネラルプリコンパイルの設定パラメータを保持する。 EcuMFlexが実装されている場合のみ適用される。 | Only applicable if EcuMFlex is implemented.
      boolean EcuMAlarmClockPresent: set at pre-compile  # This flag indicates whether the optional AlarmClock feature is present. / このフラグはオプションでAlarmClock機能が存在するかどうかを設定する。
      boolean EcuMEnableDefBehaviour [0..0]: set at pre-compile  # Switches the defensive behaviour on or off. / EcuM_GoDown APIの呼び出しを許可されたユーザをチェックするかどうかのオンとオフを切り替える。
      boolean EcuMModeHandling [0..1]: set at pre-compile  # If false, Run Request Protocol is not performed. / TRUE：RUN要求のプロトコルが実行される FALSE：RUN要求のプロトコルが実行されない
      boolean EcuMResetLoopDetection: set at pre-compile  # If false, no reset loop detection is performed. / TRUE：ループが検出された場合リセットされる FALSE：ループが検出されてもリセットされない
      boolean EcuMSetProgrammableInterrupts: set at pre-compile  # If this configuration parameter exists and is to true, the callout "EcuM_AL_SetProgrammableInterrupts" is called during startup of EcuM (during StartPreOS). / この設定パラメータが存在し、trueにある場合は、コールアウト「EcuM_AL_SetProgrammableInterruptsは」（StartPreOS中）EcuMの起動時に呼び出される。
      symbolic name reference EcuMAlarmWakeupSource: set at pre-compile, destination=EcuMWakeupSource  # This parameter describes the reference to the EcuMWakeupSource being used for the EcuM AlarmClock. / EcuM AlarmClockに使用されるEcuMWakeupSourceを設定する。
    container EcuMGeneral  # This container holds the general, pre-compile configuration parameters. / このコンテナはすべてのプリコンパイルの設定パラメータを保持する。
      boolean EcuMDevErrorDetect: set at pre-compile  # If false, no debug artifacts (e.g. calls to DET) shall remain in the executable object. Initialization of DET, however is controlled by configuration of optional BSW modules. / FALSEの場合、デバッグアーティファクトが（例えば、DETへの呼び出し）実行可能オブジェクトに残っていないものとする。 DETの初期化はBSWモジュールの構成によって制御される。
      boolean EcuMIncludeDem [0..0]: set at pre-compile  # If enabled, the according BSW module will be included to the ECU State Manager. / 未使用
      boolean EcuMIncludeDet: set at pre-compile  # If defined, the according BSW module will be initialized by the ECU State Manager / 定義されている場合、対応するBSWモジュールはECUステートマネージャによって初期化される。
      float EcuMMainFunctionPeriod: 0..Inf, scope=ECU, set at pre-compile  # This parameter defines the schedule period of EcuM_MainFunction. / このパラメータは、EcuM_MainFunctionのスケジュール間隔を定義する（ミリ秒）。 | Unit: [s]
      integer EcuMQCommNumofChannel: 0..255, set at pre-compile, origin=QINeS  # RUN II/IIIで動作状態を監視する通信機能CH数を定義する。 MAX=255 MIN=0
      integer EcuMQCounterId: 0..255, scope=ECU, set at pre-compile, origin=QINeS, symbolic-name-value=true  # OSカウンタのID。
      integer EcuMQGptChannel: 0..255, set at pre-compile, origin=QINeS  # 初期化時にSTARTするタイマのチャネル名を設定する。
      float EcuMQGptNumofTick: 0..65535, set at pre-compile, origin=QINeS  # 初期化時にSTARTするタイマに指定するTick値を設定する。
      boolean EcuMQLibBfxEnabled: set at pre-compile, origin=QINeS  # Bfxライブラリが有効であるか判定する。 TRUE：有効 FALSE：無効
      boolean EcuMQLibCalEnabled: set at pre-compile, origin=QINeS  # Calライブラリが有効であるか判定する。 TRUE：有効 FALSE：無効
      boolean EcuMQLibCrcEnabled: set at pre-compile, origin=QINeS  # Crcライブラリが有効であるか判定する。 TRUE：有効 FALSE：無効
      boolean EcuMQLibE2eEnabled: set at pre-compile, origin=QINeS  # E2eライブラリが有効であるか判定する。 TRUE：有効 FALSE：無効
      boolean EcuMQLibEfxEnabled: set at pre-compile, origin=QINeS  # Efxライブラリが有効であるか判定する。 TRUE：有効 FALSE：無効
      boolean EcuMQLibIflEnabled: set at pre-compile, origin=QINeS  # Iflライブラリが有効であるか判定する。 TRUE：有効 FALSE：無効
      boolean EcuMQLibIfxEnabled: set at pre-compile, origin=QINeS  # Ifxライブラリが有効であるか判定する。 TRUE：有効 FALSE：無効
      boolean EcuMQLibMflEnabled: set at pre-compile, origin=QINeS  # Mflライブラリが有効であるか判定する。 TRUE：有効 FALSE：無効
      boolean EcuMQLibMfxEnabled: set at pre-compile, origin=QINeS  # Mfxライブラリが有効であるか判定する。 TRUE：有効 FALSE：無効
      integer EcuMQMasterModuleCore: 0..65535, scope=ECU, set at pre-compile, origin=QINeS  # EcuMのマスタコア。
      boolean EcuMQModAdcEnabled: set at pre-compile, origin=QINeS  # AdcのBSWモジュールが有効であるか判定する。 TRUE：有効 FALSE：無効
      boolean EcuMQModBswmEnabled: set at pre-compile, origin=QINeS  # BswmのBSWモジュールが有効であるか判定する。 TRUE：有効 FALSE：無効
      boolean EcuMQModCanEnabled: set at pre-compile, origin=QINeS  # CanのBSWモジュールが有効であるか判定する。 TRUE：有効 FALSE：無効
      boolean EcuMQModCanifEnabled: set at pre-compile, origin=QINeS  # CanifのBSWモジュールが有効であるか判定する。 TRUE：有効 FALSE：無効
      boolean EcuMQModCannmEnabled: set at pre-compile, origin=QINeS  # CannmのBSWモジュールが有効であるか判定する。 TRUE：有効 FALSE：無効
      boolean EcuMQModCansmEnabled: set at pre-compile, origin=QINeS  # CansmのBSWモジュールが有効であるか判定する。 TRUE：有効 FALSE：無効
      boolean EcuMQModCantpEnabled: set at pre-compile, origin=QINeS  # CantpのBSWモジュールが有効であるか判定する。 TRUE：有効 FALSE：無効
      boolean EcuMQModCantrcvEnabled: set at pre-compile, origin=QINeS  # CantrcvのBSWモジュールが有効であるか判定する。 TRUE：有効 FALSE：無効
      boolean EcuMQModComEnabled: set at pre-compile, origin=QINeS  # ComのBSWモジュールが有効であるか判定する。 TRUE：有効 FALSE：無効
      boolean EcuMQModCommEnabled: set at pre-compile, origin=QINeS  # CommのBSWモジュールが有効であるか判定する。 TRUE：有効 FALSE：無効
      boolean EcuMQModCortstEnabled: set at pre-compile, origin=QINeS  # CortstのBSWモジュールが有効であるか判定する。 TRUE：有効 FALSE：無効
      boolean EcuMQModCsmEnabled: set at pre-compile, origin=QINeS  # CsmのBSWモジュールが有効であるか判定する。 TRUE：有効 FALSE：無効
      boolean EcuMQModDbgEnabled: set at pre-compile, origin=QINeS  # DbgのBSWモジュールが有効であるか判定する。 TRUE：有効 FALSE：無効
      boolean EcuMQModDcmEnabled: set at pre-compile, origin=QINeS  # DcmのBSWモジュールが有効であるか判定する。 TRUE：有効 FALSE：無効
      boolean EcuMQModDemEnabled: set at pre-compile, origin=QINeS  # DemのBSWモジュールが有効であるか判定する。 TRUE：有効 FALSE：無効
      boolean EcuMQModDetEnabled: set at pre-compile, origin=QINeS  # DetのBSWモジュールが有効であるか判定する。 TRUE：有効 FALSE：無効
      boolean EcuMQModDioEnabled: set at pre-compile, origin=QINeS  # DioのBSWモジュールが有効であるか判定する。 TRUE：有効 FALSE：無効
      boolean EcuMQModDltEnabled: set at pre-compile, origin=QINeS  # DltのBSWモジュールが有効であるか判定する。 TRUE：有効 FALSE：無効
      boolean EcuMQModDoipEnabled: set at pre-compile, origin=QINeS  # DoipのBSWモジュールが有効であるか判定する。 TRUE：有効 FALSE：無効
      boolean EcuMQModEaEnabled: set at pre-compile, origin=QINeS  # EaのBSWモジュールが有効であるか判定する。 TRUE：有効 FALSE：無効
      boolean EcuMQModEcumEnabled: set at pre-compile, origin=QINeS, default-value=true  # EcumのBSWモジュールが有効であるか判定する。 TRUE：有効 FALSE：無効
      boolean EcuMQModEepEnabled: set at pre-compile, origin=QINeS  # EepのBSWモジュールが有効であるか判定する。 TRUE：有効 FALSE：無効
      boolean EcuMQModEthEnabled: set at pre-compile, origin=QINeS  # EthのBSWモジュールが有効であるか判定する。 TRUE：有効 FALSE：無効
      boolean EcuMQModEthifEnabled: set at pre-compile, origin=QINeS  # EthifのBSWモジュールが有効であるか判定する。 TRUE：有効 FALSE：無効
      boolean EcuMQModEthsmEnabled: set at pre-compile, origin=QINeS  # EthsmのBSWモジュールが有効であるか判定する。 TRUE：有効 FALSE：無効
      boolean EcuMQModEthtrcvEnabled: set at pre-compile, origin=QINeS  # EthtrcvのBSWモジュールが有効であるか判定する。 TRUE：有効 FALSE：無効
      boolean EcuMQModFeeEnabled: set at pre-compile, origin=QINeS  # FeeのBSWモジュールが有効であるか判定する。 TRUE：有効 FALSE：無効
      boolean EcuMQModFimEnabled: set at pre-compile, origin=QINeS  # FimのBSWモジュールが有効であるか判定する。 TRUE：有効 FALSE：無効
      boolean EcuMQModFlsEnabled: set at pre-compile, origin=QINeS  # FlsのBSWモジュールが有効であるか判定する。 TRUE：有効 FALSE：無効
      boolean EcuMQModFlststEnabled: set at pre-compile, origin=QINeS  # FlststのBSWモジュールが有効であるか判定する。 TRUE：有効 FALSE：無効
      boolean EcuMQModFrEnabled: set at pre-compile, origin=QINeS  # FrのBSWモジュールが有効であるか判定する。 TRUE：有効 FALSE：無効
      boolean EcuMQModFrartpEnabled: set at pre-compile, origin=QINeS  # FrartpのBSWモジュールが有効であるか判定する。 TRUE：有効 FALSE：無効
      boolean EcuMQModFrifEnabled: set at pre-compile, origin=QINeS  # FrifのBSWモジュールが有効であるか判定する。 TRUE：有効 FALSE：無効
      boolean EcuMQModFrnmEnabled: set at pre-compile, origin=QINeS  # FrnmのBSWモジュールが有効であるか判定する。 TRUE：有効 FALSE：無効
      boolean EcuMQModFrsmEnabled: set at pre-compile, origin=QINeS  # FrsmのBSWモジュールが有効であるか判定する。 TRUE：有効 FALSE：無効
      boolean EcuMQModFrtpEnabled: set at pre-compile, origin=QINeS  # FrtpのBSWモジュールが有効であるか判定する。 TRUE：有効 FALSE：無効
      boolean EcuMQModFrtrcvEnabled: set at pre-compile, origin=QINeS  # FrtrcvのBSWモジュールが有効であるか判定する。 TRUE：有効 FALSE：無効
      boolean EcuMQModGptEnabled: set at pre-compile, origin=QINeS, default-value=true  # GptのBSWモジュールが有効であるか判定する。 TRUE：有効 FALSE：無効
      boolean EcuMQModIcuEnabled: set at pre-compile, origin=QINeS  # IcuのBSWモジュールが有効であるか判定する。 TRUE：有効 FALSE：無効
      boolean EcuMQModIohwab10Enabled: set at pre-compile, origin=QINeS  # Iohwab10のBSWモジュールが有効であるか判定する。 TRUE：有効 FALSE：無効
      boolean EcuMQModIohwab{1..9}Enabled: set at pre-compile, origin=QINeS  # Iohwab{1..9}のBSWモジュールが有効であるか判定する。 TRUE：有効 FALSE：無効
      boolean EcuMQModIpdumEnabled: set at pre-compile, origin=QINeS  # IpdumのBSWモジュールが有効であるか判定する。 TRUE：有効 FALSE：無効
      boolean EcuMQModJ1939dcmEnabled: set at pre-compile, origin=QINeS  # J1939dcmのBSWモジュールが有効であるか判定する。 TRUE：有効 FALSE：無効
      boolean EcuMQModJ1939nmEnabled: set at pre-compile, origin=QINeS  # J1939nmのBSWモジュールが有効であるか判定する。 TRUE：有効 FALSE：無効
      boolean EcuMQModJ1939rmEnabled: set at pre-compile, origin=QINeS  # J1939rmのBSWモジュールが有効であるか判定する。 TRUE：有効 FALSE：無効
      boolean EcuMQModJ1939tpEnabled: set at pre-compile, origin=QINeS  # J1939tpのBSWモジュールが有効であるか判定する。 TRUE：有効 FALSE：無効
      boolean EcuMQModLinEnabled: set at pre-compile, origin=QINeS  # LinのBSWモジュールが有効であるか判定する。 TRUE：有効 FALSE：無効
      boolean EcuMQModLinifEnabled: set at pre-compile, origin=QINeS  # LinifのBSWモジュールが有効であるか判定する。 TRUE：有効 FALSE：無効
      boolean EcuMQModLinnmEnabled: set at pre-compile, origin=QINeS  # LinnmのBSWモジュールが有効であるか判定する。 TRUE：有効 FALSE：無効
      boolean EcuMQModLinsmEnabled: set at pre-compile, origin=QINeS  # LinsmのBSWモジュールが有効であるか判定する。 TRUE：有効 FALSE：無効
      boolean EcuMQModLintpEnabled: set at pre-compile, origin=QINeS  # LintpのBSWモジュールが有効であるか判定する。 TRUE：有効 FALSE：無効
      boolean EcuMQModLintrcvEnabled: set at pre-compile, origin=QINeS  # LintrcvのBSWモジュールが有効であるか判定する。 TRUE：有効 FALSE：無効
      boolean EcuMQModMcuEnabled: set at pre-compile, origin=QINeS, default-value=true  # McuのBSWモジュールが有効であるか判定する。 TRUE：有効 FALSE：無効
      boolean EcuMQModMemifEnabled: set at pre-compile, origin=QINeS  # MemifのBSWモジュールが有効であるか判定する。 TRUE：有効 FALSE：無効
      boolean EcuMQModNmEnabled: set at pre-compile, origin=QINeS  # NmのBSWモジュールが有効であるか判定する。 TRUE：有効 FALSE：無効
      boolean EcuMQModNvmEnabled: set at pre-compile, origin=QINeS  # NvmのBSWモジュールが有効であるか判定する。 TRUE：有効 FALSE：無効
      boolean EcuMQModOcuEnabled: set at pre-compile, origin=QINeS  # OcuのBSWモジュールが有効であるか判定する。 TRUE：有効 FALSE：無効
      boolean EcuMQModOsEnabled: set at pre-compile, origin=QINeS, default-value=true  # OsのBSWモジュールが有効であるか判定する。 TRUE：有効 FALSE：無効
      boolean EcuMQModPdurEnabled: set at pre-compile, origin=QINeS  # PdurのBSWモジュールが有効であるか判定する。 TRUE：有効 FALSE：無効
      boolean EcuMQModPortEnabled: set at pre-compile, origin=QINeS  # PortのBSWモジュールが有効であるか判定する。 TRUE：有効 FALSE：無効
      boolean EcuMQModPwmEnabled: set at pre-compile, origin=QINeS  # PwmのBSWモジュールが有効であるか判定する。 TRUE：有効 FALSE：無効
      boolean EcuMQModRamtstEnabled: set at pre-compile, origin=QINeS  # RamtstのBSWモジュールが有効であるか判定する。 TRUE：有効 FALSE：無効
      boolean EcuMQModRteEnabled: set at pre-compile, origin=QINeS, default-value=true  # RteのBSWモジュールが有効であるか判定する。 TRUE：有効 FALSE：無効
      boolean EcuMQModSchmEnabled: set at pre-compile, origin=QINeS, default-value=true  # SchmのBSWモジュールが有効であるか判定する。 TRUE：有効 FALSE：無効
      boolean EcuMQModSdEnabled: set at pre-compile, origin=QINeS  # SdのBSWモジュールが有効であるか判定する。 TRUE：有効 FALSE：無効
      boolean EcuMQModSoadEnabled: set at pre-compile, origin=QINeS  # SoadのBSWモジュールが有効であるか判定する。 TRUE：有効 FALSE：無効
      boolean EcuMQModSpiEnabled: set at pre-compile, origin=QINeS  # SpiのBSWモジュールが有効であるか判定する。 TRUE：有効 FALSE：無効
      boolean EcuMQModStbmEnabled: set at pre-compile, origin=QINeS  # StbmのBSWモジュールが有効であるか判定する。 TRUE：有効 FALSE：無効
      boolean EcuMQModTcpipEnabled: set at pre-compile, origin=QINeS  # TcpipのBSWモジュールが有効であるか判定する。 TRUE：有効 FALSE：無効
      boolean EcuMQModTmEnabled: set at pre-compile, origin=QINeS  # TmのBSWモジュールが有効であるか判定する。 TRUE：有効 FALSE：無効
      boolean EcuMQModTtcanEnabled: set at pre-compile, origin=QINeS  # TtcanのBSWモジュールが有効であるか判定する。 TRUE：有効 FALSE：無効
      boolean EcuMQModTtcanifEnabled: set at pre-compile, origin=QINeS  # TtcanifのBSWモジュールが有効であるか判定する。 TRUE：有効 FALSE：無効
      boolean EcuMQModUdpnmEnabled: set at pre-compile, origin=QINeS  # UdpnmのBSWモジュールが有効であるか判定する。 TRUE：有効 FALSE：無効
      boolean EcuMQModWdgEnabled: set at pre-compile, origin=QINeS  # WdgのBSWモジュールが有効であるか判定する。 TRUE：有効 FALSE：無効
      boolean EcuMQModWdgifEnabled: set at pre-compile, origin=QINeS  # WdgifのBSWモジュールが有効であるか判定する。 TRUE：有効 FALSE：無効
      boolean EcuMQModWdgmEnabled: set at pre-compile, origin=QINeS  # WdgmのBSWモジュールが有効であるか判定する。 TRUE：有効 FALSE：無効
      boolean EcuMQModXcpEnabled: set at pre-compile, origin=QINeS  # XcpのBSWモジュールが有効であるか判定する。 TRUE：有効 FALSE：無効
      boolean EcuMQMultiCore: set at pre-compile, origin=QINeS  # TRUE：マルチコアに設定する FALSE：シングルコアに設定する
      integer EcuMQNumofAlarmclock: 0..256, scope=ECU, set at pre-compile, origin=QINeS, symbolic-name-value=true  # OSカウンタのID。
      integer EcuMQNumofRunrequested: 1..8, set at pre-compile, origin=QINeS  # RUN要求リストの数を設定する。 RUN要求リストの数はSW-Cの数に応じて決定される。 (( ECUM_Q_NUMOF_USER + 31u ) / 32u )の値。
      integer EcuMQNumofTtii: 0..32, set at pre-compile, origin=QINeS  # TTII対応のウェイクアップソースの数を設定する。
      integer EcuMQNumofUser: 1..256, set at pre-compile, origin=QINeS  # SW-Cの数を設定する。
      integer EcuMQNumofWakeupSource: 5..32, set at pre-compile, origin=QINeS  # 有効なウェイクアップソースの数を設定する。ECUM_Q_WKSOURCE_ALL_VALID_SOURCESでONになっているbit数。
      integer EcuMQNvmModuleCore: 0..65535, set at pre-compile, origin=QINeS
      string EcuMQSec2Tick: set at pre-compile, origin=QINeS  # 時間(ms)をTick値に変換する式を記述すること。 例）1Tickが250usの場合 ( a * 4 )
      integer EcuMQWksourceAllValidSources: 31..4294967295, set at pre-compile, origin=QINeS  # 拡張も含め定義されたウェイクアップソースすべての合計値を設定する。
      integer EcuMQWksourceCan: 0..4294967295, set at pre-compile, origin=QINeS, default-value=0  # Canを利用したウェイクアップソースすべての合計値を設定する。
      integer EcuMQWksourceFr: 0..4294967295, set at pre-compile, origin=QINeS, default-value=0  # FlexRayを利用したウェイクアップソースすべての合計値を設定する。
      integer EcuMQWksourceGpt: 0..4294967295, set at pre-compile, origin=QINeS, default-value=0  # GPTを利用したウェイクアップソースすべての合計値を設定する。
      integer EcuMQWksourceIcu: 0..4294967295, set at pre-compile, origin=QINeS, default-value=0  # ICUを利用したウェイクアップソースすべての合計値を設定する。
      integer EcuMQWksourceLin: 0..4294967295, set at pre-compile, origin=QINeS, default-value=0  # Linを利用したウェイクアップソースすべての合計値を設定する。
      integer EcuMQWksourceNoValidateSources: 31..4294967295, set at pre-compile, origin=QINeS  # 検証不要のウェイクアップソースすべての合計値を設定する。
      boolean EcuMVersionInfoApi: set at pre-compile  # Switches the version info API on or off / バージョン情報APIのON/OFFスイッチ。 本モジュールのバージョン情報取得関数EcuM_GetVersionInfo関数の使用可否を設定する。 TRUE：使用可能にする FALSE：無効にする
      container EcuMQWksourceName [0..27]
        integer EcuMQWksourceValue: 5..31, set at pre-compile, origin=QINeS, symbolic-name-value=true  # システムで使用するWAKEUPソースに紐づくbit位置を定義する。 MAX=31 MIN=5

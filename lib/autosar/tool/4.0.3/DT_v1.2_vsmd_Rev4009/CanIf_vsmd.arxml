AUTOSAR XML (schema 4-0-3)
package /QINeS
  ecuc definition collection AUTOSARParameterDefinition: module=CanIf
  module definition CanIf [0..1]: refined-module-def=CanIf, variants link-time/post-build/pre-compile  # This container includes all necessary configuration sub-containers according the CAN Interface configuration structure. / CanIfモジュールのコンフィグレーション。
    container CanIfCtrlDrvCfg [1..*]  # Configuration parameters for all the underlying CAN Driver modules are aggregated under this container. For each CAN Driver module a seperate instance of this container has to be provided. / CanIfモジュールが制御するCANドライバに関する設定。 複数のCANドライバを制御する場合はCANドライバの数だけ設定する。
      boolean CanIfCtrlDrvTxCancellation: set at pre-compile  # Selects whether transmit cancellation is supported and if the appropriate callback will be provided to the CAN Driver module. / 未使用 (送信キャンセルをサポートするかどうか決定するためのフラグ) | True: Enabled False: Disabled
      reference CanIfCtrlDrvInitHohConfigRef: set at link in variant link-time+post-build / pre-compile in variant pre-compile, destination=CanIfInitHohCfg  # Reference to the Init Hoh Configuration / CANハードウェアオブジェクトハンドル(HOH)初期化情報への参照。
      reference CanIfCtrlDrvNameRef: set at pre-compile, destination=CanGeneral  # CAN Interface Driver Reference. / CANドライバのジェネラルパラメータへの参照。 ※使用するCANドライバのショートネームに"_"をつけた名前でCanドライバのジェネラルコンテナを命名してください。 例）Can_ | This reference can be used to get any information (Ex. Driver Name, Vendor ID) from the CAN driver. The CAN Driver name can be derived from the ShortName of the CAN driver module.
      container CanIfCtrlCfg [1..65535]  # This container contains the configuration (parameters) of an adressed CAN controller by an underlying CAN Driver module. This container is configurable per CAN controller. / CANドライバの設定。
        integer CanIfCtrlId: 0..65535, set at link in variant link-time+post-build / pre-compile in variant pre-compile, symbolic-name-value=true  # This parameter abstracts from the CAN Driver specific parameter Controller. Each controller of all connected CAN Driver modules shall be assigned to one specific ControllerId of the CanIf. / CANコントローラID。 | Range: 0..number of configured controllers of all CAN Driver modules
        boolean CanIfCtrlWakeupSupport: scope=ECU, set at link in variant link-time+post-build / pre-compile in variant pre-compile, default-value=false  # This parameter defines if a respective controller of the referenced CAN Driver modules is queriable for wake up events. / ウェイクアップ機能の有効/無効情報。 TRUE：有効 FALSE：無効 | True: Enabled False: Disabled
        symbolic name reference CanIfCtrlCanCtrlRef: scope=ECU, set at link in variant link-time+post-build / pre-compile in variant pre-compile, destination=CanController  # This parameter references to the logical handle of the underlying CAN controller from the CAN Driver module to be served by the CAN Interface module. The following parameters of CanController config container shall be referenced by this link: CanControllerId, CanWakeupSourceRef / CANドライバで制御するCANコントローラ情報への参照。 | Range: 0..max. number of underlying supported CAN controllers
    container CanIfDispatchCfg  # Callback functions provided by upper layer modules of the CanIf. The callback functions defined in this container are common to all configured CAN Driver / CAN Transceiver Driver modules. / CanIfモジュールとして上位モジュールから提供されるCallback関数リスト。
      function name CanIfDispatchUserCheckTrcvWakeFlagIndicationName [0..0]: set at link in variant link-time+post-build / pre-compile in variant pre-compile  # This parameter defines the name of <User_ClearTrcvWufFlagIndication>. / 未使用 | If CANIF_DISPATCH_USERCHECKTRCVWAKEFLAGINDICATION_UL equals CAN_SM the name of <User_CheckTrcvWakeFlagIndication> is fixed. If it equals CDD, the name is selectable. If CANIF_PUBLIC_PN_SUPPORT equals False, this parameter shall not be configurable.
      enumeration CanIfDispatchUserCheckTrcvWakeFlagIndicationUL [0..0]: {CAN_SM, CDD}, set at link in variant link-time+post-build / pre-compile in variant pre-compile  # This parameter defines the upper layer module to which the CheckTrcvWakeFlagIndication from the Driver modules have to be routed. / 未使用 | If CANIF_PUBLIC_PN_SUPPORT equals False, this parameter shall not be configurable.
      function name CanIfDispatchUserClearTrcvWufFlagIndicationName [0..0]: set at link in variant link-time+post-build / pre-compile in variant pre-compile  # This parameter defines the name of <User_ClearTrcvWufFlagIndication>. / 未使用 | If CANIF_DISPATCH_USERCLEARTRCVWUFFLAGINDICATION_UL equals CAN_SM the name of <User_ClearTrcvWufFlagIndication> is fixed. If it equals CDD, the name is selectable. If CANIF_PUBLIC_PN_SUPPORT equals False, this parameter shall not be configurable.
      enumeration CanIfDispatchUserClearTrcvWufFlagIndicationUL [0..0]: {CAN_SM, CDD}, set at link in variant link-time+post-build / pre-compile in variant pre-compile  # This parameter defines the upper layer module to which the ClearTrcvWufFlagIndication from the Driver modules have to be routed. / 未使用 | If CANIF_PUBLIC_PN_SUPPORT equals False, this parameter shall not be configurable.
      function name CanIfDispatchUserConfirmPnAvailabilityName [0..0]: set at link in variant link-time+post-build / pre-compile in variant pre-compile  # This parameter defines the name of <User_ConfirmPnAvailability>. If CANIF_DISPATCH_USERCONFIRMPNAVAILABILITY_UL equals CAN_SM the name of <User_ConfirmPnAvailability> is fixed. If it equals CDD, the name is selectable. If CANIF_PUBLIC_PN_SUPPORT equals False, this parameter shall not be configurable. / 未使用
      enumeration CanIfDispatchUserConfirmPnAvailabilityUL [0..0]: {CAN_SM, CDD}, set at link in variant link-time+post-build / pre-compile in variant pre-compile  # This parameter defines the upper layer module to which the ConfirmPnAvailability notification from the Driver modules have to be routed. If CANIF_PUBLIC_PN_SUPPORT equals False, this parameter shall not be configurable. / 未使用
      function name CanIfDispatchUserCtrlBusOffName [0..1]: set at link in variant link-time+post-build / pre-compile in variant pre-compile, max-length=32, min-length=1  # This parameter defines the name of <User_ControllerBusOff>. / Canバスオフ時に呼ばれるCallback関数名。 <User_ControllerBusOff> CanSM_ControllerBusOffのみ指定可能。 | This parameter depends on the parameter CANIF_USERCTRLBUSOFF_UL. If CANIF_USERCTRLBUSOFF_UL equals CAN_SM the name of <User_ControllerBusOff> is fixed. If CANIF_USERCTRLBUSOFF_UL equals CDD, the name of <User_ControllerBusOff> is selectable.
      enumeration CanIfDispatchUserCtrlBusOffUL: {CAN_SM}, scope=ECU, set at link in variant link-time+post-build / pre-compile in variant pre-compile, default-value=CAN_SM  # This parameter defines the upper layer (UL) module to which the notifications of all ControllerBusOff events from the CAN Driver modules have to be routed via <User_ControllerBusOff>. / Canバスオフ時に呼ばれるCallback関数が属するモジュール情報。 CanSMのみ指定可能。 | There is no possibility to configure no upper layer (UL) module as the provider of <User_ControllerBusOff>.
      function name CanIfDispatchUserCtrlModeIndicationName [0..1]: scope=ECU, set at link in variant link-time+post-build / pre-compile in variant pre-compile, max-length=32, min-length=1  # This parameter defines the name of <User_ControllerModeIndication>. / Canコントローラモードが切り替わった時に呼び出されるCallback関数。 <User_ControllerModeIndication> CanSM_ControllerModeIndicationのみ指定可能。 | This parameter depends on the parameter CANIF_USERCTRLMODEINDICATION_UL. If CANIF_USERCTRLMODEINDICATION_UL equals CAN_SM the name of <User_ControllerModeIndication> is fixed. If CANIF_USERCTRLMODEINDICATION_UL equals CDD, the name of <User_ControllerModeIndication> is selectable.
      enumeration CanIfDispatchUserCtrlModeIndicationUL: {CAN_SM}, scope=ECU, set at link in variant link-time+post-build / pre-compile in variant pre-compile, default-value=CAN_SM  # This parameter defines the upper layer (UL) module to which the notifications of all ControllerTransition events from the CAN Driver modules have to be routed / Canコントローラモードが切り替わった時に呼び出されるCallback関数が属するモジュール情報。 CanSMのみ指定可能。 | via <User_ControllerModeIndication>.
      function name CanIfDispatchUserTrcvModeIndicationName [0..1]: scope=ECU, set at link in variant link-time+post-build / pre-compile in variant pre-compile, max-length=32, min-length=1  # This parameter defines the name of <User_TrcvModeIndication>. / Canトランシーバモードが切り替わった時に呼び出されるCallback関数。 <User_TrcvModeIndication> CanSM_TransceiverModeIndicationのみ指定可能。 | This parameter depends on the parameter CANIF_USERTRCVMODEINDICATION_UL. If CANIF_USERTRCVMODEINDICATION_UL equals CAN_SM the name of <User_TrcvModeIndication> is fixed. If CANIF_USERTRCVMODEINDICATION_UL equals CDD, the name of <User_TrcvModeIndication> is selectable.
      enumeration CanIfDispatchUserTrcvModeIndicationUL [0..1]: {CAN_SM}, scope=ECU, set at link in variant link-time+post-build / pre-compile in variant pre-compile, default-value=CAN_SM  # This parameter defines the upper layer (UL) module to which the notifications of all TransceiverTransition events from the CAN Transceiver Driver modules have to be routed via <User_TrcvModeIndication>. If no UL module is configured, no upper layer callback function will be called. / Canトランシーバコントローラモードが切り替わった時に呼び出されるCallback関数が属するモジュール情報。 CanSMのみ指定可能。
      function name CanIfDispatchUserValidateWakeupEventName [0..1]: scope=ECU, set at link in variant link-time+post-build / pre-compile in variant pre-compile, max-length=32, min-length=1  # This parameter defines the name of <User_ValidateWakeupEvent>. This parameter depends on the parameter CANIF_USERVALIDATEWAKEUPEVENT_UL. CANIF_USERVALIDATEWAKEUPEVENT_UL equals ECUM the name of <User_ValidateWakeupEvent> is fixed. CANIF_USERVALIDATEWAKEUPEVENT_UL equals CDD, the name of <User_ValidateWakeupEvent> is selectable. If parameter CANIF_WAKEUP_CHECK_VALIDATION_API is disabled, no <User_ValidateWakeupEvent> API can be configured. / CanValidateWakeUpイベントが発生した時に呼び出されるCallback関数。 <User_ValidateWakeupEvent> EcuM_ValidateWakeupEventのみ指定可能。 | parameter depends on the parameter CANIF_USERVALIDATEWAKEUPEVENT_UL. CANIF_USERVALIDATEWAKEUPEVENT_UL equals ECUM the name of <User_ValidateWakeupEvent> is fixed. CANIF_USERVALIDATEWAKEUPEVENT_UL equals CDD, the name of <User_ValidateWakeupEvent> is selectable. If parameter CANIF_WAKEUP_CHECK_VALIDATION_API is disabled, no <User_ValidateWakeupEvent> API can be configured.
      enumeration CanIfDispatchUserValidateWakeupEventUL [0..1]: {ECUM}, scope=ECU, set at link in variant link-time+post-build / pre-compile in variant pre-compile, default-value=ECUM  # This parameter defines the upper layer (UL) module to which the notifications about positive former requested wake up sources have to be routed via <User_ValidateWakeupEvent>. If parameter CANIF_WAKEUP_CHECK_VALIDATION_API is disabled, this parameter cannot be configured. / CanValidateWakeUpイベントが発生した時に呼び出されるCallback関数が属するモジュール情報。 ECUMのみ指定可能。
    container CanIfInitCfg: multiple-configuration-container=true  # This container contains the init parameters of the CAN Interface. / CanIfモジュール初期値パラメータ。 | At least one (if only on CanIf with one possible Configuration), but multiple (CanIf with different Configurations) instances of this container are possible.
      string CanIfInitCfgSet [0..0]: set at link in variant link-time / post-build in variant post-build / pre-compile in variant pre-compile, max-length=32, min-length=1  # Selects the CAN Interface specific configuration setup. This type of the external data structure shall contain the post build initialization data for the CAN Interface for all underlying CAN Dirvers. / 未使用 | constant to CanIf_ConfigType
      container CanIfBufferCfg [0..65535]  # This container contains the Txbuffer configuration. Multiple buffers with different sizes could be configured. If CanIfBufferSize (CANIF834_Conf) equals 0, the CanIf Tx L-PDU only refers via this CanIfBufferCfg the corresponding CanIfHthCfg. / 送信バッファ情報。異なるサイズの複数バッファを指定可能。
        integer CanIfBufferSize: 0..255, set at link in variant link-time / post-build in variant post-build / pre-compile in variant pre-compile, default-value=0  # This parameter defines the number of CanIf Tx L-PDUs which can be buffered in one Txbuffer. If this value equals 0, the CanIf does not perform Txbuffering for the CanIf Tx L-PDUs which are assigned to this Txbuffer. If CanIfPublicTxBuffering equals False, this parameter equals 0 for all TxBuffer. If the CanHandleType of the referred HTH equals FULL, this parameter equals 0 for this TxBuffer. / 送信バッファにバッファリング可能なL-PDU数。
        reference CanIfBufferHthRef [1..65535]: set at link in variant link-time / post-build in variant post-build / pre-compile in variant pre-compile, destination=CanIfHthCfg  # Reference to HTH, that defines the hardware object or the pool of hardware objects configured for transmission. All the CanIf Tx L-PDUs refer via the CanIfBufferCfg and this parameter to the HTHs if TxBuffering is enabled, or not. / 送信バッファが紐付くCANハードウェア送信ハンドル(HTH)情報への参照。 | Each HTH shall not be assigned to more than one buffer.
      container CanIfInitHohCfg [0..65535]  # This container contains the references to the configuration setup of each underlying CAN Driver. / CanIfモジュールが制御するCANハードウェアオブジェクトハンドル(HOH)初期化情報。 送信・受信に分かれる。
        reference CanIfInitRefCfgSet [0..0]: set at link in variant link-time / post-build in variant post-build / pre-compile in variant pre-compile, destination=CanConfigSet  # Selects the CAN Interface specific configuration setup. This type of external data structure shall contain the post build initialization data for the CAN Interface for all underlying CAN Drivers. / 未使用
        container CanIfHrhCfg [0..65535]  # This container contains configuration parameters for each hardware receive object (HRH). / CANハードウェア受信ハンドル(HRH)情報。
          boolean CanIfHrhSoftwareFilter: set at link in variant link-time+post-build / pre-compile in variant pre-compile, default-value=true  # Selects the hardware receive objects by using the HRH range/list from CAN Driver configuration to define, for which HRH a software filtering has to be performed at during receive processing. / ソフトウェアフィルタリング機能の有効/無効情報。 TRUE：有効 FALSE：無効 | True: Software filtering is enabled False: Software filtering is enabled
          reference CanIfHrhCanCtrlIdRef: set at link in variant link-time+post-build / pre-compile in variant pre-compile, destination=CanIfCtrlCfg  # Reference to controller Id to which the HRH belongs to. A controller can contain one or more HRHs. / CANハードウェア受信ハンドル(HRH)情報が紐付くコントローラ情報への参照。 1つのコントローラは複数HRH情報を扱うことができる。
          symbolic name reference CanIfHrhCanHandleTypeRef [0..0]: set at link in variant link-time+post-build / pre-compile in variant pre-compile, destination=CanHardwareObject  # The parameter refers to a particular HRH object in the CAN Driver Module configuration. The type of the HRH can either be Full-CAN or Basic-CAN. The type of HRHs is defined in the CAN Driver Module and hence it is derived from CAN Driver Configuration of a Hardware Object. If BasicCAN is configured, software filtering is enabled. / 未使用 | Please note that this reference is deprecated and is kept only for backward compatibility reasons. CanIfHthIdSymRef shall be used instead to get the CanHandleType and CanObjectId of CAN Driver. In the next major release this reference will be deleted.
          symbolic name reference CanIfHrhIdSymRef: set at link in variant link-time / post-build in variant post-build / pre-compile in variant pre-compile, destination=CanHardwareObject  # The parameter refers to a particular HRH object in the CanDrv configuration (see CanHardwareObject CAN324_Conf). / CANドライバモジュールが持つCANハードウェア受信ハンドル(HRH)情報への参照。 | The CanIf receives the following information of the CanDrv module by this reference: - CanHandleType (see CAN323_Conf) - CanObjectId (see CAN326_Conf)
          container CanIfHrhRangeCfg [0..65535]  # Defines the parameters required for configurating multiple CANID ranges for a given same HRH. / CANハードウェア受信ハンドル(HRH)が扱うCAN ID情報。 複数のIDを設定可能。
            integer CanIfHrhRangeRxPduLowerCanId: 0..536870911, set at link in variant link-time / post-build in variant post-build / pre-compile in variant pre-compile  # Lower CAN Identifier of a receive CAN L-PDU for identifier range definition, in which all CAN Ids shall pass the software filtering. / CAN IDの下限値。
            enumeration CanIfHrhRangeRxPduRangeCanIdType: {EXTENDED, STANDARD}, set at link in variant link-time / post-build in variant post-build / pre-compile in variant pre-compile  # Specifies whether a configured Range of CAN Ids shall only consider standard CAN Ids or extended CAN Ids. / CAN IDの種別情報。 EXTENDED：拡張 STANDARD：標準
            integer CanIfHrhRangeRxPduUpperCanId: 0..536870911, set at link in variant link-time / post-build in variant post-build / pre-compile in variant pre-compile  # Upper CAN Identifier of a receive CAN L-PDU for identifier range definition, in which all CAN Ids shall pass the software filtering. / CAN IDの上限値。
        container CanIfHthCfg [0..65535]  # This container contains parameters related to each HTH. / CANハードウェア送信ハンドル(HTH)情報。
          reference CanIfHthCanCtrlIdRef: set at link in variant link-time+post-build / pre-compile in variant pre-compile, destination=CanIfCtrlCfg  # Reference to controller Id to which the HTH belongs to. A controller can contain one or more HTHs. / CANハードウェア送信ハンドル(HTH)が紐付くコントローラ情報への参照。 1つのコントローラは複数HTH情報を扱うことができる。
          symbolic name reference CanIfHthCanHandleTypeRef [0..0]: set at link in variant link-time+post-build / pre-compile in variant pre-compile, destination=CanHardwareObject  # The parameter refers to a particular HTH object in the CAN Driver Module configuration. The type of the HTH can either be Full-CAN or Basic-CAN. The type of HTHs is defined in the CAN Driver Module and hence it is derived from CAN Driver Configuration of a Hardware Object. / 未使用 | Please note that this reference is deprecated and is kept only for backward compatibility reasons. CanIfHthIdSymRef shall be used instead to get the CanHandleType and CanObjectId of CAN Driver. In the next major release this reference will be deleted.
          symbolic name reference CanIfHthIdSymRef: set at link in variant link-time+post-build / pre-compile in variant pre-compile, destination=CanHardwareObject  # The parameter refers to a particular HTH object in the CanDrv configuration (see CanHardwareObject CAN324_Conf). / CANドライバモジュールが持つCANハードウェア送信ハンドル(HTH)情報への参照。 | The CanIf receives the following information of the CanDrv module by this reference: - CanHandleType (see CAN323_Conf) - CanObjectId (see CAN326_Conf)
      container CanIfRxPduCfg [0..65535]  # This container contains the configuration (parameters) of each receive CAN L-PDU. / 受信PDU情報。 | The SHORT-NAME of "CanIfRxPduConfig" container itself represents the symolic name of Receive L-PDU.
        integer CanIfRxPduCanId [0..1]: 0..536870911, set at link in variant link-time / post-build in variant post-build / pre-compile in variant pre-compile  # CAN Identifier of Receive CAN L-PDUs used by the CAN Interface. Exa: Software Filtering. This parameter is used if exactly one Can Identifier is assigned to the Pdu. If a range is assigned then the CanIfRxPduCanIdRange parameter shall be used. / 受信PDUに割り当てるCAN ID。 | Range: 11 Bit For Standard CAN Identifier ... 29 Bit For Extended CAN identifier
        enumeration CanIfRxPduCanIdType: {EXTENDED_CAN, STANDARD_CAN}, set at link in variant link-time / post-build in variant post-build / pre-compile in variant pre-compile  # CAN Identifier of receive CAN L-PDUs used by the CAN Driver for CAN L-PDU reception. / CAN IDの種別情報。 EXTENDED_CAN：拡張 STANDARD_CAN：標準
        integer CanIfRxPduDlc: 0..8, set at link in variant link-time / post-build in variant post-build / pre-compile in variant pre-compile  # Data Length code of received CAN L-PDUs used by the CAN Interface. Exa: DLC check. / CANメッセージのデータ領域サイズ。0～8バイトで指定する。 | The data area size of a CAN L-PDU can have a range from 0 to 8 bytes.
        integer CanIfRxPduId: 0..4294967295, scope=ECU, set at link in variant link-time / post-build in variant post-build / pre-compile in variant pre-compile, symbolic-name-value=true  # ECU wide unique, symbolic handle for receive CAN L-PDU. The CanIfRxPduId is configurable at pre-compile and post-built time. It shall fulfill ANSI/AUTOSAR definitions for constant defines. / 受信PDU ID。 | Range: 0..max. number of defined CanRxPduIds
        boolean CanIfRxPduReadData: scope=ECU, set at link in variant link-time / post-build in variant post-build / pre-compile in variant pre-compile, default-value=false  # Enables and disables the Rx buffering for reading of received L-PDU data. / 受信データのバッファリング機能の有効/無効情報。 TRUE：有効 FALSE：無効 | True: Enabled False: Disabled
        boolean CanIfRxPduReadNotifyStatus: set at link in variant link-time / post-build in variant post-build / pre-compile in variant pre-compile, default-value=false  # Enables and disables receive indication for each receive CAN L-PDU for reading its notification status. / 受信ステータス通知機能の有効/無効情報。 TRUE：有効 FALSE：無効 | True: Enabled False: Disabled
        function name CanIfRxPduUserRxIndicationName [0..1]: scope=ECU, set at link in variant link-time+post-build / pre-compile in variant pre-compile, max-length=32, min-length=1  # This parameter defines the name of the <User_RxIndication>. / 受信完了時に呼び出されるCallback関数。 <User_RxIndication> CanNm/CanTp/PduRで提供される下記の受信完了通知Callback関数から選択可能。 CanNm_RxIndication/CanTp_RxIndication/PduR_CanIfRxIndication | This parameter depends on the parameter CANIF_RXPDU_USERRXINDICATION_UL. If CANIF_RXPDU_USERRXINDICATION_UL equals CAN_TP, CAN_NM, PDUR, XCP or J1939TP, the name of the <User_RxIndication> is fixed. If CANIF_RXPDU_USERRXINDICATION_UL equals CDD, the name of the <User_RxIndication> is selectable.
        enumeration CanIfRxPduUserRxIndicationUL [0..1]: {CAN_NM, CAN_TP, PDUR}, scope=ECU, set at link in variant link-time / post-build in variant post-build / pre-compile in variant pre-compile  # This parameter defines the upper layer (UL) module to which the indication / 受信完了時に呼び出されるコールバック関数が属するモジュール情報。 | of the successfully received CANRXPDUID has to be routed via <User_RxIndication>. This <User_RxIndication> has to be invoked when the indication of the configured CANRXPDUID will be received by an Rx indication event from the CAN Driver module. If no upper layer (UL) module is configured, no <User_RxIndication> has to be called in case of an Rx indication event of the CANRXPDUID from the CAN Driver module.
        reference CanIfRxPduBswSchExclAreaIdRef: set at pre-compile, destination=RteBswExclusiveAreaImpl  # Reference to an exclusive area Id defined within the BSW Scheduler. / BSWスケジューラで定義される排他エリアIDへの参照。
        reference CanIfRxPduHrhIdRef [1..65535]: set at link in variant link-time / post-build in variant post-build / pre-compile in variant pre-compile, destination=CanIfHrhCfg  # The HRH to which Rx L-PDU belongs to, is referred through this parameter. / 受信PDUが紐付くCANハードウェア受信ハンドル(HRH)情報への参照。
        reference CanIfRxPduRef: set at pre-compile, destination=Pdu  # Reference to the "global" Pdu structure to allow harmonization of handle IDs in the COM-Stack. / COM-StackでのハンドルIDの調和を可能にするためにグローバルに定義されるPDU構造定義への参照。
        container CanIfRxPduCanIdRange [0..*]  # Optional container that allows to map a range of CAN Ids to one PduId. / 受信PDUのCAN ID情報。
          integer CanIfRxPduCanIdRangeLowerCanId: 0..536870911, set at link in variant link-time / post-build in variant post-build / pre-compile in variant pre-compile  # Lower CAN Identifier of a receive CAN L-PDU for identifier range definition, in which all CAN Ids are mapped to one PduId. / CAN IDの下限値。
          integer CanIfRxPduCanIdRangeUpperCanId: 0..536870911, set at link in variant link-time / post-build in variant post-build / pre-compile in variant pre-compile  # Upper CAN Identifier of a receive CAN L-PDU for identifier range definition, in which all CAN Ids are mapped to one PduId. / CAN IDの上限値。
        container CanIfTTRxFrameTriggering [0..1]  # This container is only included and valid if TTCAN Interface SWS is used and TTCAN is enabled. / 未使用 | Frame trigger for TTCAN reception. CanIfTTRxFrameTriggering is only included, if the controller supports TTCAN and a joblist is used for reception.
          integer CanTTRxJoblistTimeMark [0..0]: 0..65535, set at link in variant link-time / post-build in variant post-build / pre-compile in variant pre-compile  # Defines the point in time, when the joblist execution funciton (JLEF) shall be called for the referenced rx trigger. Value is given in cycle time. This parameter is only configurable if a joblist is enabled by parameter CanIfTTJobList. / 未使用
          reference CanIfTTRxHwObjectTriggerIdRef [0..0]: set at link in variant link-time / post-build in variant post-build / pre-compile in variant pre-compile, destination=CanTTHardwareObjectTrigger  # This parameter refers to a particular TTCAN hardware receive object Trigger of a hardware object in the TTCAN Driver Module, which is referred via plain CAN parameter CANIF_HRH_HANDLETYPE_REF. This parameter is only configurable if a joblist is enabled by parameter CanIfTTJobList. / 未使用
      container CanIfTxPduCfg [0..65535]  # This container contains the configuration (parameters) of a transmit CAN L-PDU. It has to be configured as often as a transmit CAN L-PDU is needed. / 送信PDU情報。 | The SHORT-NAME of "CanIfTxPduConfig" container represents the symolic name of Transmit L-PDU.
        integer CanIfTxPduCanId: 0..536870911, set at link in variant link-time / post-build in variant post-build / pre-compile in variant pre-compile  # CAN Identifier of transmit CAN L-PDUs used by the CAN Driver for CAN L-PDU transmission. / 送信PDUに割り当てるCAN ID。 | Range: 11 Bit For Standard CAN Identifier ... 29 Bit For Extended CAN identifier
        enumeration CanIfTxPduCanIdType: {EXTENDED_CAN, STANDARD_CAN}, set at link in variant link-time / post-build in variant post-build / pre-compile in variant pre-compile  # Type of CAN Identifier of the transmit CAN L-PDU used by the CAN Driver module for CAN L-PDU transmission. / CAN IDの種別情報。 EXTENDED_CAN：拡張 STANDARD_CAN：標準
        integer CanIfTxPduDlc: 0..8, set at link in variant link-time / post-build in variant post-build / pre-compile in variant pre-compile  # Data length code (in bytes) of transmit CAN L-PDUs used by the CAN Driver for CAN L-PDU transmission. / CANメッセージのデータ領域サイズ。0～8バイトで指定する。 | The data area size of a CAN L-Pdu can have a range from 0 to 8 bytes.
        integer CanIfTxPduId: 0..4294967295, scope=ECU, set at link in variant link-time / post-build in variant post-build / pre-compile in variant pre-compile, symbolic-name-value=true  # ECU wide unique, symbolic handle for transmit CAN L-PDU. The CanIfTxPduId is configurable at pre-compile and post-built time. / 送信PDU ID。 | Range: 0..max. number of CantTxPduIds
        boolean CanIfTxPduPnFilterPdu [0..1]: set at link in variant link-time / post-build in variant post-build / pre-compile in variant pre-compile, default-value=false  # If CanIfPublicPnFilterSupport is enabled, by this parameter PDUs could be configured which will pass the CanIfPnFilter. / 送信PDUのフィルタリング機能の有効/無効情報。 TRUE：有効 FALSE：無効 | If there is no CanIfTxPduPnFilterPdu configured per controller, the corresponding controller applies no CanIfPnFilter.
        boolean CanIfTxPduReadNotifyStatus: set at link in variant link-time / post-build in variant post-build / pre-compile in variant pre-compile, default-value=false  # Enables and disables transmit confirmation for each transmit CAN L-PDU for reading its notification status. / 送信通知状態取得機能の有効/無効情報。 TRUE：有効 FALSE：無効 | True: Enabled False: Disabled
        enumeration CanIfTxPduType: {DYNAMIC, STATIC}, scope=ECU, set at link in variant link-time / post-build in variant post-build / pre-compile in variant pre-compile  # Defines the type of each transmit CAN L-PDU. / 送信PDU種別。 DYNAMIC：動的 STATIC：静的
        function name CanIfTxPduUserTxConfirmationName [0..1]: scope=ECU, set at link in variant link-time+post-build / pre-compile in variant pre-compile, max-length=32, min-length=1  # This parameter defines the name of the <User_TxConfirmation>. This parameter depends on the parameter CANIF_TXPDU_USERTXCONFIRMATION_UL. If CANIF_TXPDU_USERTXCONFIRMATION_UL equals CAN_TP, CAN_NM, PDUR, XCP or J1939TP, the name of the <User_TxConfirmation> is fixed. If CANIF_TXPDU_USERTXCONFIRMATION_UL equals CDD, the name of the <User_TxConfirmation> is selectable. / 送信完了時に呼ばれるCallback関数。 <User_TxConfirmation> CanNm/CanTp/PduRで提供される下記の送信完了通知Callback関数から選択可能。 CanNm_TxConfirmation/CanTp_TxConfirmation/PduR_CanIfTxConfirmation/PduR_CanTpTxConfirmation | parameter depends on the parameter CANIF_TXPDU_USERTXCONFIRMATION_UL. If CANIF_TXPDU_USERTXCONFIRMATION_UL equals CAN_TP, CAN_NM, PDUR, XCP or J1939TP, the name of the <User_TxConfirmation> is fixed. If CANIF_TXPDU_USERTXCONFIRMATION_UL equals CDD, the name of the <User_TxConfirmation> is selectable.
        enumeration CanIfTxPduUserTxConfirmationUL [0..1]: {CAN_NM, CAN_TP, PDUR}, scope=ECU, set at link in variant link-time / post-build in variant post-build / pre-compile in variant pre-compile  # This parameter defines the upper layer (UL) module to which the confirmation of the successfully transmitted CANTXPDUID has to be routed via the <User_TxConfirmation>. / 送信完了時に呼ばれるCallback関数が属するモジュール情報。 CanNm/CanTp/PduRから選択可能。 | This <User_TxConfirmation> has to be invoked when the confirmation of the configured CANTXPDUID will be received by a Tx confirmation event from the CAN Driver module. If no upper layer (UL) module is configured, no <User_TxConfirmation> has to be called in case of a Tx confirmation event of the CANTXPDUID from the CAN Driver module.
        reference CanIfTxPduBswSchExclAreaIdRef: set at pre-compile, destination=RteBswExclusiveAreaImpl  # Reference to an exclusive area Id defined within the BSW Scheduler. / BSWスケジューラで定義される排他エリアIDへの参照。
        reference CanIfTxPduBufferRef: set at link in variant link-time / post-build in variant post-build / pre-compile in variant pre-compile, destination=CanIfBufferCfg  # Configurable reference to a CanIf buffer configuration. / 送信PDUが紐付く送信バッファ情報への参照。
        reference CanIfTxPduRef: set at pre-compile, destination=Pdu  # Reference to the "global" Pdu structure to allow harmonization of handle IDs in the COM-Stack. / COM-StackでのハンドルIDの調和を可能にするためにグローバルに定義されるPDU構造定義への参照。
        container CanIfTTTxFrameTriggering [0..1]  # This container is only included and valid if TTCAN Interface SWS is used and TTCAN is enabled. / 未使用 | Frame trigger for TTCAN transmission. CanIfTTTxFrameTriggering is only included, if the controller supports TTCAN and a joblist is used.
          integer CanIfTTTxJoblistTimeMark [0..0]: 0..65535, set at link in variant link-time / post-build in variant post-build / pre-compile in variant pre-compile  # Defines the point in time, when the joblist execution funciton (JLEF) shall be called for the referenced tx frame trigger. / 未使用 | Value is given in cycle time. This parameter is only configurable if a joblist is enabled by parameter CanIfTTJobList.
          reference CanIfTTTxHwObjectTriggerIdRef [0..0]: set at link in variant link-time / post-build in variant post-build / pre-compile in variant pre-compile, destination=CanTTHardwareObjectTrigger  # This parameter refers to a particular TTCAN hardware transmit object Trigger of a hardware object in the TTCAN Driver Module, / 未使用 | which is referred via plain CAN parameter CANIF_HTH_HANDLETYPE_REF. This parameter is only configurable if a joblist is enabled by parameter CanIfTTJobList.
    container CanIfPrivateCfg  # This container contains the private configuration (parameters) of the CAN Interface. / CanIfモジュール内部設定。
      boolean CanIfPrivateDlcCheck: set at pre-compile, default-value=true  # Selects whether the DLC check is supported. / DLCのチェック機能の有効/無効情報。 TRUE：サポート有 FALSE：サポート無 | True: Enabled False: Disabled
      enumeration CanIfPrivateSoftwareFilterType: {CANIF_Q_BINARY, CANIF_Q_INDEX, CANIF_Q_LINEAR, CANIF_Q_TABLE, CANIF_Q_NONE}, set at pre-compile, default-value=CANIF_Q_LINEAR  # Selects the desired software filter mechanism for reception only. / 受信時に使用するソフトウェアフィルタ。下記の4種類から選択可能 BINARY/INDEX/LINEAR/TABLE | Each implemented software filtering method is identified by this enumeration number. Range: Types implemented software filtering methods
      boolean CanIfSupportTTCAN [0..0]: set at pre-compile, default-value=false  # Defines whether TTCAN is supported. / 未使用 | TRUE: TTCAN is supported. FALSE: TTCAN is not supported, only normal CAN communication is possible.
      container CanIfTTGeneral [0..0]  # This container is only included and valid if TTCAN Interface SWS is used and TTCAN is enabled. / 未使用 | This container contains the parameters, which define if and in which way TTCAN is supported. CanIfTTGeneral is only included, if the controller supports TTCAN.
        boolean CanIfTTJoblist [0..0]: set at pre-compile, default-value=false  # Defines whether TTCAN is processed via a joblist. / 未使用 | TRUE: Joblist is used. FALSE: No joblist is used. This parameter is only configurable if TTCAN is enabled by parameter CanIfSupportTTCAN.
        integer CanIfTTMaxIsrDelay [0..0]: 0..65535, set at link in variant link-time / post-build in variant post-build / pre-compile in variant pre-compile  # Defines the maximum delay for the execution of the joblist execution function JLEF. This parameter is only configurable if a joblist is enabled by parameter CanIfTTJobList. / 未使用
    container CanIfPublicCfg  # This container contains the public configuration (parameters) of the CAN Interface. / CanIfモジュールのパブリックコンフィグレーションパラメータ一覧。
      boolean CanIfPublicCancelTransmitSupport: scope=ECU, set at pre-compile, default-value=false  # Configuration parameter to enable/disable dummy API for upper layer modules which allows to request the cancellation of an I-PDU. / 送信キャンセルサービスの有効/無効情報。 TRUE：有効 FALSE：無効 ただし、送信キャンセルサービスは互換性を担保するためのダミーAPIである。
      string CanIfPublicCddHeaderFile [0..0]: scope=ECU, set at pre-compile, max-length=32, min-length=1  # Defines header files for callback functions which shall be included in case of CDDs. Range of characters is 1.. 32. / 未使用
      boolean CanIfPublicChangeBaudrateSupport [0..0]: scope=ECU, set at pre-compile, default-value=false  # Configuration parameter to enable/disable the API to change the baudrate of a CAN controller. / 未使用 | True: Enabled False: Disabled
      boolean CanIfPublicDevErrorDetect: set at pre-compile, default-value=true  # Enables and disables the development error detection and notification mechanism. / 開発エラーの検出および通知機能の有効/無効情報。 TRUE：有効 FALSE：無効 | True: Enabled False: Disabled
      enumeration CanIfPublicHandleTypeEnum [0..0]: {UINT16, UINT8}, set at pre-compile, default-value=UINT8  # This parameter is used to configure the Can_HwHandleType. The Can_HwHandleType represents the hardware object handles of a CAN hardware unit. For CAN hardware units with more than 255 HW objects the extended range shall be used (UINT16). / 未使用
      boolean CanIfPublicMultipleDrvSupport [0..0]: scope=ECU, set at pre-compile, default-value=false  # Selects support for multiple CAN Drivers. / 未使用 | True: Enabled False: Disabled
      integer CanIfPublicNumberOfCanHwUnits: 1..1, scope=ECU, set at link in variant link-time+post-build / pre-compile in variant pre-compile, default-value=1  # Number of served CAN hardware units. / CANハードウェアユニットの数。
      boolean CanIfPublicPnSupport [0..0]: set at pre-compile, default-value=false  # Selects support of Partial Network features in CanIf. / 未使用 | True: Enabled False: Disabled
      boolean CanIfPublicReadRxPduDataApi: scope=ECU, set at pre-compile, default-value=false  # Enables / Disables the API CanIf_ReadRxPduData() for reading received L-PDU data. / 受信したL-PDUデータをリードするためのAPI CanIf_ReadRxPduData（）の有効/無効情報。 TRUE：有効 FALSE：無効 | True: Enabled False: Disabled
      boolean CanIfPublicReadRxPduNotifyStatusApi: scope=ECU, set at pre-compile, default-value=false  # Enables and disables the API for reading the received L-PDU data. / 受信したL-PDUデータをリードするためのAPI の有効/無効スイッチ。 TRUE：有効 FALSE：無効 | True: Enabled False: Disabled
      boolean CanIfPublicReadTxPduNotifyStatusApi: scope=ECU, set at pre-compile, default-value=false  # Enables and disables the API for reading the notification status of transmit and receive L-PDUs. / L-PDUの送受信の通知ステータスをリードするためのAPI の有効/無効情報。 TRUE：有効 FALSE：無効 | True: Enabled False: Disabled
      boolean CanIfPublicSetDynamicTxIdApi [0..0]: scope=ECU, set at pre-compile, default-value=false  # Enables and disables the API for reconfiguration of the CAN Identifier for each Transmit L-PDU. / 未使用 | True: Enabled False: Disabled
      boolean CanIfPublicTxBuffering: set at pre-compile, default-value=false  # Enables and disables the buffering of transmit L-PDUs (rejected by the CanDrv) within the CAN Interface module. / CAN Interfaceモジュールでの（CanDrvに拒絶された）送信L-PDUのバッファリングの有効/無効情報。 TRUE：有効 FALSE：無効 | True: Enabled False: Disabled
      boolean CanIfPublicTxConfirmPollingSupport: set at pre-compile  # Configuration parameter to enable/disable the API to poll for Tx Confirmation state. / 送信完了状態をポーリング取得するAPIの有効/無効情報。 TRUE：有効 FALSE：無効
      boolean CanIfPublicVersionInfoApi [0..0]: set at pre-compile, default-value=false  # Enables and disables the API for reading the version information about the CAN Interface. / 未使用 | True: Enabled False: Disabled
      boolean CanIfPublicWakeupCheckValidByNM [0..1]: scope=ECU, set at pre-compile, default-value=false  # If enabled, only NM messages shall validate a detected wake-up event / NMによるウェイクアップバリデーションチェック有効/無効情報。 TRUE：有効 FALSE：無効 | (see CANIF722) at the corresponding wake-up source in the CanIf. If disabled, all messages shall validate such a wake-up event. This parameter depends on CANIF_PUBLIC_WAKEUP_CHECK_VALID_API and shall only be configurable, if it is enabled. True: Enabled False: Disabled
      boolean CanIfPublicWakeupCheckValidSupport: scope=ECU, set at pre-compile, default-value=false  # Selects support for wake up validation / ウェイクアップバリデーションのチェック機能の有効/無効情報。 TRUE：有効 FALSE：無効 | True: Enabled False: Disabled
    container CanIfTrcvDrvCfg [0..*]  # This container contains the configuration (parameters) of all addressed CAN transceivers by each underlying CAN Transceiver Driver module. For each CAN transceiver Driver a seperate instance of this container shall be provided. / CanIfモジュールが制御するCANトランシーバに関する設定。 複数のCANトランシーバを制御する場合はCANトランシーバの数だけ設定する。
      container CanIfTrcvCfg [1..65535]  # This container contains the configuration (parameters) of one addressed CAN transceiver by the underlying CAN Transceiver Driver module. For each CAN transceiver a seperate instance of this container has to be provided. / CANトランシーバの設定。
        integer CanIfTrcvId: 0..65535, set at link in variant link-time+post-build / pre-compile in variant pre-compile, symbolic-name-value=true  # This parameter abstracts from the CAN Transceiver Driver specific parameter Transceiver. Each transceiver of all connected CAN Transceiver Driver modules shall be assigned to one specific TransceiverId of the CanIf. / CANトランシーバID。 | Range: 0..number of configured transceivers of all CAN Transceiver Driver modules
        boolean CanIfTrcvWakeupSupport: scope=ECU, set at link in variant link-time+post-build / pre-compile in variant pre-compile, default-value=false  # This parameter defines if a respective transceiver of the referenced CAN Transceiver Driver modules is queriable for wake up events. / CANトランシーバドライバモジュールのウェイクアップイベントサポート情報。 TRUE：サポート FALSE：非サポート | True: Enabled False: Disabled
        symbolic name reference CanIfTrcvCanTrcvRef: scope=ECU, set at link in variant link-time+post-build / pre-compile in variant pre-compile, destination=CanTrcvChannel  # This parameter references to the logical handle of the underlying CAN / CANトランシーバで制御するチャネル情報への参照。 | transceiver from the CAN transceiver driver module to be served by the CAN Interface module. Range: 0..max. number of underlying supported CAN transceivers

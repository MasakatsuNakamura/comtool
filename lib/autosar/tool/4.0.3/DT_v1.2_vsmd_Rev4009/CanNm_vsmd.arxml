AUTOSAR XML (schema 4-0-3)
package /QINeS
  ecuc definition collection AUTOSARParameterDefinition: module=CanNm
  module definition CanNm [0..1]: refined-module-def=CanNm, variants link-time/post-build/pre-compile  # Configuration Parameters for the CanNm module. / CanNmモジュールのコンフィグレーション。
    container CanNmGlobalConfig: multiple-configuration-container=true  # This container contains the global configuration parameter of the CanNm. The parameters and the parameters of the sub containers shall be mapped to the C data type CanNm_ConfigType (for parameters where it is possible) which is passed to the CanNm_Init function. / 本モジュールの全体の設定を行う構造体。 パラメータとサブコンテナ内のパラメータはC言語のCanNm_ConfigType型に割り付けられ、CanNm_Init関数に引き渡される。 （パラメータを適用する為） | This container is a MultipleConfigurationContainer (only for variant 3), i.e. this container and its sub-containers exit once per configuration set.
      boolean CanNmBusLoadReductionEnabled: set at pre-compile, default-value=true  # Pre-processor switch for enabling busload reduction support. / （プリプロセッサ用の設定） バス負荷を軽減するかどうかを切り替える。
      boolean CanNmBusSynchronizationEnabled: set at pre-compile, default-value=false  # Pre-processor switch for enabling bus synchronization support. This feature is required for gateway nodes only. / （プリプロセッサ用の設定） バスの同期処理の有効無効を切り替える。 この機能はゲートウェイノードでのみ必要な機能である。 CanNmPassiveModeEnabledがFalseの場合、本設定値が使用される。 CanNmPassiveModeEnabledがFalseでない場合、本設定はFalse扱いとなる。 | calculationFormula = If (CanNmPassiveModeEnabled == False) then Equal(NmBusSynchronizationEnabled) else Equal(False)
      boolean CanNmComControlEnabled: set at pre-compile, default-value=false  # Pre-processor switch for enabling the Communication Control support. / （プリプロセッサ用の設定） CanNm_EnableCommunicationやCanNm_DisableCommunicationを介して通信の有効無効を切り替える。 | calculationformula = Equal(NmComControlEnabled)
      boolean CanNmComUserDataSupport: set at pre-compile, default-value=false  # Enable/disable the user data support. / ユーザーデータの有効無効を切り替える。 有効とした場合、ユーザデータの設定／取得にCanNmのAPIを使用せず、COMを使用する。
      boolean CanNmCoordinatorSyncSupport: set at pre-compile, default-value=false  # Enables/disables the coordinator synchronisation support. / 協調シャットダウンの有効無効を切り替える。
      boolean CanNmDevErrorDetect: set at pre-compile, default-value=true  # Pre-processor switch for enabling development error detection support. / （プリプロセッサ用の設定） 開発時エラーの有効無効を切り替える。
      boolean CanNmImmediateRestartEnabled: set at pre-compile, default-value=true  # Pre-processor switch for enabling the asynchronous transmission of a NM PDU upon bus-communication request in Prepare-Bus-Sleep mode. / （プリプロセッサ用の設定） 即時送信の有効無効を切り替える。 バススリープ準備モード中にバス通信要求NM PDUの非同期転送の有効化を指定する。
      boolean CanNmImmediateTxconfEnabled: set at pre-compile, default-value=false  # Enable/disable the immediate tx confirmation. / 即時送信確認(immediate tx confirmation)の有効無効を切り替える。
      float CanNmMainFunctionPeriod: 1..255, set at link in variant link-time+post-build / pre-compile in variant pre-compile  # Call cycle in milliseconds of CanNm_MainFunction. / CanNm_MainFunctionが呼ばれる周期を指定する。(1..255[ms])
      boolean CanNmNodeDetectionEnabled: set at pre-compile, default-value=false  # Precompile time switch to enable the node detection feature. / （プリプロセッサ用の設定） ノードの検出機能の有効無効を切り替える。
      integer CanNmNumberOfChannels: 1..255, set at pre-compile, default-value=1  # Number of Can NM channels allowed within one ECU. / ECU一つに設定できるCan NMチャネルのチャネルの総数を入力する。(1..255)
      boolean CanNmPassiveModeEnabled: set at pre-compile, default-value=false  # Pre-processor switch for enabling support of the Passive Mode. / （プリプロセッサ用の設定） パッシブモードの有効無効を切り替える。 | calculationFormula = Equal(NmPassiveModeEnabled)
      boolean CanNmPduRxIndicationEnabled: set at pre-compile, default-value=false  # Pre-processor switch for enabling the PDU Rx Indication. / （プリプロセッサ用の設定） CanNm_RxIndicationが呼ばれた際にNm_ PduRxIndicationの呼び出しの有効無効を切り替える。 | calculationFormula = Equal(NmPduRxIndicationEnabled)
      boolean CanNmPnEiraCalcEnabled [0..0]: set at pre-compile, default-value=false  # Specifies if CanNm calculates the PN request information for internal an external requests. (EIRA) / 未使用 | true: PN request are calculated false: PN request are not calculated
      float CanNmPnResetTime [0..0]: 0.001..65.535, set at link in variant link-time+post-build / pre-compile in variant pre-compile  # Specifies the runtime of the reset timer in seconds. This reset time is valid for the reset of PN requests in the EIRA and in the ERA. The value shall be the same for every channel. Thus it is a global config parameter. / 未使用
      boolean CanNmRemoteSleepIndEnabled: set at pre-compile, default-value=true  # Pre-processor switch for enabling remote sleep indication support. This feature is required for gateway nodes only. / （プリプロセッサ用の設定） リモートスリープ通知(Nm_RemoteSleepIndication)の呼び出しの有効無効を切り替える。 この機能はゲートウェイノードでのみ必要な機能である。 CanNmPassiveModeEnabledがFalseの場合、本設定値が使用される。 CanNmPassiveModeEnabledがFalseでない場合、本設定はFalse扱いとなる。 | calculationFormula = If (CanNmPassiveModeEnabled == False) then Equal(NmRemoteSleepIndEnabled) else Equal(False)
      boolean CanNmRepeatMsgIndEnabled: set at pre-compile, default-value=false  # Enable/disable the notification that a RepeatMessageRequest bit has been received. / RepeatMessageRequest bitを受信した際に Nm_RepeatMessageIndicationの呼び出しの有効無効を切り替える。 | calculationformula = Equal(NmRepeatMsgIndEnabled)
      boolean CanNmStateChangeIndEnabled: set at pre-compile, default-value=false  # Pre-processor switch for enabling the CAN NM state change notification. / （プリプロセッサ用の設定） 本モジュールのステートが変化した際に、Nm_StateChangeNotificationの呼び出しの有効無効を切り替える。 | calculationFormula = Equal(NmStateChangeIdEnabled)
      boolean CanNmUserDataEnabled: set at pre-compile, default-value=false  # Pre-processor switch for enabling user data support. / ユーザーデータの有効無効を切り替える。 | calculationFormula = Equal(NmUserDataEnabled)
      boolean CanNmVersionInfoApi [0..0]: set at pre-compile  # Pre-processor switch for enabling version info API support. / 未使用
      reference CanNmPnEiraRxNSduRef [0..0]: set at link in variant link-time+post-build / pre-compile in variant pre-compile, destination=Pdu  # Reference to a Pdu in the COM-Stack. / 未使用 | Only one SduRef is required for CanNm because the EIRA is the aggregation over all Can Channels.
      container CanNmChannelConfig [1..255]  # This container contains the channel specific configuration parameter of the CanNm. / CanNmのチャンネル毎の設定を行う構造体。
        boolean CanNmActiveWakeupBitEnabled: set at link in variant link-time+post-build / pre-compile in variant pre-compile, default-value=true  # -
        boolean CanNmAllNmMessagesKeepAwake [0..0]: set at link in variant link-time+post-build / pre-compile in variant pre-compile, default-value=false  # Specifies if CanNm drops irrelevant NM messages. / 未使用 | false: Only NM messages with an with CRI bit = true and containing an PN request for this ECU triggers the standard RX indication handling true: Every NM message triggers the standard RX indication handling
        boolean CanNmBusLoadReductionActive: set at link in variant link-time+post-build / pre-compile in variant pre-compile, default-value=true  # This parameter defines if bus load reduction for the respective NM channel is active or not. / NMチャネル毎にバス負荷の軽減の有効無効を切り替える。
        integer CanNmCarWakeUpBitPosition [0..0]: 0..7, set at link in variant link-time+post-build / pre-compile in variant pre-compile  # Specifies the Bit position of the CWU within the NM-Message. / 未使用
        integer CanNmCarWakeUpBytePosition [0..0]: 2..7, set at link in variant link-time+post-build / pre-compile in variant pre-compile  # Specifies the Byte position of the CWU within the NM-Message. / 未使用
        boolean CanNmCarWakeUpFilterEnabled [0..0]: set at link in variant link-time+post-build / pre-compile in variant pre-compile, default-value=false  # If CWU filtering is supported, only the CWU bit within the NM message with source node identifier CanNmCarWakeUpFilterNodeId is considered as CWU request. / 未使用 | FALSE - CWU filtering is not supported TRUE - CWU filtering is supported
        integer CanNmCarWakeUpFilterNodeId [0..0]: 0..255, set at link in variant link-time+post-build / pre-compile in variant pre-compile  # Source node identifier for CWU filtering. If CWU filtering is supported, only the CWU bit within the NM message with source node identifier CanNmCarWakeUpFilterNodeId is considered as CWU request. / 未使用
        boolean CanNmCarWakeUpRxEnabled: set at link in variant link-time+post-build / pre-compile in variant pre-compile, default-value=false  # Enables or disables support of CarWakeUp bit evaluation in received NM messages. / NMメッセージ受信時にCWU(CarWakeUp)ビットのサポートの有効無効を切り替える。 FALSE：CarWakeUpを無効にする TRUE：CarWakeUpを有効にする | FALSE - CarWakeUp not supported TRUE - CarWakeUp supported
        float CanNmImmediateNmCycleTime [0..1]: 1..65535, set at link in variant link-time+post-build / pre-compile in variant pre-compile  # Defines the immediate NM PDU cycle time in milliseconds which is used for CanNmImmediateNmTransmissions NM PDU transmissions. This parameter is only valid if CanNmImmediateNmTransmissions is greater one. / CanNmImmediateNmTransmissionsで指定されるNM PDU送信に使用される。「RepeatMessageState」状態に遷移後、即時送信する時間を指定する。(1..65535[ms]) このパラメータはCanNmImmediateNmTransmissionsが1より大きい場合に有効である。
        integer CanNmImmediateNmTransmissions: 0..255, set at link in variant link-time+post-build / pre-compile in variant pre-compile  # Defines the number of immediate NM PDUs which shall be transmitted. If the value is zero no immediate NM PDUs are transmitted. The cycle time of immeditate NM PDUs is defined by CanNmImmediateNmCycleTime. / 即時送信するNM PDUの数を指定する。 この値が0の場合、NM PDUは即時送信されない。 即時送信するNM PDUの送信周期はCanNmImmediateNmCycleTimeで指定する。
        float CanNmMsgCycleOffset: 0..65535, set at link in variant link-time+post-build / pre-compile in variant pre-compile  # Time offset in the periodic transmission node. It determines the start delay of the transmission. Specified in milliseconds. / 周期送信のオフセット時間。 「Repeat Message State」状態へ遷移後、即時送信期間が終了した後のNM-PDUの送信間隔を指定する。(0..65535[ms]) このパラメータはCanNmPassiveModeEnabledがFalseの場合に有効となる。 | This parameter is only valid if CanNmPassiveModeEnabled is False.
        float CanNmMsgCycleTime: 1..65535, set at link in variant link-time+post-build / pre-compile in variant pre-compile  # Period of a NM-message in milliseconds. It determines the periodic rate in the "periodic transmission mode with bus load reduction" and is the basis for transmit scheduling in the "periodic transmission mode without bus load reduction". / NM-PDUの定期送信間隔を指定する。(1..65535[ms]) 「バス負荷軽減モードの周期送信」の周期、及び、「バス負荷軽減モードでない周期送信」の送信スケジュールの基準となる。 このパラメータはCanNmPassiveModeEnabledがFalseの場合に有効となる。 | This parameter is only valid if CanNmPassiveModeEnabled is False.
        float CanNmMsgReducedTime: 1..65535, set at link in variant link-time / pre-compile in variant pre-compile  # Node specific bus cycle time in the periodic transmission mode with bus load reduction. Specified in milliseconds. / バス負荷の軽減が有効の場合のNM-PDUの送信間隔を指定する。(1..65535[ms]) このパラメータは以下を全て満たす場合にのみ有効となる。 ・CanNmBusLoadReductionEnabled が True ・CanNmBusLoadReductionActive が True ・CanNmPassiveModeEnabled が False | This parameter is only valid if CanNmBusLoadReductionEnabled == True and CanNmBusLoadReductionActive == True and CanNmPassiveModeEnabled == False Otherwise this parameter is not used.
        float CanNmMsgTimeoutTime: 1..65535, set at link in variant link-time+post-build / pre-compile in variant pre-compile  # Transmission Timeout of NM-message. If there is no transmission confirmation by the CAN Interface within this timeout, the CANNM module shall give an error notification. / NMメッセージの送信のタイムアウト時間を設定する。(1..65535[s]) このタイムアウト時間内にCAN Interfaceから送信確認がなかった場合、CanNmモジュールはエラー通知を行う。 このパラメータはCanNmPassiveModeEnabledがFalseの場合に有効となる。 | This parameter is only valid if CANNM_PASSIVE_MODE_ENABLED is disabled.
        integer CanNmNodeId: 0..255, set at link in variant link-time+post-build / pre-compile in variant pre-compile  # Node identifier of local node. / ノードIDを設定する。(0..255) このパラメータは以下を全て満たす場合にのみ有効となる。 ・CanNmPassiveModeEnabled がFalse ・CanNmNodeDetectionEnabled がTrue | This parameter is only valid if CanNmPassiveModeEnabled = False and CanNmNodeDetectionEnabled = True
        enumeration CanNmPduCbvPosition: {CANNM_PDU_BYTE_0, CANNM_PDU_BYTE_1, CANNM_PDU_OFF}, set at link in variant link-time+post-build / pre-compile in variant pre-compile, default-value=CANNM_PDU_BYTE_1  # Defines the position of the control bit vector within the NM PDU. / NM PDU中の制御ビット配列(CBV)の位置を定義する。 CanNmPduByte0：0バイト目 CanNmPduByte1：1バイト目 CanNmPduOff：CBVは使用しない | The value of the parameter represents the location of the control bit vector in the NM PDU (CanNmPduByte0 means byte 0, CanNmPduByte1 means byte 1, CanNmPduOff means source node identifier is not part of the NM PDU) if(CANNM_PDU_CBV_POSITION != CANNM_PDU_OFF && CANNM_PDU_NID_POSITION != CANNM_PDU_OFF) then CANNM_PDU_CBV_POSITION != CANNM_PDU_NID_POSITION if(CANNM_PDU_CBV_POSITION != CANNM_PDU_OFF && CANNM_PDU_NID_POSITION == CANNM_PDU_OFF) then CANNM_PDU_CBV_POSITION = CANNM_PDU_BYTE0 ImplementationType: CanNm_PduPositionType
        enumeration CanNmPduNidPosition: {CANNM_PDU_BYTE_0, CANNM_PDU_BYTE_1, CANNM_PDU_OFF}, set at link in variant link-time+post-build / pre-compile in variant pre-compile, default-value=CANNM_PDU_BYTE_0  # Defines the position of the source node identifier within the NM PDU. / NM PDU中のソースノード識別子(NID)の位置を定義する。 CanNmPduByte0：0バイト目 CanNmPduByte1：1バイト目 CanNmPduOff：NIDは使用しない | The value of the parameter represents the location of the source node identifier in the NM PDU (CanNMPduByte0 means byte 0, CanNmPduByte1 means byte 1, CanNmPduOff means source node identifier is not part of the NM PDU) if(CANNM_PDU_NID_POSITION != CANNM_PDU_OFF && CANNM_PDU_CBV_POSITION != CANNM_PDU_OFF) then CANNM_PDU_NID_POSITION != CANNM_PDU_CBV_POSITION if(CANNM_PDU_NID_POSITION != CANNM_PDU_OFF && CANNM_PDU_CBV_POSITION == CANNM_PDU_OFF) then CANNM_PDU_NID_POSITION = CANNM_PDU_BYTE0 ImplementationType: CanNm_PduPositionType
        boolean CanNmPnEnabled [0..1]: set at link in variant link-time / post-build in variant post-build / pre-compile in variant pre-compile, default-value=false  # Enables or disables support of partial networking. / パーシャルネットワーキング(PN)のサポートの有効無効を切り替える。 false：無効 true：有効 | false: Partial networking Range not supported true: Partial networking supported
        boolean CanNmPnEraCalcEnabled [0..0]: set at link in variant link-time+post-build / pre-compile in variant pre-compile, default-value=false  # Specifies if CanNm calculates the PN request information for external requests. (ERA) / 未使用 | false: PN request are not calculated true: PN request are calculated
        boolean CanNmPnHandleMultipleNetworkRequests [0..0]: set at link in variant link-time+post-build / pre-compile in variant pre-compile, default-value=false  # false: CanNm_NetworkRequest is ignored in NO. / 未使用 | true: CanNm_NetworkRequest triggers a change from NO to RM.
        float CanNmRemoteSleepIndTime: 0..65535, set at link in variant link-time+post-build / pre-compile in variant pre-compile  # Timeout for Remote Sleep Indication. / リモートスリープ通知のタイムアウト。 他の全てのノードがスリープ状態になるまでに要する時間をミリ秒で指定する。 一般的に、この値は(n * CanNmMsgCycleTime)と等しい値にすべきである。 nは通常、リモートスリープ通知を受け取る前に送信されたNMメッセージの数を表す。 (n-1)はリモートスリープ通知処理により紛失することになるNMメッセージの数になる。 0はリモートスリープ通知機能が無効であることを示す。 | It defines the time in seconds how long it shall take to recognize that all other nodes are ready to sleep. Typically it should be equal to: n * CanNmMsgCycleTime, where n denotes the number of NM-Messages that are normally sent before Remote Sleep Indication is detected. The value of n decremented by one determines the amount of lost NM-Messages that can be tolerated by the Remote Sleep Indication procedure. The value 0 denotes that no Remote Sleep Indication functionality is configured.
        float CanNmRepeatMessageTime: 0..65535, set at link in variant link-time+post-build / pre-compile in variant pre-compile  # Timeout for Repeat Message State. / リピートメッセージ状態のタイムアウト。 NMがリピートメッセージ状態にとどまれる時間をミリ秒で指定する。 一般的に、この値は(n * CanNmMsgCycleTime)と等しい値にすべきである。 nは通常、リピートメッセージ状態で送信されるNMメッセージの数を表す。 (n-1)はノード検出処理により紛失することになるNMメッセージの数になる。 0はリピートメッセージ状態が無効であることを示す。 これは、リピートメッセージ状態について一時的にリピートメッセー状態になった後、すぐ、リピートメッセージ状態を去ることとなり、この結果、起動安定性は保証されずノード検出手順が不可能となる事を意味している。 | It defines the time in seconds how long the NM shall stay in the Repeat Message State. Typically it should be equal to: n * CanNmMsgCycleTime, where n denotes the number of NM-Messages that are normally sent in the Repeat Message State. The value of n decremented by one determines the amount of lost NM-Messages that can be tolerated by the node detection procedure. The value 0 denotes that no Repeat Message State is configured. It means that Repeat Message State is transient what implicates that it is left immediately after entrance and in result no start-up stability is guaranteed and no node detection procedure is possible.
        float CanNmTimeoutTime: 2..65535, set at link in variant link-time+post-build / pre-compile in variant pre-compile  # Network Timeout for NM-Messages. / NMメッセージのネットワークタイムアウト。 これはバススリープ準備モードに移行する前にネットワークモードにとどまる時間をミリ秒で表す。 クラスタの全ノードで等しい値でなければならない。 CanNmMsgCycleTimeより大きい値でなければならない。 一般的に、この値は(n * CanNmMsgCycleTime)と等しい値にすべきである。 nはバススリープモードへ移行する前のスリープ準備状態でのNMメッセージ周期回数を表す。 (n-1)は協調アルゴリズムにより紛失することになるNMメッセージの数になる。 | It denotes the time in seconds how long the NM shall stay in the Network Mode before transition into Prepare Bus-Sleep Mode shall take place. It shall be equal for all nodes in the cluster. It shall be greater than CanNmMsgCycleTime. Typically it should be equal to: n * CanNmMsgCycleTime, where n denotes the number of NM-Message cycle times in the Ready Sleep State before transition into the Bus-Sleep Mode is initiated. The value of n decremented by one determines the amount of lost NM-Messages that can be tolerated by the coordination algorithm.
        integer CanNmUserDataLength: 0..8, set at link in variant link-time+post-build / pre-compile in variant pre-compile, default-value=8  # Defines the length of the user data contained in the NM PDU / NM-PDUのユーザーデータの長さを指定する。(0..8)
        float CanNmWaitBusSleepTime: 1..65535, set at link in variant link-time+post-build / pre-compile in variant pre-compile  # Timeout for bus calm down phase. / バススリープ状態のタイムアウト。 これはバススリープモードに移行する前にバススリープモード準備モードにとどまる時間をミリ秒で表す。 クラスタの全ノードで等しい値でなければならない。 全ての送信バッファが空になる時間より十分に大きい値でなければならない。 | It denotes the time in seconds how long the NM shall stay in the Prepare Bus-Sleep Mode before transition into Bus-Sleep Mode shall take place. It shall be equal for all nodes in the cluster. It shall be long enough to make all Tx-buffer empty.
        symbolic name reference CanNmComMNetworkHandleRef: set at link in variant link-time+post-build / pre-compile in variant pre-compile, destination=ComMChannel  # This reference points to the unique channel defined by the ComMChannel and provides access to the unique channel index value in ComMChannelId. / この参照はComMChannelによって定義された特定のチャネルを指し、ComChannelIdで特定のチャネルインデックス値へのアクセスを提供する。
        reference CanNmPnEraRxNSduRef [0..0]: set at link in variant link-time+post-build / pre-compile in variant pre-compile, destination=Pdu  # Reference to a Pdu in the COM-Stack. The SduRef is required for every CanNm Channel, because ERA is reported per channel. / 未使用
        container CanNmRxPdu  # This container is used to configure the Rx PDU properties that are used for the CanNm Channel. / 本モジュールの受信PDUの設定を行う構造体。
          integer CanNmRxPduId: 0..65535, set at link in variant link-time+post-build / pre-compile in variant pre-compile, symbolic-name-value=true  # This parameter defines the Rx PDU ID of the CanIf L-PDU range that is associated with this CanNmChannel instance. / 本モジュールの受信PDUの設定を行う構造体。
          reference CanNmRxPduRef: set at link in variant link-time+post-build / pre-compile in variant pre-compile, destination=Pdu  # Reference to the global PDU that is used by this CanNmChannel instance. / このCanNmChannelで使用するグローバルPDU。
        container CanNmTxPdu [0..*]  # This container contains the CanNmTxConfirmationPduId and the CanNmTxPduRef. / 本モジュールの受信PDUの設定を行う構造体。
          integer CanNmTxConfirmationPduId: 0..65535, set at link in variant link-time+post-build / pre-compile in variant pre-compile, symbolic-name-value=true  # Handle Id to be used by the Lower Layer to confirm the transmission of the CanNmTxPdu to the LowerLayer. / 下位層に対してI-PDUの送信確認通知をするためのIDを指定する。(0..65535)
          reference CanNmTxPduRef: set at link in variant link-time / post-build in variant post-build / pre-compile in variant pre-compile, destination=Pdu  # The reference to the common PDU structure. / 使用する受信I-PDUを指定する。
        container CanNmUserDataTxPdu [0..0]  # This optional container is used to configure the UserNm PDU. This container is only available if CanNmComUserDataSupport is enabled. / 未使用
          integer CanNmTxUserDataPduId: 0..65535, set at link in variant link-time+post-build / pre-compile in variant pre-compile, symbolic-name-value=true  # This parameter defines the Handle ID of the NM User Data I-PDU. / 未使用
          reference CanNmTxUserDataPduRef: set at link in variant link-time+post-build / pre-compile in variant pre-compile, destination=Pdu  # Reference to the NM User Data I-PDU in the global PDU collection. / 未使用
      container CanNmPnInfo [0..0]  # PN information configuration / 未使用
        integer CanNmPnInfoLength: 0..7, set at link in variant link-time+post-build / pre-compile in variant pre-compile, default-value=0  # Specifies the length of the PN request information in the NM message. / 未使用
        integer CanNmPnInfoOffset: 1..7, set at link in variant link-time+post-build / pre-compile in variant pre-compile, default-value=0  # Specifies the offset of the PN request information in the NM message. / 未使用
        container CanNmPnFilterMaskByte [0..7]  # PN information configuration / 未使用
          integer CanNmPnFilterMaskByteIndex: 0..6, set at link in variant link-time+post-build / pre-compile in variant pre-compile  # Specifies the offset of the PN request information in the NM message. / 未使用
          integer CanNmPnFilterMaskByteValue: 0..255, set at link in variant link-time+post-build / pre-compile in variant pre-compile, default-value=0  # Parameter to configure the filter mask byte. / 未使用

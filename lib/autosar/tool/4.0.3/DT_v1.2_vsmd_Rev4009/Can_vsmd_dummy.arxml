AUTOSAR XML (schema 4-0-3)
package /eSOL/EcucDefs
  ecuc definition collection AUTOSARParameterDefinition: module=Can
  module definition Can [0..*]: refined-module-def=Can, variants post-build/pre-compile  # This container holds the configuration of a single CAN Driver. / Can通信モジュールのコンフィグレーション。
    container CanConfigSet: multiple-configuration-container=true  # This is the multiple configuration set container for CAN Driver / CANドライバのための複数のコンフィギュレーション・セット・コンテナ。
      container CanController [1..*]  # This container contains the configuration parameters of the CAN controller(s). / CANコントローラ（複数可）のコンフィグレーション・パラメータ。
        enumeration CanBusoffProcessing: {INTERRUPT, POLLING}, set at pre-compile  # Enables / disables API Can_MainFunction_BusOff() for handling busoff events in polling mode. / ポーリングモードでのバスオフのイベントを処理するためのAPI「Can_MainFunction_BusOff()」の有効/無効 設定。
        boolean CanControllerActivation: set at pre-compile  # Defines if a CAN controller is used in the configuration. / CANコントローラの有効/無効 設定。
        integer CanControllerBaseAddress: 0..4294967295, set at pre-compile  # Specifies the CAN controller base address. / CANコントローラのベースアドレス。
        integer CanControllerId: 0..255, set at pre-compile, symbolic-name-value=true  # This parameter provides the controller ID which is unique in a given CAN Driver. The value for this parameter starts with 0 and continue without any gaps. / CANコントローラID。 CAN Driver内で一意の値を指定する。この値は0からの連続値とする。
        enumeration CanRxProcessing: {INTERRUPT, POLLING}, set at pre-compile  # Enables / disables API Can_MainFunction_Read() for handling PDU reception events in polling mode. / ポーリングモードでPDU受信イベントを処理するAPI「Can_MainFunction_Read()」の有効/無効 設定。
        enumeration CanTxProcessing: {INTERRUPT, POLLING}, set at pre-compile  # Enables / disables API Can_MainFunction_Write() for handling PDU transmission events in polling mode. / ポーリングモードでPDU送信イベントを処理するAPI「Can_MainFunction_Write()」の有効/無効 設定。
        enumeration CanWakeupProcessing: {INTERRUPT, POLLING}, set at pre-compile  # Enables / disables API Can_MainFunction_Wakeup() for handling wakeup events in polling mode. / ポーリングモードでウェイクアップイベントを処理するためのAPI「Can_MainFunction_Wakeup()」の有効/無効 設定。
        boolean CanWakeupSupport: set at pre-compile  # CAN driver support for wakeup over CAN Bus. / CANバス上のウェイクアップ用ドライバのサポート有効/無効 設定。
        reference CanControllerDefaultBaudrate: set at post-build in variant post-build / pre-compile in variant pre-compile, destination=CanControllerBaudrateConfig  # Reference to baudrate configuration container configured for the Can Controller. / CANコントローラー用に設定されたボーレート設定コンテナへの参照。
        reference CanCpuClockRef: set at pre-compile, destination=McuClockReferencePoint  # Reference to the CPU clock configuration, which is set in the MCU driver configuration / MCUドライバに設定されるCPUクロック設定の参照。
        symbolic name reference CanWakeupSourceRef [0..1]: set at pre-compile, destination=EcuMWakeupSource  # This parameter contains a reference to the Wakeup Source for this controller as defined in the ECU State Manager. / Wakeup要求元。 EcuMで設定されるWakeupSourceを参照する。 | Implementation Type: reference to EcuM_WakeupSourceType
        container CanControllerBaudrateConfig [1..*]  # This container contains bit timing related configuration parameters of the CAN controller(s). / CANコントローラのためのビットタイミング等ボーレートパラメータを設定するコンテナ。
          integer CanControllerBaudRate: 0..2000, set at post-build in variant post-build / pre-compile in variant pre-compile  # Specifies the baudrate of the controller in kbps. / コントローラのボーレート指定 (kbps単位)。
          integer CanControllerPropSeg: 0..255, set at post-build in variant post-build / pre-compile in variant pre-compile  # Specifies propagation delay in time quantas. / 伝播時間セグメントを設定する。
          integer CanControllerSeg1: 0..255, set at post-build in variant post-build / pre-compile in variant pre-compile  # Specifies phase segment 1 in time quantas. / 位相バッファセグメント1を設定する。
          integer CanControllerSeg2: 0..255, set at post-build in variant post-build / pre-compile in variant pre-compile  # Specifies phase segment 2 in time quantas. / 位相バッファセグメント2を設定する。
          integer CanControllerSyncJumpWidth: 0..255, set at post-build in variant post-build / pre-compile in variant pre-compile  # Specifies the synchronization jump width for the controller in time quantas. / 再同期ジャンプ幅を設定する。
        container CanFilterMask [0..*]  # This container contains the configuration (parameters) of the CAN Filter Mask(s). / フィルタマスクを設定するコンテナ。
          integer CanFilterMaskValue: 0..4294967295, set at post-build in variant post-build / pre-compile in variant pre-compile  # Describes a mask for hardware-based filtering of CAN identifiers. The CAN identifiers of incoming messages are masked with the appropriate CanFilterMaskValue. Bits holding a 0 mean don't care, i.e. do not compare the message's identifier in the respective bit position. / 受信したCAN-IDに対して適用するフィルタマスクを設定する。 CanFilterMaskValueのビットが0の場合は、そのビットを評価しない。つまり、ビット位置のメッセージのIDを比較しないということになる。 | The mask shall be build by filling with leading 0. In case of CanIdType EXTENDED or MIXED a 29 bit mask shall be build. In case of CanIdType STANDARD a 11 bit mask shall be build
        container CanTTController [0..1]  # This container is only included and valid if TTCAN SWS is used and TTCAN is enabled. / このコンテナはTTCANが有効の場合に使用する。 | This container contains the configuration parameters of the TTCAN controller(s) (which are needed in addition to the configuration parameters of the CAN controller(s)). CanTTController is only included, if the controller supports TTCAN.
          integer CanTTControllerApplWatchdogLimit: 0..255, set at post-build in variant post-build / pre-compile in variant pre-compile  # Defines the maximum time period (unit is 256 times NTU) after which the application has to serve the watchdog. / アプリケーションがウォッチドッグを提供するまでの最大間隔。
          integer CanTTControllerCycleCountMax: 0..63, set at post-build in variant post-build / pre-compile in variant pre-compile  # Defines the value for cycle_count_max. / サイクルカウントの最大数。 許可される値： 0x00： 1 basic cycle 0x01： 2 basic cycles 0x03： 4 basic cycles 0x07： 8 basic cycles 0x0F： 16 basic cycles 0x1F： 32 basic cycles 0x3F： 64 basic cycles | Allowed values: 0x00: 1 basic cycle 0x01: 2 basic cycles 0x03: 4 basic cycles 0x07: 8 basic cycles 0x0F: 16 basic cycles 0x1F: 32 basic cycles 0x3F: 64 basic cycles
          integer CanTTControllerExpectedTxTrigger: 0..255, set at post-build in variant post-build / pre-compile in variant pre-compile  # Number of expected_tx_trigger. / 期待されるTXトリガの数。
          boolean CanTTControllerExternalClockSynchronisation: set at post-build in variant post-build / pre-compile in variant pre-compile  # Enables/disables the external clock synchronization. / 外部クロック同期の有効/無効設定。 TRUE：有効 FALSE：無効 ※CanTTControllerLevel2がTRUEの時のみ、このパラメータは設定可能。 | TRUE: External clock synchronization enabled. FALSE: External clock synchronization disabled. This parameter shall only be configurable if parameter CanTTControllerLevel2 equals TRUE.
          boolean CanTTControllerGlobalTimeFiltering: set at post-build in variant post-build / pre-compile in variant pre-compile  # Enables/disables the global time filtering. / グローバルタイムフィルタリングの有効/無効設定。 TRUE：有効 FALSE：無効 ※CanTTControllerLevel2がTRUEの時のみ、このパラメータは設定可能。 | TRUE: Global time filtering enabled. FALSE: Global time filtering disabled. This parameter shall only be configurable if parameter CanTTControllerLevel2 equals TRUE.
          integer CanTTControllerInitialRefOffset: 0..127, set at post-build in variant post-build / pre-compile in variant pre-compile  # Defines the initial value for ref trigger offset. / トリガを参照する際のオフセットの初期値。
          integer CanTTControllerInterruptEnable: 0..1023, set at post-build in variant post-build / pre-compile in variant pre-compile  # Enables/disables the respective interrupts. / 割り込みの有効/無効 設定。 Bitに1を設定：割り込み有効 Bitに0を設定：割り込み無効 Bit位置に対する割り込み元は以下のとおり 10：Application Watchdog. 9：Watch Trigger reached. 8：Initialization Watch Trigger reached. 7：Change of Error Level. 6：Tx Overflow. 5：Tx Underflow. 4：Global Time Error. 3：Gap. 2：Start of Cycle. 1：Time Discontinuity. 0：Master State Change. ※Bit位置1：Time DiscontinuityとBit位置4：Global Time ErrorはCanTTControllerLevel2がTRUEの時のみ設定可能。 | Bit Position set to 1: Enable respective interrupt. Bit Position set to 0: Disable respective interrupt. Bit Position / Interrupt Source: 10: Application Watchdog. 9: Watch Trigger reached. 8: Initialization Watch Trigger reached. 7: Change of Error Level. 6: Tx Overflow. 5: Tx Underflow. 4: Global Time Error. 3: Gap. 2: Start of Cycle. 1: Time Discontinuity. 0: Master State Change. Bit position "1: Time Discontinuity" and "4: Global Time Error" shall only be configurable if parameter CanTTControllerLevel2 equals TRUE.
          boolean CanTTControllerLevel2: set at post-build in variant post-build / pre-compile in variant pre-compile  # Defines whether Level 2 or Level 1 is used. / CanTTControllerのレベル定義。 TRUE：Level 2 FALSE：Level 1 ※このパラメータをFALSEに設定した場合、依存関係を持つパラメータは設定不要。 | TRUE: Level 2. FALSE: Level 1. If this parameter is set to FALSE then all parameters with dependency to CanTTControllerLevel2 need not be configured.
          float CanTTControllerNTUConfig: 0..100, set at post-build in variant post-build / pre-compile in variant pre-compile  # Defines the config value for NTU (network time unit). / NTU(network time unit)のための設定値。 マイクロ秒単位で設定。 ※CanTTControllerLevel2がTRUEの時のみ、このパラメータは設定可能。 | Value given in microseconds. The value configured shall be greater than 0. Together with the local oscillator period, the TUR (time unit ratio) can be derived from the NTU. This parameter shall only be configurable if parameter CanTTControllerLevel2 equals TRUE.
          enumeration CanTTControllerOperationMode: {CAN_TT_EVENT_SYNC_TIME_TRIGGERED, CAN_TT_EVENT_TRIGGERED, CAN_TT_TIME_TRIGGERED}, set at post-build in variant post-build / pre-compile in variant pre-compile  # Defines the operation mode. / オペレーションモードの定義。
          float CanTTControllerSyncDeviation: 0..100, set at post-build in variant post-build / pre-compile in variant pre-compile  # Defines the maximum synchronization deviation: / 同期ずれの最大値。 NTU(network time unit)のパーセント値を設定。 ※CanTTControllerLevel2がTRUEの時のみ、このパラメータは設定可能。 | Given as a percentage value of the NTU (network time unit). The value configured shall be greater than 0. This parameter shall only be configurable if parameter CanTTControllerLevel2 equals TRUE.
          boolean CanTTControllerTURRestore: set at post-build in variant post-build / pre-compile in variant pre-compile  # Enables/disables the TUR restore. / TUR (time unit ratio) のリストア有効無効設定。 TRUE：有効 FALSE：無効 ※CanTTControllerLevel2がTRUEの時のみ、このパラメータは設定可能。 | Note that the value configured for TUR can be derived from the value configured for NTU and the local oscillator preriod. TRUE: TUR restore enabled. FALSE: TUR restore disabled. This parameter shall only be configurable if parameter CanTTControllerLevel2 equals TRUE.
          boolean CanTTControllerTimeMaster: set at post-build in variant post-build / pre-compile in variant pre-compile  # Defines whether the controller acts as a potential time master. / コントローラのマスタ/スレーブ設定。 TRUE：マスタ FALSE：スレーブ | TRUE: Potential time master. FALSE: Time slave.
          integer CanTTControllerTimeMasterPriority: 0..7, set at post-build in variant post-build / pre-compile in variant pre-compile  # Defines the time master priority. / タイムマスタの優先度。
          integer CanTTControllerTxEnableWindowLength: 1..16, set at post-build in variant post-build / pre-compile in variant pre-compile  # Length of the tx enable window given in CAN bit times. / CAN bit時間中のTX可能なウィンドウの長さ。 | Definition parameter "CanTTControllerTxEnableWindowlength" is used such that: Length of enable window = CanTTControllerTxEnableWindowLength + 1
          integer CanTTControllerWatchTriggerGapTimeMark: 0..65535, set at post-build in variant post-build / pre-compile in variant pre-compile  # watch trigger time mark after a gap / 監視トリガとタイムマークのギャップ。
          integer CanTTControllerWatchTriggerTimeMark: 0..65535, set at post-build in variant post-build / pre-compile in variant pre-compile  # watch trigger time mark / 監視トリガのタイムマーク。
          enumeration CanTTIRQProcessing: {INTERRUPT, POLLING}, set at post-build in variant post-build / pre-compile in variant pre-compile  # Enables / disables API Can_MainFunction_BusOff() for handling busoff events in polling mode. / ポーリングモードでのバスオフのイベントを処理するためのAPI「Can_MainFunction_BusOff()」の有効/無効 設定。
      container CanHardwareObject [1..*]  # This container contains the configuration (parameters) of CAN Hardware Objects. / CANハードウェアオブジェクトの設定に関するコンテナ。
        enumeration CanHandleType: {BASIC, FULL}, set at post-build in variant post-build / pre-compile in variant pre-compile  # Specifies the type (Full-CAN or Basic-CAN) of a hardware object. / CANタイプ。 BASIC：Basic-CAN FULL：Full-CAN
        enumeration CanIdType: {EXTENDED, MIXED, STANDARD}, set at post-build in variant post-build / pre-compile in variant pre-compile  # Specifies whether the IdValue is of type / データフレームの形式。 STANDARD：標準フォーマット(11bit) EXTENDED：拡張フォーマット(29bit) MIXED：混在 | - standard identifier - extended identifier - mixed mode ImplementationType: Can_IdType
        integer CanIdValue: 0..4294967295, set at post-build in variant post-build / pre-compile in variant pre-compile  # Specifies (together with the filter mask) the identifiers range that passes the hardware filter. / ハードウェアフィルタを通過するIDの範囲を（フィルタマスクと共に）指定。
        integer CanObjectId: 0..65535, set at post-build in variant post-build / pre-compile in variant pre-compile, symbolic-name-value=true  # Holds the handle ID of HRH or HTH. The value of this parameter is unique in a given CAN Driver, and it should start with 0 and continue without any gaps. / HRH（受信用のメールボックスのハンドル）、HTH（送信用のメールボックスのハンドル）のID。 CAN Driver内で一意の値を指定する。この値は0からの連続値とする。 | The HRH and HTH Ids are defined under two different name-spaces. Example: HRH0-0, HRH1-1, HTH0-2, HTH1-3
        enumeration CanObjectType: {RECEIVE, TRANSMIT}, set at post-build in variant post-build / pre-compile in variant pre-compile  # Specifies if the HardwareObject is used as Transmit or as Receive object / ハードウェアオブジェクトの受信(HRH)または送信(HTH)区分。 RECEIVE：受信 TRANSMIT：送信
        reference CanControllerRef: set at post-build in variant post-build / pre-compile in variant pre-compile, destination=CanController  # Reference to CAN Controller to which the HOH is associated to. / HOHで送受信されるCANコントローラの関連付け。
        reference CanFilterMaskRef [0..1]: set at post-build in variant post-build / pre-compile in variant pre-compile, destination=CanFilterMask  # Reference to the filter mask that is used for hardware filtering together with the CAN_ID_VALUE. / HRHで使用されるフィルタマスク。CanFilterMaskコンテナへの参照。 | Different CanHardwareObjects with different CanIdTypes (STANDARD, MIXED, EXTENDED) can share the same CanFilterMask (i.e., the CanFilterMaskRef parameters of these CanHardwareObjects reference the very same CanFilterMask container). This shall be allowed and must be supported by the configuration generators. The CanFilterMaskRef is omitted for 1) CanHardwareObjects with CanObjectType set to TRANSMIT 2) CanHardwareObjects with CanObjectType set to RECEIVE if only a single Can ID shall be received via this CanHardwareObjects (i.e., exact match with CanIdValue)
        reference CanMainFunctionRWPeriodRef [0..1]: set at post-build in variant post-build / pre-compile in variant pre-compile, destination=CanMainFunctionRWPeriods  # Reference to CAN Controller to which the HOH is associated to. / 送受信をポーリングで行う場合のポーリング周期。CanMainFunctionRWPeriodsコンテナへの参照。
        container CanTTHardwareObjectTrigger [0..*]  # This container is only included and valid if TTCAN SWS is used and TTCAN is enabled. / ハードウェアオブジェクトのトリガー設定に関するコンテナ。 TTCAN SWSが使用されTTCANが有効な場合に本コンテナが有効。 | This container contains the configuration (parameters) of TTCAN triggers for Hardware Objects, which are additional to the configuration (parameters) of CAN Hardware Objects. CanTTHardwareObjectTrigger is only included, if the controller supports TTCAN.
          integer CanTTHardwareObjectBaseCycle: 0..63, set at post-build in variant post-build / pre-compile in variant pre-compile  # Defines the cycle_offset. / サイクル開始時間を補正するオフセット値。 | CanTTHardwareObjectBaseCycle must be not greater than cycle_count_max.
          integer CanTTHardwareObjectCycleRepetition: 1..64, set at post-build in variant post-build / pre-compile in variant pre-compile  # Defines the repeat_factor. / リピート率。 | CanTTHardwareObjectCycleRepetition shall be a power of two (2), greater than cycle_offset but not greater than cycle_count_max + 1.
          integer CanTTHardwareObjectTimeMark: 0..65535, set at post-build in variant post-build / pre-compile in variant pre-compile  # Defines the point in time, when the trigger will be activated. / トリガー起動時間。 | Value is given in cycle time.
          integer CanTTHardwareObjectTriggerId: 0..63, set at post-build in variant post-build / pre-compile in variant pre-compile, symbolic-name-value=true  # Sequential number which allows separation of different TTCAN triggers configured for one and the same hardware object. / 異なるTTCANの分離を可能にするシーケンス番号。
          enumeration CanTTHardwareObjectTriggerType: {CAN_TT_RX_TRIGGER, CAN_TT_TX_REF_TRIGGER, CAN_TT_TX_REF_TRIGGER_GAP, CAN_TT_TX_TRIGGER_EXCLUSIVE, CAN_TT_TX_TRIGGER_MERGED, CAN_TT_TX_TRIGGER_SINGLE}, set at post-build in variant post-build / pre-compile in variant pre-compile  # Defines the type of the trigger associated with the hardware object. This parameter depends on plain CAN parameter CAN_OBJECT_TYPE. / ハードウェアオブジェクトに関連付けられたトリガのタイプ。CANパラメータのCAN_OBJECT_TYPEに依存する。 | If CAN_OBJECT_TYPE equals RECEIVE than this parameter is fixed to CAN_TT_RX_TRIGGER. If CAN_OBJECT_TYPE equals TRANSMIT than one of the following literals is configurable: CAN_TT_TX_REF_TRIGGER, CAN_TT_TX_REF_TRIGGER_GAP, CAN_TT_TX_TRIGGER_MERGED, CAN_TT_TX_TRIGGER_SINGLE, CAN_TT_TX_TRIGGER_EXCLUSIVE.
    container CanGeneral  # This container contains the parameters related each CAN Driver Unit. / CANドライバの全体的な設定に関するコンテナ。
      boolean CanChangeBaudrateApi: set at pre-compile, default-value=false  # The support of the Can_ChangeBaudrate API is optional. / Can_ChangeBaudrate()関数のAPIサポート有無。 TRUE：サポート有 FALSE：サポート無 | If this parameter is set to true the Can_ChangeBaudrate API shall be supported. Otherwise the API is not supported.
      boolean CanDevErrorDetection: set at pre-compile  # Switches the Development Error Detection and Notification ON or OFF. / DETエラー通知の使用有無 。 TRUE：使用する FALSE：使用しない
      boolean CanHardwareCancellation: set at pre-compile  # Specifies if hardware cancellation shall be supported.ON or OFF / ハードウェアによる送信キャンセルの使用有無 。 TRUE：使用する FALSE：使用しない
      boolean CanIdenticalIdCancellation: set at pre-compile  # Enables/disables cancellation of pending PDUs with identical ID. / 送信を保留しているPDUの送信キャンセルの使用有無 。 TRUE：使用する FALSE：使用しない
      integer CanIndex: 0..255, set at pre-compile  # Specifies the InstanceId of this module instance. If only one instance is present it shall have the Id 0. / CanモジュールのインスタンスID。インスタンスが1つだけの場合はIDは0となる。
      function name CanLPduReceiveCalloutFunction [0..1]: set at pre-compile  # This parameter defines the existence and the name of a callout function that is called after a successful / CANバスから受信したL-PDUを上位レイヤへ送信する際のCallback関数名。 | reception of a received CAN Rx L-PDU. If this parameter is omitted no callout shall take place.
      float CanMainFunctionBusoffPeriod [0..1]: 0.001..65.535, set at pre-compile  # This parameter describes the period for cyclic call to Can_MainFunction_Busoff. Unit is seconds. / バスオフ検知をポーリングで行う場合のCan_MainFunction_Busoff()を呼び出す周期。（秒単位）
      float CanMainFunctionModePeriod: 0.001..65.535, set at pre-compile  # This parameter describes the period for cyclic call to Can_MainFunction_Mode. Unit is seconds. / CANコントローラーのモード変更通をポーリングで行う場合のCan_MainFunction_Mode()を呼び出す周期。（秒単位）
      float CanMainFunctionWakeupPeriod [0..1]: 0.001..65.535, set at pre-compile  # This parameter describes the period for cyclic call to Can_MainFunction_Wakeup. Unit is seconds. / ウェイクアップ検知をポーリングで行う場合のCan_MainFunction_Wakeup()を呼び出す周期。（秒単位）
      boolean CanMultiplexedTransmission: set at pre-compile  # Specifies if multiplexed transmission shall be supported.ON or OFF / 多重伝送のサポート有無。 TRUE：サポート有 FALSE：サポート無
      float CanTimeoutDuration: 0.001..65.535, set at pre-compile  # Specifies the maximum time for blocking function until a timeout is detected. Unit is seconds. / ハードウェア上のモードが切り替わるのを待機するタイムアウトの上限値。（秒単位）
      boolean CanVersionInfoApi: set at pre-compile  # Switches the Can_GetVersionInfo() API ON or OFF. / Can_GetVersionInfo()のサポート有無。 TRUE：サポート有 FALSE：サポート無
      reference CanCounterRef: set at pre-compile, destination=OsCounter  # This parameter contains a reference to the counter, which is used by the CAN driver. / Canモジュールで参照されるOSカウンタ。
      reference CanSupportTTCANRef: set at pre-compile, destination=CanIfPrivateCfg  # The parameter refers to CanIfSupportTTCAN parameter in the CAN Interface Module configuration. / TTCANのサポート有無。CanIfSupportTTCANを参照。 | The CanIfSupportTTCAN parameter defines whether TTCAN is supported.
      container CanMainFunctionRWPeriods
        float CanMainFunctionReadPeriod [0..*]: 0.001..65.535, set at pre-compile  # This parameter describes the period for cyclic call to Can_MainFunction_Read. Unit is seconds. Different poll-cycles will be configurable if more than one CanMainFunctionReadPeriod is configured. In this case multiple Can_MainFunction_Read() will be provided by the CAN Driver module. / メッセージ受信検知（Can_MainFunction_Read()）のポーリング周期。（秒単位）
        float CanMainFunctionWritePeriod [0..*]: 0.001..65.535, set at pre-compile  # This parameter describes the period for cyclic call to Can_MainFunction_Write. Unit is seconds. Different poll-cycles will be configurable if more than one CanMainFunctionWritePeriod is configured. In this case multiple Can_MainFunction_Write() will be provided by the CAN Driver module. / メッセージ送信完了検知（Can_MainFunction_Write()）のポーリング周期。（秒単位）

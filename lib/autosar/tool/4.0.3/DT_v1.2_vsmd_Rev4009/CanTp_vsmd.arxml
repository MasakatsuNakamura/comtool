AUTOSAR XML (schema 4-0-3)
package /QINeS
  ecuc definition collection AUTOSARParameterDefinition: module=CanTp
  module definition CanTp [0..1]: refined-module-def=CanTp, variants post-build/pre-compile  # Configuration of the CanTp (CAN Transport Protocol) module. / CanTpモジュールのコンフィグレーション。
    container CanTpConfig: multiple-configuration-container=true  # This container contains the configuration parameters and sub containers of the AUTOSAR CanTp module. This container is a MultipleConfigurationContainer, i.e. this container and its sub-containers exist once per configuration set. / CanTpモジュールの動作機能関連のコンフィグレーション。
      float CanTpMainFunctionPeriod: 0..255, set at post-build in variant post-build / pre-compile in variant pre-compile  # Allow to configure the time for the MainFunction (as float in seconds). Please note: This period shall be the same as call cycle time of the periodic task were CanTp Main function is called. / 本モジュールの周期処理であるCanTp_MainFunction周期をms単位で指定します(0..255)。 本モジュールで使用するタイマ値のベースとなります。
      container CanTpChannel [1..*]  # This container contains the configuration parameters of the CanTp channel. / 本モジュールで扱うチャネル情報。
        enumeration CanTpChannelMode: {CANTP_MODE_FULL_DUPLEX, CANTP_MODE_HALF_DUPLEX}, set at pre-compile  # The CAN Transport Layer supports half and full duplex channel modes. / チャネル種別情報。 CANTP_MODE_FULL_DUPLEX：全二重方式。送受信中の送受信切り替えが可能。 CANTP_MODE_HALF_DUPLEX：半二重方式。送受信中の送受信切り替えが不可。
        container CanTpRxNSdu [0..*]  # The following parameters needs to be configured for each CAN N-SDU that the CanTp module receives via the CanTpChannel. / チャネルに紐付く受信N-SDU情報。
          integer CanTpBs [0..1]: 0..255, set at post-build in variant post-build / pre-compile in variant pre-compile  # Sets the number of N-PDUs the CanTp receiver allows the sender to send, before waiting for an authorization to continue transmission of the following N-PDUs.For further details on this parameter value see ISO 15765-2 specification. / BS値(0..255)。 1回の連続送信ブロックで許容するCFメッセージ数。
          float CanTpNar [0..1]: 0..Inf, set at post-build in variant post-build / pre-compile in variant pre-compile  # Value in seconds of the N_Ar timeout. N_Ar is the time for transmission of a CAN frame (any N_PDU) on the receiver side. / CF送信開始から送信完了までのタイマ設定値(0..4294967295)をms単位で指定する。
          float CanTpNbr: 0..Inf, set at post-build in variant post-build / pre-compile in variant pre-compile  # Value in seconds of the performance requirement for (N_Br + N_Ar). N_Br is the elapsed time between the receiving indication of a FF or CF or the transmit confirmation of a FC, until the transmit request of the next FC. / FC作成開始(FFもしくは連続送信ブロック最終CF受信完了)からFC送信開始までのタイマ設定値(0..4294967295)をms単位で指定する。
          float CanTpNcr [0..1]: 0..Inf, set at post-build in variant post-build / pre-compile in variant pre-compile  # Value in seconds of the N_Cr timeout. N_Cr is the time until reception of the next Consecutive Frame N_PDU. / CF受信待ち開始(FC送信完了またはCF受信完了)からCF受信完了までのタイマ設定値(0..4294967295)をms単位で指定する。
          enumeration CanTpRxAddressingFormat: {CANTP_EXTENDED, CANTP_MIXED, CANTP_STANDARD}, set at pre-compile  # Declares which communication addressing mode is supported for this Rx N-SDU. / 受信N-SDUのアドレス種別。 CANTP_EXTENDED：拡張方式 CANTP_MIXED：混合方式 CANTP_STANDARD：標準方式 | Enum values: CanTpStandard. To use normal addressing format. CanTpExtended. To use extended addressing format. CanTpMixed. To use mixed addressing format.
          integer CanTpRxDl: 0..65535, set at pre-compile  # Data Length Code of this RxNsdu. In case of variable message length, this value indicates the minimum data length. / 受信N-SDUのデータ長(0..65535)。 実際に受信したN-SDUに設定されたデータ長を使用するため未使用。 | Depending on SF or FF N-SDU the value will be limited to 7 (6 for an extended addressing format) and 4095 respectively.
          integer CanTpRxNSduId: 0..65535, set at pre-compile, symbolic-name-value=true  # Unique identifier user by the upper layer to call CanTp_CancelReceive, CanTp_ChangeParameter and CanTp_ReadParameter. / 受信N-SDUのID(0..65535)。 全チャネルに属する送受信N-SDU毎にユニークなIDを指定する。
          enumeration CanTpRxPaddingActivation: {CANTP_OFF, CANTP_ON}, set at pre-compile  # Defines if the receive frame uses padding or not. / 受信動作に関連するPDUデータの未使用領域にパディング処理を行うかを設定する。 CANTP_OFF：パディング無 CANTP_ONパディング有 | Definition of enumeration values: CanTpOn: The N-PDU received uses padding for SF, FC and the last CF. (N-PDU length is always 8 bytes) CanTpOff: The N-PDU received does not use padding for SF, CF and the last CF. (N-PDU length is dynamic)
          enumeration CanTpRxTaType: {CANTP_FUNCTIONAL, CANTP_PHYSICAL}, set at pre-compile  # Declares the communication type of this Rx N-SDU. / ターゲットアドレス種別。 CANTP_FUNCTIONAL：ファンクショナルアドレッシング CANTP_PHYSICAL：フィジカルアドレッシング
          integer CanTpRxWftMax [0..1]: 0..65535, set at post-build in variant post-build / pre-compile in variant pre-compile  # This parameter indicates how many Flow Control wait N-PDUs can be consecutively transmitted by the receiver. It is local to the node and is not transmitted inside the FC protocol data unit. / 送信FCのFSでWTを連続送信できる最大値(0..65535)を指定する。 | CanTpRxWftMax is used to avoid sender nodes being potentially hooked-up in case of a temporarily reception inability on the part of the receiver nodes, whereby the sender could be waiting continuously.
          float CanTpSTmin [0..1]: 0..127, set at post-build in variant post-build / pre-compile in variant pre-compile  # Sets the duration of the minimum time the CanTp sender shall wait between the transmissions of two CF N-PDUs. / 送信FCのST値(0..127)を指定する。 | For further details on this parameter value see ISO 15765-2 specification.
          reference CanTpRxNSduRef: set at post-build in variant post-build / pre-compile in variant pre-compile, destination=Pdu  # Reference to a Pdu in the COM-Stack. / 受信関連通知を上位に通知する際の対象のPDU。
          container CanTpNAe [0..*]  # Contains the parameters needed to configure each RxNSdu or TxNSdu with CanTpAddressingFormat set to CanTpMixed. / N-SDUのアドレス種別が混合方式の際に使用する拡張アドレス情報値(0..255)。
            integer CanTpNAe: 0..255, set at pre-compile  # If an RxNsdu or a TxNsdu is configured for mixed addressing | format, this parameter contains the transport protocol address extension value.
          container CanTpNSa [0..*]  # Contains the parameters needed to configure each RxNSdu or TxNSdu with CanTpAddressingFormat set to CanTpExtended. / 送信元アドレス情報値(0..255)。 PDU送信データへの送信元アドレス情報の設定は無いため、未使用。
            integer CanTpNSa: 0..255, set at pre-compile  # If an RxNSdu or a TxNSdu is configured for extended addressing format, this parameter contains the transport protocol source address's value.
          container CanTpNTa [0..*]  # The following parameters need to be configured for each RxNsdu or TxNsdu with the CanTpAddressingFormat set to CanTpExtended. / N-SDUのアドレス種別が拡張方式の際に使用する送信先アドレス情報値(0..255)。
            integer CanTpNTa: 0..255, set at pre-compile  # If an RxNsdu or a TxNsdu is configured for extended addressing format, this parameter contains the transport protocol target address's value.
          container CanTpRxNPdu  # Used for grouping of the ID of a PDU and the Reference to a PDU. / 受信PDU情報。
            integer CanTpRxNPduId: 0..65535, set at pre-compile, symbolic-name-value=true  # The N-PDU identifier attached to the RxNsdu is identified by CanTpRxNSduId. / 受信関連の通知を下位から通知された際に指定される本モジュールで管理するPDUのID (0..65535)。 | Each RxNsdu identifier is linked to only one SF/FF/CF N-PDU identifier. Nevertheless, in the case of extended or mixed addressing format, the same N-PDU identifier can be used for several N-SDU identifiers. The distinction is made by the N_TA or N_AE value (first data byte of SF or FF frames).
            reference CanTpRxNPduRef: set at post-build in variant post-build / pre-compile in variant pre-compile, destination=Pdu  # Reference to a Pdu in the COM-Stack. / 受信関連の通知を下位から通知される受信対象のPDU。
          container CanTpTxFcNPdu [0..*]  # Used for grouping of the ID of a PDU and the Reference to a PDU. / 受信N-SDUが使用するFCフレーム情報。
            integer CanTpTxFcNPduConfirmationPduId: 0..65535, set at pre-compile, symbolic-name-value=true  # Handle Id to be used by the CanIf to confirm the transmission of the CanTpTxFcNPdu to the CanIf module. / FC送信完了通知を下位から通知された際に指定される本モジュールで管理するPDUのID (0..65535)。 受信N-SDUがFC送信を伴うかの情報を兼ねており、65535の場合、FC送信は実施しない。
            reference CanTpTxFcNPduRef: set at post-build in variant post-build / pre-compile in variant pre-compile, destination=Pdu  # Reference to a Pdu in the COM-Stack. / FC送信処理を行う際の送信PDU。
        container CanTpTxNSdu [0..*]  # The following parameters needs to be configured for each CAN N-SDU that the CanTp module transmits via the CanTpChannel. / チャネルに紐付く送信N-SDU情報。
          float CanTpNas: 0..Inf, set at post-build in variant post-build / pre-compile in variant pre-compile  # Value in second of the N_As timeout. N_As is the time for transmission of a CAN frame (any N_PDU) on the part of the sender. / フレーム(SF、FF、CF)送信開始から送信完了までのタイマ設定値(0..4294967295)をms単位で指定する。
          float CanTpNbs [0..1]: 0..Inf, set at post-build in variant post-build / pre-compile in variant pre-compile  # Value in seconds of the N_Bs timeout. N_Bs is the time of transmission until reception of the next Flow Control N_PDU. / フレーム送信完了(FFもしくはブロック最終CF)からFC受信完了までのタイマ設定値(0..4294967295)をms単位で指定する。
          float CanTpNcs [0..1]: 0..Inf, set at post-build in variant post-build / pre-compile in variant pre-compile  # Value in seconds of the performance requirement of (N_Cs + N_As). N_Cs is the time which elapses between the transmit request of a CF N-PDU until the transmit request of the next CF N-PDU. / フレーム作成開始(FC受信完了またはCF送信完了)からフレーム作成終了(次CF送信開始)までのタイマ設定値(0..4294967295)をms単位で指定する。
          boolean CanTpTc: set at pre-compile  # switch for enabling Transmit Cancellation. / 送信中のキャンセル可否。 TRUE：キャンセル可 FALSE：キャンセル不可
          enumeration CanTpTxAddressingFormat: {CANTP_EXTENDED, CANTP_MIXED, CANTP_STANDARD}, set at pre-compile  # Declares which communication addressing format is supported for this TxNsdu. / 送信N-SDUのアドレス種別。 CANTP_EXTENDED：拡張方式 CANTP_MIXED：混合方式 CANTP_STANDARD：標準方式 | Definition of Enumeration values: CanTpStandard to use normal addressing format. CanTpExtended to use extended addressing format (the N_TA container of this TxNsdu will be used). CanTpMixed to use mixed addressing format (the N_AE container of this TxNsdu will be used).
          integer CanTpTxDl: 0..65535, set at pre-compile  # Data Length Code of this TxNsdu. In case of variable length message, this value indicates the minimum data length. / 送信N-SDUのデータ長(0..65535)。 送信要求を受けた際の送信要求データに設定されたデータ長を使用するため未使用。
          integer CanTpTxNSduId: 0..65535, set at pre-compile, symbolic-name-value=true  # Unique identifier to a structure that contains all useful information to process the transmission of a TxNsdu. / 送信N-SDUのID(0..65535)。 全チャネルに属する送受信N-SDU毎にユニークなIDを指定する。
          enumeration CanTpTxPaddingActivation: {CANTP_OFF, CANTP_ON}, set at pre-compile  # Defines if the transmit frame use padding or not. / 送信PDUデータの未使用領域にパディング処理を行うかを設定する。 CANTP_OFF：パディング無 CANTP_ONパディング有 | Definition of Enumeration values: CanTpOn The transmit N-PDU uses padding for SF, FC and the last CF. (N-PDU length is always 8 bytes) CanTpOff The transmit N-PDU does not use padding for SF, CF and the last CF. (N-PDU length is dynamic)
          enumeration CanTpTxTaType: {CANTP_FUNCTIONAL, CANTP_PHYSICAL}, set at pre-compile  # Declares the communication type of this TxNsdu. / ターゲットアドレス種別。 CANTP_FUNCTIONAL：ファンクショナルアドレッシング CANTP_PHYSICAL：フィジカルアドレッシング | Enumeration values: CanTpPhysical. Used for 1:1 communication. CanTpFunctional. Used for 1:n communication.
          reference CanTpTxNSduRef: set at post-build in variant post-build / pre-compile in variant pre-compile, destination=Pdu  # Reference to a Pdu in the COM-Stack. / 送信関連通知を上位に通知する際の対象のPDU。
          container CanTpNAe [0..*]  # Contains the parameters needed to configure each RxNSdu or TxNSdu with CanTpAddressingFormat set to CanTpMixed. / N-SDUのアドレス種別が混合方式の際に使用する拡張アドレス情報値(0..255)。
            integer CanTpNAe: 0..255, set at pre-compile  # If an RxNsdu or a TxNsdu is configured for mixed addressing | format, this parameter contains the transport protocol address extension value.
          container CanTpNSa [0..*]  # Contains the parameters needed to configure each RxNSdu or TxNSdu with CanTpAddressingFormat set to CanTpExtended. / 送信元アドレス情報値(0..255)。 PDU送信データへの送信元アドレス情報の設定は無いため、未使用。
            integer CanTpNSa: 0..255, set at pre-compile  # If an RxNSdu or a TxNSdu is configured for extended addressing format, this parameter contains the transport protocol source address's value.
          container CanTpNTa [0..*]  # The following parameters need to be configured for each RxNsdu or TxNsdu with the CanTpAddressingFormat set to CanTpExtended. / N-SDUのアドレス種別が拡張方式の際に使用する送信先アドレス情報値(0..255)。
            integer CanTpNTa: 0..255, set at pre-compile  # If an RxNsdu or a TxNsdu is configured for extended addressing format, this parameter contains the transport protocol target address's value.
          container CanTpRxFcNPdu [0..*]  # Used for grouping of the ID of a PDU and the Reference to a PDU. / 送信N-SDUが使用するFCフレーム情報。
            integer CanTpRxFcNPduId: 0..65535, set at pre-compile, symbolic-name-value=true  # N-PDU identifier attached to the FC N-PDU of this TxNsdu identified by CanTpTxNSduId. / FC受信完了通知を下位から通知された際に指定される本モジュールで管理するPDUのID (0..65535)。 | Each TxNsdu identifier is linked to one Rx FC N-PDU identifier only. However, in the case of extended addressing format, the same FC N-PDU identifier can be used for several N-SDU identifiers. The distinction is made by means of the N_TA value (first data byte of FC frames).
            reference CanTpRxFcNPduRef: set at post-build in variant post-build / pre-compile in variant pre-compile, destination=Pdu  # Reference to a Pdu in the COM-Stack. / FC受信完了通知を下位から通知された際のPDU。
          container CanTpTxNPdu  # Used for grouping of the ID of a PDU and the Reference to a PDU. / 送信PDU情報。
            integer CanTpTxNPduConfirmationPduId: 0..65535, set at pre-compile, symbolic-name-value=true  # Handle Id to be used by the CanIf to confirm the transmission of the CanTpTxNPdu to the CanIf module. / 送信関連の通知を下位から通知された際に指定される本モジュールで管理するPDUのID (0..65535)。
            reference CanTpTxNPduRef: set at post-build in variant post-build / pre-compile in variant pre-compile, destination=Pdu  # Reference to a Pdu in the COM-Stack. / SF・FF・CF送信処理を行う際に指定する送信対象PDU。
    container CanTpGeneral  # This container contains the general configuration parameters of the CanTp module. / CanTpモジュールの一般的機能に関連のコンフィグレーション。
      boolean CanTpChangeParameterApi: set at pre-compile  # This parameter, if set to true, enables the CanTp_ChangeParameterRequest Api for this Module. / CanTp_ChangeParameter関数有効/無効設定。 TRUE：有効 FALSE：無効
      boolean CanTpDevErrorDetect: set at pre-compile  # Switches the Development Error Detection and Notification ON or OFF / 開発時エラー検出および通知の有効/無効設定。 TRUE：有効 FALSE：無効
      integer CanTpPaddingByte: 0..255, set at pre-compile  # Used for the initialization of unused bytes with a certain value / N-SDU未使用領域にパディング処理で設定する値(0..255)。
      boolean CanTpReadParameterApi: set at pre-compile  # This parameter, if set to true, enables the CanTp_ReadParameterApi for this module. / CanTp_ReadParameter関数有効/無効設定。 TRUE：有効 FALSE：無効
      boolean CanTpVersionInfoApi: set at pre-compile  # The function CanTp_GetVersionInfo is configurable (On/Off) by this configuration parameter. / CanTp_GetVersionInfo関数有効/無効設定。 CanTp_GetVersionInfo関数未サポートのため、FALSE固定。

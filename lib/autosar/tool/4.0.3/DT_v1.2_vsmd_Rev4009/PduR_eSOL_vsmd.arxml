AUTOSAR XML (schema 4-0-3)
package /eSOL/EcucDefs
  ecuc definition collection AUTOSARParameterDefinition: module=PduR
  module definition PduR [0..1]: refined-module-def=PduR, variants post-build/pre-compile  # Configuration of the PduR (PDU Router) module. / PduRモジュールのコンフィグレーション。
    container PduRBswModules [0..0]  # Each container describes a specific BSW module (upper/CDD/lower/IpduM) that the PDU Router shall interface to. / 各々のコンテナは、PduRモジュールがインターフェースするためのBSWモジュールの仕様を記載。 | The reason to have it as own configuration container instead of implication of the routing path is to be able to configure CDD:s properly and to force module's to be used in a post-build situation even though no routing is made to/from this module (future configurations may include these modules).
      boolean PduRCancelReceive: set at pre-compile  # Specifies if the Transport protocol module supports the CancelReceive API or not. Value true the API is supported. / CancelReceive APIサポート有無。
      boolean PduRCancelTransmit: set at pre-compile  # Specifies if the BSW module supports the CancelTransmit API or not. Value true the API is supported. / CancelTransmit APIサポート有無。
      boolean PduRChangeParameterRequestApi: set at pre-compile  # This parameter, if set to true, enables the PduR_<Up>ChangeParameterRequest Api for this Module. / ChangeParameterRequest APIサポート有無。
      boolean PduRCommunicationInterface: set at pre-compile  # Specifies if the BSW module supports the Communication Interface APIs or not. Value true the APIs are supported. / Communication Interface APIsサポート有無。 | A module can have both Communication Interface APIs and Transport Protocol APIs (e.g. the COM module).
      boolean PduRLowerModule: set at pre-compile  # The PduRLowerModule will decide who will call the APIs and who will implement the APIs. / 下位モジュールが利用するAPIの実装とPduRが利用するAPIの実装有無。 | For example, if the CanIf module is referenced then the PDU Router module will implement the PduR_CanIfRxIndication API. And the PDUR module will call the CanIf_Transmit API. Other APIs are of course also covered. An upper module can also be an lower module (e.g. the IpduM module).
      boolean PduRRetransmission: set at pre-compile  # If set to true this means that the destination transport protocol module will use the retransmission feature. This parameter might be set to false if the retransmission feature is not used, even though the destination transport protocol is supporting it. / TPモジュールの再送機能使用有無。 | This parameter is only valid for transport protocol modules and gateway operations. If transmission from a local upper layer module this module will handle the retransmission.
      boolean PduRTransportProtocol: set at pre-compile  # The PDU Router module shall use the API parameters specified for transport protocol interface. / トランスポートプロトコル用のAPIパラメータの使用有無。
      boolean PduRTriggertransmit: set at pre-compile  # Specifies if the BSW module supports the TriggerTransmit API or not. Value true the API is supported. / TriggerTransmit APIサポート有無。
      boolean PduRTxConfirmation: set at pre-compile  # Specifies if the BSW module supports the TxConfirmation API or not. Value true the API is supported. / TxConfirmation APIサポート有無。
      boolean PduRUpperModule: set at pre-compile  # The PduRUpperModule will decide who will call the APIs and who will implement the APIs. / 上位モジュールが利用するAPIの実装とPduRが利用するAPIの実装有無。 | For example, if the COM module is referenced then the PDU Router module will implement the PduR_Transmit API. And the PDUR module will call the Com_RxIndication API. Other APIs are of course also covered. An upper module can also be an lower module (e.g. the IpduM module).
      boolean PduRUseTag: set at pre-compile  # This parameter, if set to true, enables the usage of the tag (<up>) in the following API calls: / ＜up＞タグの有効化・無効化。 | * PduR_<Up>CancelReceiveRequest * PduR_<Up>CancelTransmitRequest * PduR_<Up>ChangeParameterRequest Example: If used by COM and the parameter is enabled the PduR_ComCancelTransmitRequest is used. The background is that upper layer modules differ in usage of this tag (e.g. COM is using the tag, DCM is not).
      foreign reference PduRBswModuleRef: set at pre-compile, destination-type=ECUC-MODULE-CONFIGURATION-VALUES  # This is a reference to one BSW module's configuration (i.e. not the ECUC parameter definition template). / 参照するBSWモジュールの特定のコンフィグレーション。 | Example, there could be several configurations of LinIf and this reference selects one of them.
    container PduRGeneral  # This container is a subcontainer of PduR and specifies the general configuration parameters of the PDU Router. / PduRモジュール全般に関するコンテナ。
      boolean PduRDevErrorDetect: set at pre-compile  # If true then PDU Router will enable the error-reporting to the Development Error Tracer (DET). / Detへの通知の有効化・無効化。
      boolean PduRQSupportCanIf: set at pre-compile, origin=QINeS  # - / CanIfモジュールへのルーティング有効化・無効化。
      boolean PduRQSupportCanNm: set at pre-compile, origin=QINeS, default-value=false  # - / CanNmモジュールへのルーティング有効化・無効化。
      boolean PduRQSupportCanTp: set at pre-compile, origin=QINeS  # - / CanTpモジュールへのルーティング有効化・無効化。
      boolean PduRQSupportCom: set at pre-compile, origin=QINeS  # - / Comモジュールへのルーティング有効化・無効化。
      boolean PduRQSupportDcm: set at pre-compile, origin=QINeS, default-value=false  # - / Dcmモジュールへのルーティング有効化・無効化。
      boolean PduRQSupportIpduM: set at pre-compile, origin=QINeS  # -
      boolean PduRQSupportLinIf: set at pre-compile, origin=QINeS  # - / LinIfモジュールへのルーティング有効化・無効化。
      boolean PduRQSupportLinTp: set at pre-compile, origin=QINeS  # - / LinTpモジュールへのルーティング有効化・無効化。
      boolean PduRVersionInfoApi [0..0]: set at pre-compile  # If true the PduR_GetVersionInfo API is available. / PduR_GetVersionInfo APIの有効化・無効化。
      boolean PduRZeroCostOperation [0..0]: set at pre-compile  # If set the PduR configuration generator will report an error if zero-cost-operation cannot be fulfilled. / ゼロコストオペレーションのサポート有無。 | This parameter shall be seen as an input requirement to the configuration generator.
    container PduRRoutingTables: multiple-configuration-container=true  # Represents one table of routing paths. / ルーティングテーブル全般に関するコンテナ。 | This routing table allows multiple configurations that can be used to create several routing tables in the same configuration. This is mainly used for post-build (e.g. post-build selectable) but can be used by pre-compile and link-time for variant handling.
      integer PduRConfigurationId: 0..65535, set at pre-compile  # Identification of the configuration of the PduR configuration. This identification can be read using the PduR API. / コンフィグレーションID。
      container PduRRoutingPathGroup [0..*]  # This container groups routing path destinations. Destinations are used instead of routing paths since a routing path can be 1:n. It is desirable to be able to enable/disable a specific bus (i.e. a destination) rather than a routing path. Of course it is possible to create groups that covers specific routing paths as well. / ルーティングパスグループのコンテナ。 | Enabling and disabling of routing path groups are made using the PduR API
        boolean PduRIsEnabledAtInit [0..0]: set at pre-compile  # If set to true this routing path group will be enabled after initializing the PDU Router module (i.e. enabled in the PduR_Init function). / 初期化後のルーティングパスグループの有効化・無効化。
        integer PduRRoutingPathGroupId: 0..65535, set at post-build in variant post-build / pre-compile in variant pre-compile, symbolic-name-value=true  # Identification of the routing group. / ルーティングパスグループID。 | The identification will be used by the disable/enable API in the PDU Router module API.
        reference PduRDestPduRef [0..0]: set at post-build in variant post-build / pre-compile in variant pre-compile, destination=PduRDestPdu  # This reference selects one destination of the routing path. / 転送先のPDU IDの参照パラメータ。
      container PduRRoutingTable [0..2]  # Represents one container of routing paths. Each container is either minimum routing or not. / ルーティングテーブルのコンテナ。
        boolean PduRIsMinimumRouting [0..0]: set at pre-compile  # Specifies if the container contains routing paths that are of the type minimum routing or not. / ミニマムルーティングとしてのルーティングパスを含むか否か。
        container PduRRoutingPath [0..*]  # This container is a subcontainer of PduRRoutingTable and specifies the routing path of a PDU. / ルーティングパスのコンテナ。
          container PduRDestPdu  # This container is a subcontainer of PduRRoutingPath and specifies one destination for the PDU to be routed. / ルーティングパスの転送先のコンテナ。
            enumeration PduRDestModule: {PDUR_Q_UP_COM, PDUR_Q_UP_IPDUM, PDUR_Q_LO_IPDUM, PDUR_Q_LO_CANIF, PDUR_Q_LO_LINIF, PDUR_Q_LO_CANTP, PDUR_Q_LO_LINTP}, set at post-build in variant post-build / pre-compile in variant pre-compile, origin=QINeS  # This parameter is only for communication interfaces. Transport protocol modules will always call the TxConfirmation function. If set the destination communication interface module will call the TxConfirmation. However the TxConfirmation may be not called due to error. So the PduR shall not block until the TxConfirmation is called. One background for this parameter is for the PduR to know when all modules have confirmed a multicast operation. / 転送先モジュールタイプ。
            enumeration PduRDestPduDataProvision [0..1]: {PDUR_DIRECT, PDUR_TRIGGERTRANSMIT}, set at post-build in variant post-build / pre-compile in variant pre-compile  # Specifies how data are provided: direct (as part of the Transmit call) or via the TriggerTransmit callback function. Only required for non-TP I-PDUs (local and gatewayed). / 転送先の非TP I-PDUの送信方式が直接送信またはトリガ送信。
            integer PduRDestPduHandleId: 0..255, set at post-build in variant post-build / pre-compile in variant pre-compile, symbolic-name-value=true  # PDU identifier assigned by PDU Router. Used by communication interface and transport protocol modules for confirmation. / PduRのハンドルIDで、転送先のモジュールが参照するPDU ID。
            integer PduRTpThreshold [0..0]: 1..65535, set at pre-compile  # Defines the number of bytes which shall be received before transmission on the destination bus may start. Only required for routing-on-the-fly TP gateway PDUs. The threshold shall not be larger than the length of the related TP Buffer. / routing-on-the-fly用の閾値で受信データ長が本パラメータを超えた場合に転送先にルーティングを行う。
            boolean PduRTransmissionConfirmation [0..0]: set at pre-compile  # This parameter is only for communication interfaces. Transport protocol modules will always call the TxConfirmation function. / 転送先の非TPモジュールのTxConfirmation APIの利用有無。 | If set the destination communication interface module will call the TxConfirmation. However the TxConfirmation may be not called due to error. So the PduR shall not block until the TxConfirmation is called. One background for this parameter is for the PduR to know when all modules have confirmed a multicast operation.
            reference PduRDestPduRef: set at post-build in variant post-build / pre-compile in variant pre-compile, destination=Pdu  # Destination PDU reference; reference to unique PDU identifier which shall be used by the PDU Router instead of the source PDU ID when calling the related function of the destination module. / 転送先のPDU IDの参照パラメータ。
            reference PduRDestTxBufferRef [0..1]: set at post-build in variant post-build / pre-compile in variant pre-compile, destination=PduRTxBuffer  # Reference to a buffer that is allocated in the PduRTxBuffer. Having a global (for PduR) list of buffers allows reusage and hence less memory consumption. / ゲートウェイ時のトリガ送信用の非TP I-PDUバッファの参照パラメータ。
            container PduRDefaultValue [0..0]  # Specifies the default value of the I-PDU. Only required for gateway operation and if at least one PDU specified by PduRDestPdu uses TriggerTransmit Data provision. / ゲートウェイ時のトリガ送信用の非TP I-PDUバッファのデフォルト値のコンテナ。 | Represented as an array of IntegerParamDef.
              container PduRDefaultValueElement [0..*]  # Each value element is represented by the element and the position in an array. / デフォルト値。
                integer PduRDefaultValueElement: 0..255, set at post-build in variant post-build / pre-compile in variant pre-compile  # The default value consists of a number of elements. Each element is one byte long and the number of elements is specified by SduLength. The position of this parameter in the container is specified by the PduRElementBytePosition parameter.
                integer PduRDefaultValueElementBytePosition: 0..255, set at post-build in variant post-build / pre-compile in variant pre-compile  # This parameter specifies the byte position of the element within the default value / バイト位置。
          container PduRSrcPdu  # This container is a subcontainer of PduRRoutingPath and specifies the source of the PDU to be routed. / ルーティングパスの転送元のコンテナ。
            integer PduRSourcePduHandleId: 0..255, set at post-build in variant post-build / pre-compile in variant pre-compile, symbolic-name-value=true  # PDU identifier assigned by PDU Router. / PduRのハンドルIDで、転送元のモジュールが参照するPDU ID。
            enumeration PduRSrcModule: {PDUR_Q_UP_COM, PDUR_Q_UP_IPDUM, PDUR_Q_LO_IPDUM, PDUR_Q_LO_CANIF, PDUR_Q_LO_LINIF, PDUR_Q_LO_CANTP, PDUR_Q_LO_LINTP}, set at post-build in variant post-build / pre-compile in variant pre-compile, origin=QINeS  # - / 転送元モジュールタイプ。
            reference PduRSrcPduRef: set at post-build in variant post-build / pre-compile in variant pre-compile, destination=Pdu  # Source PDU reference; reference to unique PDU identifier which shall be used for the requested PDU Router operation. / 転送元のPDU IDの参照パラメータ。
      container PduRTpBufferTable [0..1]  # This container will specify the needed buffers for gatewaying using TP. It is not connected to the specific routing path destination to allow a more efficient buffer handling. / ゲートウェイ用のTP I-PDUバッファのコンテナ。
        integer PduRMaxTpBufferNumber [0..0]: 0..65535, set at post-build in variant post-build / pre-compile in variant pre-compile  # maximum number of TP buffers. / TPバッファ最大数。
        container PduRTpBuffer [0..*]  # Specifies a buffer used for gatwaying through TP. / TPバッファ。
          integer PduRTpBufferLength: 1..65535, set at pre-compile  # Length of the TP buffer in number of bytes / TPバッファ長。
      container PduRTxBufferTable [0..1]  # This container will specify the needed buffers for gatewaying using communication interface. It not defined per routing path to allow reusage of buffers. / ゲートウェイ時のトリガ送信用の非TP I-PDUバッファのコンテナ。
        integer PduRMaxTxBufferNumber [0..0]: 0..65535, set at post-build in variant post-build / pre-compile in variant pre-compile  # maximum number of Tx buffers. / Txバッファ最大数。
        container PduRTxBuffer [0..*]  # Specifies a buffer used for gatwaying through communication interface. / Txバッファ。
          integer PduRPduMaxLength: 1..255, set at pre-compile  # Length of the Tx buffer in number of bytes. / Txバッファ長。
          integer PduRTxBufferDepth: 1..255, set at pre-compile  # Number of Pdus that can be stored in the buffer. If value is 1 then the buffer semantic is "last is best". If the value is greater then 1 then the buffer semnatic is a FiFo. / Txバッファのキュー数。
